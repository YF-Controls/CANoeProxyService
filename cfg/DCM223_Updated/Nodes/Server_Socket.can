/*@!Encoding:1252*/
includes
{
  
}
// ---------------------------------------------------
// node global variables.
// ---------------------------------------------------
variables
{
  const int gMTU = 1500;               // tcp mtu
  const int gSERVER_REPLY_WELCOME = 1; // server reply for welcome.
  const int gSERVER_REPLY_ANSWER = 2;  // server reply for answer.
  const dword gIPV4_STR_SIZE = 16;     // IPv4 string size
  const dword gINVALID_SOCKET = ~0;    // invalid socket constant
  dword gListenPort = 4242;           // port to send udp to.
  dword gListenSocket = gINVALID_SOCKET;       // server side: server listen socket
  dword gServerClientSocket = gINVALID_SOCKET; // server side: a client's socket
  char gServerTcpBuffer[gMTU];                 // tcp receive buffer of server
  int Cont = 0;
  
  timer DMRR_timer;
  timer DMRL_timer;

  dword Socket_nvm = 0;
  int ar[100];
  
  int DMRR_ACTIVE = 0;
  int DMRL_ACTIVE = 0;
  
  int TargetRL = 0;
  int TargetRR = 0;
  
  int TargOK = 0;
  
  int target = 0;
}

// ---------------------------------------------------
// Interaction: Server disconnects client...
// ---------------------------------------------------
on key 'x'
{
  serverDisconnectClient();
}

// ---------------------------------------------------
// on measurement start. (initialize and start demo)
// ---------------------------------------------------
on start
{
  serverStart();
  @DAG_Diagnostics::DiagnosticsRole = 3;
  @ModelGlobal::ISw_Stat = 4;
  @IL::Klemme15 = 1;
}

// ---------------------------------------------------
// before measurement stops.
// ---------------------------------------------------
on preStop
{
  // close server ( this implies closing all server and client sockets. )
  serverClose();
}

  
  on message 0x16420134x /*RL*/
   {
    if (target != 1)
    {
      TargetRL = 1;
      TargetRR = 0;
      DMRR_ACTIVE = 0;
      DMRL_ACTIVE = 1;
      sysSetVariableString("LocalAuthentication", "DiagTarget", "DMRL223") ;
      target = 1; 
      write ("entra");
    }
   }
  
  on message 0x14420134x /*RL*/
   {
    if (target != 1)
    {
      TargetRL = 1;
      TargetRR = 0;
      DMRR_ACTIVE = 0;
      DMRL_ACTIVE = 1;
      sysSetVariableString("LocalAuthentication", "DiagTarget", "DMRL223") ;
      target = 1; 
      write ("entra2");
    }
   }
  
  on message 0x16420136x /*RR*/
   {
    if (target != 2)
    {
      TargetRL = 0;
      TargetRR = 1;
      DMRR_ACTIVE = 1;
      DMRL_ACTIVE = 0;
      sysSetVariableString("LocalAuthentication", "DiagTarget", "DMRR223") ;
      target = 2; 
    }
   }
  
    on message 0x14420136x /*RR*/
   {
    if (target != 2)
    {
      TargetRL = 0;
      TargetRR = 1;
      DMRR_ACTIVE = 1;
      DMRL_ACTIVE = 0;
      sysSetVariableString("LocalAuthentication", "DiagTarget", "DMRR223") ;
      target = 2; 
    }
   }
on timer DMRR_timer
{
  diagRequest DMRR223.SoftwareVersion_Read DMRR_SW;
  diagRequest DMRR223.HardwareVersion_Read DMRR_HW;
  diagRequest DMRR223.ECUSerialNumberDataIdentifier_Read DMRR_SN;

  if (TargOK == 1)
 {
  switch(Cont)
  {
    case 0: // SW
        DiagSendRequest(DMRR_SW);
        Cont++;
        setTimer(DMRR_timer,1);
      break;
    case 1: // HW
        DiagSendRequest(DMRR_HW);
        Cont++;
        setTimer(DMRR_timer,1);
      break;
    case 2: // SN
        DiagSendRequest(DMRR_SN);
        Cont++;
        setTimer(DMRR_timer,1);
      break;
    case 3: // Fin
        Cont = 0;
        cancelTimer(DMRR_timer);
        TargOK = 0;
      break;
    default:
      break;
  }
}
else
{
  setTimer(DMRR_timer,1);
}
}

on timer DMRL_timer
{
  diagRequest DMRL223.SoftwareVersion_Read DMRL_SW;
  diagRequest DMRL223.HardwareVersion_Read DMRL_HW;
  diagRequest DMRL223.ECUSerialNumberDataIdentifier_Read DMRL_SN;
  
  if (TargOK == 1)
 {
  switch(Cont)
  {
    case 0: // SW
        DiagSendRequest(DMRL_SW);
        Cont++;
        setTimer(DMRL_timer,1);
      break;
    case 1: // HW
        DiagSendRequest(DMRL_HW);
        Cont++;
        setTimer(DMRL_timer,1);
      break;
    case 2: // SN
        DiagSendRequest(DMRL_SN);
        Cont++;
        setTimer(DMRL_timer,1);
      break;
    case 3: // Fin
        Cont = 0;
        cancelTimer(DMRL_timer);
        TargOK = 0;
      break;
    default:
      break;
  }
}
else
{
  setTimer(DMRL_timer,1);
}
}

on sysvar DM223::DMRL
{
  if (@DM223::DMRL==1)
  {
    @DM223::DMRR = 0;
    sysSetVariableString("LocalAuthentication", "DiagTarget", "DMRL223") ;
  }
}
on sysvar DM223::DMRR
{
  if (@DM223::DMRR==1)
  {
    @DM223::DMRL = 0;
    sysSetVariableString("LocalAuthentication", "DiagTarget", "DMRR_223") ;
  }
}

on sysvar ACCTIONS::DOWN
{

    if (@ACCTIONS::DOWN == 1)
  {
    //Action_Type_DOWN = 1;
    if (DMRL_ACTIVE == 1)
    {
      diagRequest DMRL223.WL_Modellierte_Async_Routine_PWC_Window_Lift_Start req;
      req.SetParameter("WinLift_Rq", 1);
      DiagSendRequest(req);
//      sendTcpData (Socket_nvm, "Action_type_DOWN_DMRL OK");
//      write("Action_type_DOWN_DMRL OK");
    }
    if (DMRR_ACTIVE == 1)
    {
      diagRequest DMRR223.WL_Modellierte_Async_Routine_PWC_Window_Lift_Start req;
      req.SetParameter("WinLift_Rq", 1);
      DiagSendRequest(req);
//      sendTcpData (Socket_nvm, "Action_type_DOWN_DMRR OK");
//      write("Action_type_DOWN_DMRR OK");
    }
  }
}

on sysvar ACCTIONS::UP
{
    if (@ACCTIONS::UP == 1)
  {
    if (DMRL_ACTIVE == 1)
    {
      diagRequest DMRL223.WL_Modellierte_Async_Routine_PWC_Window_Lift_Start req;
      req.SetParameter("WinLift_Rq", 2);
      DiagSendRequest(req);
//      sendTcpData (Socket_nvm, "Action_type_UP_DMRL OK");
//      write("Action_type_UP_DMRL OK");
    }
    if (DMRR_ACTIVE == 1)
    {
      diagRequest DMRR223.WL_Modellierte_Async_Routine_PWC_Window_Lift_Start req;
      req.SetParameter("WinLift_Rq", 2);
      DiagSendRequest(req );
//      sendTcpData (Socket_nvm, "Action_type_UP_DMRR OK");
//      write("Action_type_UP_DMRR OK");
    }
  }
}
on sysvar ACCTIONS::STOP
{
  if (@ACCTIONS::STOP == 1)
  {
    if (DMRL_ACTIVE == 1)
    {
      diagRequest DMRL223.WL_Modellierte_Async_Routine_PWC_Window_Lift_Stop req;
      DiagSendRequest(req);
//      sendTcpData (Socket_nvm, "Action_type_STOP_DMRL OK");
//      write("Action_type_STOP_DMRL OK");
    }
    if (DMRR_ACTIVE == 1)
    {
      diagRequest DMRR223.WL_Modellierte_Async_Routine_PWC_Window_Lift_Stop req;
      DiagSendRequest(req);
//      sendTcpData (Socket_nvm, "Action_type_STOP_DMRR OK");
//      write("Action_type_STOP_DMRR OK");
    }
  }
}

on sysvar ACCTIONS::SW_version
{
  if (@ACCTIONS::SW_version== 1)
  {
    if (DMRL_ACTIVE == 1)
    {
      diagRequest DMRL223.SoftwareVersion_Read req;
      DiagSendRequest(req);
    }
    if (DMRR_ACTIVE == 1)
    {
      diagRequest DMRR223.SoftwareVersion_Read req;
      DiagSendRequest(req);
    }
  }
}

on sysvar ACCTIONS::HW_version
{
  if (@ACCTIONS::HW_version== 1)
  {
    if (DMRL_ACTIVE == 1)
    {
      diagRequest DMRL223.HardwareVersion_Read req;
      DiagSendRequest(req);
    }
    if (DMRR_ACTIVE == 1)
    {
      diagRequest DMRR223.HardwareVersion_Read req;
      DiagSendRequest(req);
    }
  }
}

on sysvar ACCTIONS::SN_version
{
  if (@ACCTIONS::SN_version== 1)
  {
    if (DMRL_ACTIVE == 1)
    {
      diagRequest DMRL223.ECUSerialNumberDataIdentifier_Read req;
      DiagSendRequest(req);
    }
    if (DMRR_ACTIVE == 1)
    {
      diagRequest DMRR223.ECUSerialNumberDataIdentifier_Read req;
      DiagSendRequest(req);
    }
  }
}

on sysvar ACCTIONS::Auto
{
  if (@ACCTIONS::Auto ==1)
  {
    if (TargetRL==1)
        {
          @LocalAuthentication::Button_Authenticate = 1;
          DMRR_ACTIVE = 0;
          DMRL_ACTIVE = 1;
          Cont = 0;
          if (TargOK == 1)
          {
            setTimer(DMRL_timer,3);
          }
        }
  }
}

// ---------------------------------------------------
// Callback when client connects to server's listen socket.
// ---------------------------------------------------
void OnTcpListen( dword socket, long result)
{
  dword errCode;
  writeLineEx(1, 1, " [ S: OnTcpListen called. (result: %d)]", result);
  if (gServerClientSocket != gINVALID_SOCKET)
  {
    writeLineEx(1, 2, "S: A client is already connected. Not accepting.");
    return;
  }
  if (result == 0)
  {
    if (socket == gListenSocket)
    {
      write("S: Incoming client.", socket);
      gServerClientSocket = TcpAccept( gListenSocket );
      if (gServerClientSocket == gINVALID_SOCKET)
      {
        errCode = IpGetLastSocketError(gListenSocket);
        if (errCode == 87)
        {
          writeLineEx( 1, 3, "S: TcpAccept: Invalid listen socket given.");
          // handle error...
        }
        else
        {
          writeLineEx( 1, 3, "S: TcpAccept: Socket error: %d", IpGetLastSocketError(gListenSocket) );
          // handle error...
        }
      }
      else
      {
        write("S: Accepted client on socket %d to socket %d.", gListenSocket, gServerClientSocket);
        cancelTimer(DMRR_timer);
        cancelTimer(DMRL_timer);
        //totalVersions[0] = '\0';
//        TargetRL = 0;
//        TargetRR = 0;
        // start to receive data on the server's client socket...
        startReceive(gServerClientSocket, gServerTcpBuffer);
        // do more stuff on server to initialize the incoming accepted client...
        // welcome client.
        serverSend(gSERVER_REPLY_WELCOME, gServerClientSocket);
      }
    }
    else
    {
      writeLineEx( 1, 3, "S: OnTcpListen: Unexpected connection on socket %d. (result:%d)", socket, result);
      // handle error...
    }
  }
}

// ---------------------------------------------------
// When asynchronous TcpSend completes...
// ---------------------------------------------------
void OnTcpSend( dword socket, long result, char buffer[], dword size)
{
  writeLineEx(1, 1, " [ S: OnTcpSend called. (result: %d)]", result);
  if (result == 0)
  {
    if (socket != gINVALID_SOCKET)
    {
      if (socket == gServerClientSocket)
      {
        write("S: Server sent %d bytes to client done. (socket %d, result: %d)", size, socket, result);
        Socket_nvm = socket;
      }
    }
  }
}

// ---------------------------------------------------
// When receiving data on socket...
// ---------------------------------------------------
void OnTcpReceive( dword socket, long result, dword address, dword port, char buffer[], dword size)
{
  writeLineEx(1, 1, " [ S: OnTcpReceive called. (result: %d)]", result);
  if (result == 0)
  {
    if (socket == gServerClientSocket)
    {
      // server receives from client...
      write("S: Server received %d bytes from client: %s (result: %d)", size, buffer, result);
      DiagFuntionality(buffer);
      // check client's request...
      if (strstr(buffer, "REQUEST") >= 0)
      {
        write("S: Client request OK, sending answer.");
        serverSend(gSERVER_REPLY_ANSWER, gServerClientSocket); // answer
      }
      // continue receiving data.
      startReceive(gServerClientSocket, gServerTcpBuffer);
    }
    else if (socket != gINVALID_SOCKET)
    {
      writeLineEx(1, 3, " [ S: UNIMPLEMENTED: Received %d bytes on socket %d from 0x%x:%d with data: %s (result: %d) ]", size, socket, address, port, buffer, result);
    }
  }
}

// ---------------------------------------------------
// TCP socket receives a close notification
// (remote closed)
// ---------------------------------------------------
void OnTcpClose( dword socket, long result)
{
  if (socket == gServerClientSocket)
  {
    TcpClose(gServerClientSocket);
    gServerClientSocket = gINVALID_SOCKET;
    writeLineEx(1, 1, " [ S: OnTcpClose called. (socket: %d, result: %d) ]", socket, result);
  }
}

// ---------------------------------------------------
// server disconnects client
// ---------------------------------------------------
void serverDisconnectClient()
{
  if (gServerClientSocket != gINVALID_SOCKET)
  {
    write("S: Server disconnects client. (socket %d)", gServerClientSocket);
    TcpClose(gServerClientSocket);
    gServerClientSocket = gINVALID_SOCKET;
  }
}

// ---------------------------------------------------
// start receiving on given socket into given buffer.
// ---------------------------------------------------
void startReceive ( dword socket, char buffer[] )
{
  long result;
  result = TcpReceive( socket, buffer, elcount(buffer) );
  if (result == -1)
  {
    result = IpGetLastSocketError(socket);
    if (result != 997) // not asynchronous
    {
      // failure
      writeLineEx( 1, 3, "S: TcpReceive error %d", result);
    }
  }
  else if (result != 0) // synchronous sending failed
  {
    // failure
    writeLineEx( 1, 3, "S: TcpReceive error %d", result);
  }
}

// ---------------------------------------------------
// start server
// ---------------------------------------------------
void serverStart()
{
  writeLineEx(1, 1, " [ S: Open TCP server socket at port %d... ]", gListenPort);
  gListenSocket = TcpOpen(0, gListenPort);
  if (gListenSocket == gINVALID_SOCKET)
  {
    writeLineEx( 1, 3, " [ S: TcpOpen: Error opening TCP Socket on port %d. (Error %d) ]", gListenPort, IpGetLastError() );
    // handle error...
  }
  else
  {
    if (TcpListen( gListenSocket ) != 0)
    {
      writeLineEx(1, 3, " [ S: TcpListen: Error listening on socket. ]");
      TcpClose(gListenSocket);
      gListenSocket = gINVALID_SOCKET;
      // handle error...
    }
    else
    {
      writeLineEx(1, 1, " [ S: Start listening on server socket %d... ]", gListenSocket);
    }
  }
}

// ---------------------------------------------------
// close server
// ---------------------------------------------------
void serverClose()
{
  if (gListenSocket != gINVALID_SOCKET)
  {
    writeLineEx(1, 1, " [ Server shutdown. ]");
    serverDisconnectClient();
    TcpClose(gListenSocket);
    gListenSocket = gINVALID_SOCKET;
  }
}

// ---------------------------------------------------
// server sends data to client
// ---------------------------------------------------
void serverSend(int replyNr, dword socket)
{
  if (socket != gINVALID_SOCKET)
  {
    writeLineEx(1, 1, "S: Sending data to client. (socket %d)", socket);
    switch(replyNr)
    {
      case gSERVER_REPLY_WELCOME:
      {
        sendTcpData( socket, " Server data: WELCOME.");
      cancelTimer(DMRR_timer);
      cancelTimer(DMRL_timer);
      TargetRL = 0;
      TargetRR = 0;
      target = 0;
      DMRL_ACTIVE = 0;
      DMRR_ACTIVE = 0;
      TargOK = 0;
        break;
      }
      case gSERVER_REPLY_ANSWER:
      {
        sendTcpData(socket, "Server data: ANSWER.");
        break;
      }
      default:
      {
        writeLineEx(1, 3, " [ serverSend: UNSUPPORTED REPLY NR %d ]", replyNr);
        break;
      }
    }
  }
}

// ---------------------------------------------------
// send tcp data.
// ---------------------------------------------------
void sendTcpData( dword socket, char data[] )
{
  long result;
  dword size;
  size = elcount(data);
  result = TcpSend(socket, data, size);
  if (result == 0)
  {
    // sending took place immediately.
    writeLineEx(1, 1, " [ S: Synchronous sending: '%s' on socket %d ]", data, socket);
    OnTcpSend(socket, result, data, size); // trigger callback manually
  }
  else
  {
    if (result == -1)
    {
      result = IpGetLastSocketError(socket);
      if (result == 997)
      {
        // sending is done asynchronously.
        writeLineEx(1, 1, " [ S: Asynchronous sending: '%s' on socket %d ]", data, socket);
        // => OnTcpSend is called when done sending.
      }
      else
      {
        writeLineEx( 1, 3, " [ S: sendTcpData: Error sending data. (%d) ]", result);
        cancelTimer(DMRR_timer);
        cancelTimer(DMRL_timer);
        TargetRL = 0;
        TargetRR = 0;
        target = 0;
        DMRL_ACTIVE = 0;
        DMRR_ACTIVE = 0;
        TargOK = 0;
      }
    }
    else
    {
      writeLineEx( 1, 3, " [ S: sendTcpData: Error sending data. (%d) ]", result);
      cancelTimer(DMRR_timer);
      cancelTimer(DMRL_timer);
      TargetRL = 0;
      TargetRR = 0;
      target = 0;
      DMRL_ACTIVE = 0;
      DMRR_ACTIVE = 0;
      TargOK = 0;
    }
  }
}

void DiagFuntionality (char data[])
{ 
  if ((strncmp(data,"Read_info DMFL223", strlen(data)) == 0)||(strncmp(data,"Read_info DMFR223", strlen(data)) == 0)||(strncmp(data,"Read_info DMRL223", strlen(data)) == 0)||(strncmp(data,"Read_info DMRR223", strlen(data)) == 0))
    {     
      if ((strncmp(data,"Read_info DMRR223", strlen(data)) == 0))/*el target y el seleccionado son iguales¿?*/
      {
        if (TargetRR==1)
        {
          @LocalAuthentication::Button_Authenticate = 1;
          Cont = 0;
          //setTimer(DMRR_timer,3);
        }
        else 
        {
          sendTcpData(Socket_nvm, "Set_target ERROR Target not conected");
        }
      }
      if (strncmp(data,"Read_info DMRL223", strlen(data)) == 0)
      {
        if (TargetRL==1)
        {
          @LocalAuthentication::Button_Authenticate = 1;
          Cont = 0;
          //setTimer(DMRL_timer,3);
        }
        else 
        {
          sendTcpData(Socket_nvm, "Set_target ERROR Target not conected");
        }
      }
   } 
    
  if (strncmp(data,"Window_control DOWN", strlen(data)) == 0) 
    {
      if (DMRL_ACTIVE == 1)
      {
        diagRequest DMRL223.WL_Modellierte_Async_Routine_PWC_Window_Lift_Start req;
        req.SetParameter("WinLift_Rq", 1);
        DiagSendRequest(req);
        sendTcpData (Socket_nvm, "Action_type DOWN DMRL223 OK");
        write("Action_type_DOWN_DMRL OK");
      }
      else if (DMRR_ACTIVE == 1)
      {
      diagRequest DMRR223.WL_Modellierte_Async_Routine_PWC_Window_Lift_Start req;
      req.SetParameter("WinLift_Rq", 1);
      DiagSendRequest(req);
      sendTcpData (Socket_nvm, "Action_type DOWN DMRR223 OK");
      write("Action_type_DOWN_DMRR OK");
     }
      else
      {
        sendTcpData(Socket_nvm, "Set_target ERROR Target not conected");
      }
  }
  if (strncmp(data,"Window_control UP", strlen(data)) == 0) 
  {
    if (DMRL_ACTIVE == 1)
    {
      diagRequest DMRL223.WL_Modellierte_Async_Routine_PWC_Window_Lift_Start req;
      req.SetParameter("WinLift_Rq", 2);
      DiagSendRequest(req);
      sendTcpData (Socket_nvm, "Action_type UP DMRL223 OK");
      write("Action_type_UP_DMRL OK");
    }
    else if (DMRR_ACTIVE == 1)
    {
      diagRequest DMRR223.WL_Modellierte_Async_Routine_PWC_Window_Lift_Start req;
      req.SetParameter("WinLift_Rq", 2);
      DiagSendRequest(req );
      sendTcpData (Socket_nvm, "Action_type UP DMRR223 OK");
      write("Action_type_UP_DMRR OK");
    }
    else
    {
      sendTcpData(Socket_nvm, "Set_target ERROR Target not conected");
    }
  }
    if (strncmp(data,"Window_control STOP", strlen(data)) == 0) 
  {
    if (DMRL_ACTIVE == 1)
    {
      diagRequest DMRL223.WL_Modellierte_Async_Routine_PWC_Window_Lift_Stop req;
      DiagSendRequest(req);
      sendTcpData (Socket_nvm, "Action_type STOP DMRL223 OK");
      write("Action_type_STOP_DMRL OK");
    }
    else if (DMRR_ACTIVE == 1)
    {
      diagRequest DMRR223.WL_Modellierte_Async_Routine_PWC_Window_Lift_Stop req;
      DiagSendRequest(req );
      sendTcpData (Socket_nvm, "Action_type STOP DMRR223 OK");
      write("Action_type_STOP_DMRR OK");
    }
    else
    {
      sendTcpData(Socket_nvm, "Set_target ERROR Target not conected");
    }
  }

  if ((strncmp(data,"Read_info DMFL223", strlen(data)) != 0)&&(strncmp(data,"Read_info DMFR223", strlen(data)) != 0)&&(strncmp(data,"Read_info DMRL223", strlen(data)) != 0)&&(strncmp(data,"Read_info DMRR223", strlen(data)) != 0)&&(strncmp(data,"Window_control DOWN", strlen(data)) != 0)&&(strncmp(data,"Window_control UP", strlen(data)) != 0)&&(strncmp(data,"Window_control STOP", strlen(data)) != 0))//&&(strncmp(data,"DLK_IOControl UNLOCK", strlen(data)) != 0)&&(strncmp(data,"DLK_IOControl LOCK", strlen(data)) != 0))
  {
    sendTcpData (Socket_nvm, "Set_target ERROR Invalid Command");
  }
  
}

on sysvar LocalAuthentication::AuthResult
{
  if (@LocalAuthentication::AuthResult == 1)
  {
    //sendTcpData(Socket_nvm, "Authenticate OK");
    write("Set_target OK");
    TargOK = 1;
    Cont = 0;
    if (TargetRR==1)
    {
      setTimer(DMRR_timer,3);
	  }
    else if (TargetRL==1)
    {
      setTimer(DMRL_timer,3);
      write ("entra3");
    }
    else
    {
      sendTcpData(Socket_nvm, "Set_target ERROR Target not conected");
      write("Set_target ERROR Target not conected");
      target = 0;
    }
    @LocalAuthentication::AuthResult = 3;
    //@COMUNICATION::C= 1;
  }
  else if (@LocalAuthentication::AuthResult == 0)
  {
    sendTcpData(Socket_nvm, "Set_target ZenzefiError");
    write("Set_target ZenzefiError");
    target = 0;
  }
  else
  {
    /*no action*/
  }
}

on diagResponse *
{
  byte data[4096];
  long size;
  double param_value1=0xFF;
  double param_value2=0xFF;
  byte respon[20];
  char serialNumber[14];
  char stringResult[7];
  char nuevo_string[50];
  char myStringSW[50];
  char myStringHW[50];
  
  char totalVersions[50];

  int i;
  diagResponse * resp; // declare response with no concrete interpretation
  size=this.GetPrimitiveSize(); // get length of response
  this.GetPrimitiveData(data, elcount(data)); // copy actual response from "on diagResponse *" into data array
  switch(data[0])
  {
    case 0x62: // UDS: Read data identifier positive Response
      if ((data[1]==0xF1) && (data[2]==0x51))/*SW VERSION*/
      {
        totalVersions[0] = '\0';
        for (i = 0; i < 6; i++)
        {
          myStringSW[3*i] = (data[i+3]/10) + 0x30; 
          myStringSW[3*i+1] = (data[i+3]%10) + 0x30; 
          if (i == 2)
          {
            myStringSW[3*i+2] = ' ';  
          }
          else if(i != 5)
          {
            myStringSW[3*i+2] = '.';
          }
        }
        write("SW_version: %s", myStringSW);
        //sendTcpData(Socket_nvm, myStringSW);
        strncat(totalVersions, myStringSW, 50);
        strncat(totalVersions, ",", 50);
      }
      if ((data[1]==0xF1) && (data[2]==0x50))/*HW VERSION*/
      {        
        for (i = 0; i < 3; i++)
        {
          myStringHW[3*i] = (data[i+3]/10) + 0x30; 
          myStringHW[3*i+1] = (data[i+3]%10) + 0x30; 
          if(i != 2)
          {
            myStringHW[3*i+2] = '.';
          }
        }
        write("HW_version: %s", myStringHW);
        //sendTcpData(Socket_nvm, myStringHW);
        strncat(totalVersions, myStringHW, 50);
        strncat(totalVersions, ",", 50);
      }
      if ((data[1]==0xF1) && (data[2]==0x8C)) /*SERIAL NUMBER*/
      {
        for (i = 0; i<13; i++)
        {
          serialNumber[i] = data[i+3];
        }
        write("Serial Number: %s", serialNumber);
        //sendTcpData(Socket_nvm, serialNumber);
        strncat(totalVersions, serialNumber, 50);
        write("SW,HW,SN: %s", totalVersions);
        sendTcpData(Socket_nvm, totalVersions);
        //totalVersions[0] = '\0';
      }
      break;
    case 0x71: // UDS: EcuReset_Process positive Response
      
      break;
    default:
      break;
  }
}