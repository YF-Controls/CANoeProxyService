/* !Encoding: 65001  */
includes
{
  #include "__VariablesLib.cin"
  #include "__CaplGeneratorLib.cin"
  #include "__CANoeReportFuntionsLib.cin"
}

variables
{
  // Global variables defined within this CAPL file
}

void Tt0_SecTick_Synchronization()
{
  TestCommandBegin(__eSet, __cSet, "", "0");
  {
  
    __ReportTableHead3Columns(__cSetCaption , __cTSym, __cTOp, __cAssigned); 
    {
      @sysvarInt::`SeckTickSynchronization::`Button_SecTickCountSync = 1;
      __ReportTableRow(0, "System variable 'Button_SecTickCountSync'", __cAOp, 1, "");
    }
    __ReportTableEndTestStep("1");
  }
  TestCommandEnd();

  TestCommandBegin(__eWait, __cWait, "", "1");
  {
    __Wait("1", (500 * 1000000), 1000000, "");
  }
  TestCommandEnd();

  TestCommandBegin(__eSet, __cSet, "", "2");
  {
  
    __ReportTableHead3Columns(__cSetCaption , __cTSym, __cTOp, __cAssigned); 
    {
      @sysvarInt::`SeckTickSynchronization::`Button_SecTickCountSync = 0;
      __ReportTableRow(0, "System variable 'Button_SecTickCountSync'", __cAOp, 0, "");
    }
    __ReportTableEndTestStep("1");
  }
  TestCommandEnd();

  TestCommandBegin(__eAwaitValueMatch, __cAwaitValueMatch, "", "3");
  {
  
    int64 __time;
    long __setFailed;
    __setFailed = 0;
    __time = 15 * 1000000000;
    if (__time < 0)
    {
      testStepErrorInTestSystem(0, "1", "Unable to wait for %.3f %s. Please check input parameter.", __time / ((float)1000000000), "s");
    }
    else
    {
      snprintf(__cArray, elCount(__cArray), "System variable '%s'", "LED_Sync_Result");
      __setFailed |= testJoinSignal(sysvarInt::`SeckTickSynchronization::`LED_Sync_Result, "__tt0Callback0", __cArray) < 0;
      if (__setFailed != 0)
      {
        testStepErrorInTestSystem(0, "1", "Unable to set value condition.");
      }
      else
      {
        if (testWaitForAllJoinedEventsNS(__time) > 0)
        {
          testStepPass(2, "1", "Waited for occurrence of 1 value condition.");
        }
        else
        {
          testStepFail(0, "1", "Waited for occurrence of 1 value condition.");
        }
        __ReportTableHead5Columns(__cEmpty, __cTSym, __cTOp, __cRefVal, __cActual, __cRes);
        __csr = CheckSignalMatch(sysvarInt::`SeckTickSynchronization::`LED_Sync_Result, 1, "==") == 1;
        __ReportTableRow(0, "System variable 'LED_Sync_Result'", "==", 1, "");
        __ReportCell(sysvarInt::`SeckTickSynchronization::`LED_Sync_Result);
        __ReportCellResult(__csr, __ePassFail);
        __ReportTableEndTestStep(__cEmpty);
      }
    }
  }
  TestCommandEnd();

  TestCommandBegin(__eWait, __cWait, "", "4");
  {
    __Wait("1", (2 * 1000000000), 1000000000, "");
  }
  TestCommandEnd();

}

dword __tt0Callback0(sysvarInt * __cbParam)
{

  __csr = CheckSignalMatch(__cbParam, 1, "==") == 1;
  return __csr;
}

testcase Tt0_Driver_side_mirror_selection_adjustment(int64 iteration, int64 CSL_actuation_TimerMS)
{
  SetBreakOnFail(0);

  TestPreparationBegin();
  {
    TestCommandBegin(__eSet, __cSet, "", "0");
    {
    
      __ReportTableHead3Columns(__cSetCaption , __cTSym, __cTOp, __cAssigned); 
      {
        $`BODY1::dbNode::`BC_F::`BC_F_BODY1_GW_Container_ST3_ExtMirr_Settings_ST3::`MirrFldPk_Rq_ST3.phys = 1;
        __ReportSignalSetLValue("PDU signal 'MirrFldPk_Rq_ST3'", `BODY1::dbNode::`BC_F::`BC_F_BODY1_GW_Container_ST3_ExtMirr_Settings_ST3::`MirrFldPk_Rq_ST3, __cArray);
        __ReportTableRow(0, __cArray, __cAOp, 1, "I_C02_OFF_ON_ON");
      }
      __ReportTableEndTestStep("1");
    }
    TestCommandEnd();

    TestCommandBegin(__eWait, __cWait, "", "1");
    {
      __Wait("1", (2 * 1000000000), 1000000000, "");
    }
    TestCommandEnd();

  }
  TestPreparationEnd();

  TestCommandBegin(__eReport, __cReport, __cEmpty, "2");
  {
    __ReportTableHead2Columns("Mirror glass position status", __cTSym, __cValue);
    __ReportSignal("PDU signal 'MirrPosnX_D_ActualPosn_ST3'", `BODY1::dbNode::`DM_FL::`DM_BODY1_ContainerExtMirrMaster_ST3_ExtMirr_Master_Stat_ST3::`MirrPosnX_D_ActualPosn_ST3, __cArray, 0 );
    testInfoRow(__tableHandle, 0, __cArray);
    __ReportCell(`BODY1::dbNode::`DM_FL::`DM_BODY1_ContainerExtMirrMaster_ST3_ExtMirr_Master_Stat_ST3::`MirrPosnX_D_ActualPosn_ST3);
    __ReportSignal("PDU signal 'MirrPosnY_D_ActualPosn_ST3'", `BODY1::dbNode::`DM_FL::`DM_BODY1_ContainerExtMirrMaster_ST3_ExtMirr_Master_Stat_ST3::`MirrPosnY_D_ActualPosn_ST3, __cArray, 0 );
    testInfoRow(__tableHandle, 0, __cArray);
    __ReportCell(`BODY1::dbNode::`DM_FL::`DM_BODY1_ContainerExtMirrMaster_ST3_ExtMirr_Master_Stat_ST3::`MirrPosnY_D_ActualPosn_ST3);
    __ReportTableEndTestStep(__cEmpty);
  }
  TestCommandEnd();

  TestCommandBegin(__eSet, __cSet, "", "3");
  {
  
    __ReportTableHead3Columns(__cSetCaption , __cTSym, __cTOp, __cAssigned); 
    {
      $`LinDB::dbNode::`DSM_WM_DOOR::`DSM_WM_Frm1_AR_DOOR::`MirrSelLtSw_Psd_DOOR.phys = 1;
      __ReportSignalSetLValue("LIN signal 'MirrSelLtSw_Psd_DOOR'", `LinDB::dbNode::`DSM_WM_DOOR::`DSM_WM_Frm1_AR_DOOR::`MirrSelLtSw_Psd_DOOR, __cArray);
      __ReportTableRow(0, __cArray, __cAOp, 1, "");
    }
    __ReportTableEndTestStep("1");
  }
  TestCommandEnd();

  TestCommandBegin(__eWait, __cWait, "", "4");
  {
    __Wait("1", (300 * 1000000), 1000000, "");
  }
  TestCommandEnd();

  TestCommandBegin(__eCheck, __cCheck, "", "5");
  {
    __bVerdict = __eVerdictPass;
    __ReportTableHead5Columns(__cCheckCaption, __cTSym, __cTOp, __cRefVal, __cActual, __cRes);
    {
      __csr = CheckSignalMatch(`BODY1::dbNode::`DM_FL::`DM_FL_BODY1_Container1_ST3_ExtMirr_FL_Stat_ST3::`MirrAdj_LHD_Sel_Stat_ST3, 1, "==") == 1;
      __ReportTableRow(0, "PDU signal 'MirrAdj_LHD_Sel_Stat_ST3'", "==", 1, "I_C02_MIRRADJSW_STAT_DRV");
      __ReportCell(`BODY1::dbNode::`DM_FL::`DM_FL_BODY1_Container1_ST3_ExtMirr_FL_Stat_ST3::`MirrAdj_LHD_Sel_Stat_ST3);
      __ReportCellResult(__csr, __ePassFail);
      __bVerdict = __bVerdict && __csr;
    }
    __ReportTableEndVerdict("1", __bVerdict);
  }
  TestCommandEnd();

  TestCommandBegin(__eWait, __cWait, "", "6");
  {
    __Wait("1", (100 * 1000000), 1000000, "");
  }
  TestCommandEnd();

  TestCommandBegin(__eSet, __cSet, "", "7");
  {
  
    __ReportTableHead3Columns(__cSetCaption , __cTSym, __cTOp, __cAssigned); 
    {
      $`LinDB::dbNode::`DSM_WM_DOOR::`DSM_WM_Frm1_AR_DOOR::`MirrAdjDnSw_Psd_DOOR.phys = 1;
      __ReportSignalSetLValue("LIN signal 'MirrAdjDnSw_Psd_DOOR'", `LinDB::dbNode::`DSM_WM_DOOR::`DSM_WM_Frm1_AR_DOOR::`MirrAdjDnSw_Psd_DOOR, __cArray);
      __ReportTableRow(0, __cArray, __cAOp, 1, "");
    }
    __ReportTableEndTestStep("1");
  }
  TestCommandEnd();

  TestCommandBegin(__eWait, __cWait, "", "8");
  {
    __Wait("1", (2 * 1000000000), 1000000000, "");
  }
  TestCommandEnd();

  TestCommandBegin(__eSet, __cSet, "", "9");
  {
  
    __ReportTableHead3Columns(__cSetCaption , __cTSym, __cTOp, __cAssigned); 
    {
      $`LinDB::dbNode::`DSM_WM_DOOR::`DSM_WM_Frm1_AR_DOOR::`MirrAdjRtSw_Psd_DOOR.phys = 1;
      __ReportSignalSetLValue("LIN signal 'MirrAdjRtSw_Psd_DOOR'", `LinDB::dbNode::`DSM_WM_DOOR::`DSM_WM_Frm1_AR_DOOR::`MirrAdjRtSw_Psd_DOOR, __cArray);
      __ReportTableRow(0, __cArray, __cAOp, 1, "");
    }
    __ReportTableEndTestStep("1");
  }
  TestCommandEnd();

  TestCommandBegin(__eWait, __cWait, "", "10");
  {
    __Wait("1", (2 * 1000000000), 1000000000, "");
  }
  TestCommandEnd();

  TestCommandBegin(__eSet, __cSet, "", "11");
  {
  
    __ReportTableHead3Columns(__cSetCaption , __cTSym, __cTOp, __cAssigned); 
    {
      $`LinDB::dbNode::`DSM_WM_DOOR::`DSM_WM_Frm1_AR_DOOR::`MirrAdjLtSw_Psd_DOOR.phys = 1;
      __ReportSignalSetLValue("LIN signal 'MirrAdjLtSw_Psd_DOOR'", `LinDB::dbNode::`DSM_WM_DOOR::`DSM_WM_Frm1_AR_DOOR::`MirrAdjLtSw_Psd_DOOR, __cArray);
      __ReportTableRow(0, __cArray, __cAOp, 1, "");
    }
    __ReportTableEndTestStep("1");
  }
  TestCommandEnd();

  TestCommandBegin(__eWait, __cWait, "", "12");
  {
    __Wait("1", (2 * 1000000000), 1000000000, "");
  }
  TestCommandEnd();

  TestCommandBegin(__eSet, __cSet, "", "13");
  {
  
    __ReportTableHead3Columns(__cSetCaption , __cTSym, __cTOp, __cAssigned); 
    {
      $`LinDB::dbNode::`DSM_WM_DOOR::`DSM_WM_Frm1_AR_DOOR::`MirrAdjUpSw_Psd_DOOR.phys = 1;
      __ReportSignalSetLValue("LIN signal 'MirrAdjUpSw_Psd_DOOR'", `LinDB::dbNode::`DSM_WM_DOOR::`DSM_WM_Frm1_AR_DOOR::`MirrAdjUpSw_Psd_DOOR, __cArray);
      __ReportTableRow(0, __cArray, __cAOp, 1, "");
    }
    __ReportTableEndTestStep("1");
  }
  TestCommandEnd();

  TestCommandBegin(__eWait, __cWait, "", "14");
  {
    __Wait("1", (2 * 1000000000), 1000000000, "");
  }
  TestCommandEnd();

  TestCommandBegin(__eWait, __cWait, "", "15");
  {
    __Wait("1", (500 * 1000000), 1000000, "");
  }
  TestCommandEnd();

  TestCommandBegin(__eReport, __cReport, __cEmpty, "16");
  {
    __ReportTableHead2Columns("Mirror glass position status", __cTSym, __cValue);
    __ReportSignal("PDU signal 'MirrPosnX_D_ActualPosn_ST3'", `BODY1::dbNode::`DM_FL::`DM_BODY1_ContainerExtMirrMaster_ST3_ExtMirr_Master_Stat_ST3::`MirrPosnX_D_ActualPosn_ST3, __cArray, 0 );
    testInfoRow(__tableHandle, 0, __cArray);
    __ReportCell(`BODY1::dbNode::`DM_FL::`DM_BODY1_ContainerExtMirrMaster_ST3_ExtMirr_Master_Stat_ST3::`MirrPosnX_D_ActualPosn_ST3);
    __ReportSignal("PDU signal 'MirrPosnY_D_ActualPosn_ST3'", `BODY1::dbNode::`DM_FL::`DM_BODY1_ContainerExtMirrMaster_ST3_ExtMirr_Master_Stat_ST3::`MirrPosnY_D_ActualPosn_ST3, __cArray, 0 );
    testInfoRow(__tableHandle, 0, __cArray);
    __ReportCell(`BODY1::dbNode::`DM_FL::`DM_BODY1_ContainerExtMirrMaster_ST3_ExtMirr_Master_Stat_ST3::`MirrPosnY_D_ActualPosn_ST3);
    __ReportTableEndTestStep(__cEmpty);
  }
  TestCommandEnd();

  TestCommandBegin(__eWait, __cWait, "", "18");
  {
    __Wait("1", (2 * 1000000000), 1000000000, "");
  }
  TestCommandEnd();

  TestCommandBegin(__eSet, __cSet, "", "20");
  {
  
    __ReportTableHead3Columns(__cSetCaption , __cTSym, __cTOp, __cAssigned); 
    {
      $`BODY1::dbNode::`BC_F::`BC_F_BODY1_GW_Container_ST3_Ign_Stat_ST3::`ISw_Stat_ST3.phys = 0;
      __ReportSignalSetLValue("PDU signal 'ISw_Stat_ST3'", `BODY1::dbNode::`BC_F::`BC_F_BODY1_GW_Container_ST3_Ign_Stat_ST3::`ISw_Stat_ST3, __cArray);
      __ReportTableRow(0, __cArray, __cAOp, 0, "I_C03_ISW_STAT_IGN_LOCK");
    }
    __ReportTableEndTestStep("1");
  }
  TestCommandEnd();

  TestCommandBegin(__eWait, __cWait, "", "21");
  {
    __Wait("1", (2 * 1000000000), 1000000000, "");
  }
  TestCommandEnd();

  TestCommandBegin(__eSet, __cSet, "", "22");
  {
  
    __ReportTableHead3Columns(__cSetCaption , __cTSym, __cTOp, __cAssigned); 
    {
      $`BODY1::dbNode::`BC_F::`BC_F_BODY1_GW_Container_ST3_CLkS_Dr_State_ST3::`DrRLtch_FL_Stat_ST3.phys = 1;
      __ReportSignalSetLValue("PDU signal 'DrRLtch_FL_Stat_ST3'", `BODY1::dbNode::`BC_F::`BC_F_BODY1_GW_Container_ST3_CLkS_Dr_State_ST3::`DrRLtch_FL_Stat_ST3, __cArray);
      __ReportTableRow(0, __cArray, __cAOp, 1, "I_C02_DR_STAT_CLS");
    }
    {
      $`BODY1::dbNode::`BC_F::`BC_F_BODY1_GW_Container_ST3_CLkS_Dr_State_ST3::`DrRLtch_FR_Stat_ST3.phys = 1;
      __ReportSignalSetLValue("PDU signal 'DrRLtch_FR_Stat_ST3'", `BODY1::dbNode::`BC_F::`BC_F_BODY1_GW_Container_ST3_CLkS_Dr_State_ST3::`DrRLtch_FR_Stat_ST3, __cArray);
      __ReportTableRow(0, __cArray, __cAOp, 1, "I_C02_DR_STAT_CLS");
    }
    {
      $`BODY1::dbNode::`BC_F::`BC_F_BODY1_GW_Container_ST3_CLkS_Dr_State_ST3::`DrRLtch_RL_Stat_ST3.phys = 1;
      __ReportSignalSetLValue("PDU signal 'DrRLtch_RL_Stat_ST3'", `BODY1::dbNode::`BC_F::`BC_F_BODY1_GW_Container_ST3_CLkS_Dr_State_ST3::`DrRLtch_RL_Stat_ST3, __cArray);
      __ReportTableRow(0, __cArray, __cAOp, 1, "I_C02_DR_STAT_CLS");
    }
    {
      $`BODY1::dbNode::`BC_F::`BC_F_BODY1_GW_Container_ST3_CLkS_Dr_State_ST3::`DrRLtch_RR_Stat_ST3.phys = 1;
      __ReportSignalSetLValue("PDU signal 'DrRLtch_RR_Stat_ST3'", `BODY1::dbNode::`BC_F::`BC_F_BODY1_GW_Container_ST3_CLkS_Dr_State_ST3::`DrRLtch_RR_Stat_ST3, __cArray);
      __ReportTableRow(0, __cArray, __cAOp, 1, "I_C02_DR_STAT_CLS");
    }
    __ReportTableEndTestStep("1");
  }
  TestCommandEnd();

  TestCommandBegin(__eWait, __cWait, "", "23");
  {
    __Wait("1", (2 * 1000000000), 1000000000, "");
  }
  TestCommandEnd();

  TestCommandBegin(__eSet, __cSet, "", "25");
  {
  
    __ReportTableHead3Columns(__cSetCaption , __cTSym, __cTOp, __cAssigned); 
    {
      $`BODY1::dbNode::`EIS_BASE::`EIS_BODY1_Container_ST3_CLkS_Rq_ST3::`CLkS_Ext_Rq_ST3.phys = 1;
      __ReportSignalSetLValue("PDU signal 'CLkS_Ext_Rq_ST3'", `BODY1::dbNode::`EIS_BASE::`EIS_BODY1_Container_ST3_CLkS_Rq_ST3::`CLkS_Ext_Rq_ST3, __cArray);
      __ReportTableRow(0, __cArray, __cAOp, 1, "I_C02_CLKS_RQ_SNA_3H_LK");
    }
    __ReportTableEndTestStep("1");
  }
  TestCommandEnd();

  TestCommandBegin(__eAwaitValueMatch, __cAwaitValueMatch, "", "27");
  {
  
    dword __signalTimes[1];
    int64 __time;
    long __setFailed;
    __setFailed = 0;
    __time = 8 * 1000000000;
    if (__time < 0)
    {
      testStepErrorInTestSystem(0, "1", "Unable to wait for %.3f %s. Please check input parameter.", __time / ((float)1000000000), "s");
    }
    else
    {
      __signalTimes[0] = getSignalTime(`BODY1::dbNode::`DM_FL::`DM_FL_BODY1_Container1_ST3_ExtMirr_FL_Stat_ST3::`MirrAdj_LHD_Fold_Stat_ST3);
      snprintf(__cArray, elCount(__cArray), "PDU signal '%s'", "MirrAdj_LHD_Fold_Stat_ST3");
      __setFailed |= testJoinSignal(`BODY1::dbNode::`DM_FL::`DM_FL_BODY1_Container1_ST3_ExtMirr_FL_Stat_ST3::`MirrAdj_LHD_Fold_Stat_ST3, "__tt0Callback1", __cArray, 1) < 0;
      if (__setFailed != 0)
      {
        testStepErrorInTestSystem(0, "1", "Unable to set value condition.");
      }
      else
      {
        int64 __occurrenceTime;
        if (testWaitForAllJoinedEventsNS(__time) > 0)
        {
          testStepPass(2, "1", "Waited for occurrence of 1 value condition and signal updates.");
        }
        else
        {
          testStepFail(0, "1", "Waited for occurrence of 1 value condition and signal updates.");
        }
        __ReportTableHead6Columns(__cEmpty, __cTSym, __cTOp, __cRefVal, __cActual, __cEmpty, __cRes);
        __csr = CheckSignalMatch(`BODY1::dbNode::`DM_FL::`DM_FL_BODY1_Container1_ST3_ExtMirr_FL_Stat_ST3::`MirrAdj_LHD_Fold_Stat_ST3, 3, "==") == 1;
        __ReportTableRow(0, "PDU signal 'MirrAdj_LHD_Fold_Stat_ST3'", "==", 3, "I_C03_MIRRFLD_STAT_FOLD_IN");
        __ReportCell(`BODY1::dbNode::`DM_FL::`DM_FL_BODY1_Container1_ST3_ExtMirr_FL_Stat_ST3::`MirrAdj_LHD_Fold_Stat_ST3);
        
        {
          dword __signalTime;
          __signalTime = getSignalTime(`BODY1::dbNode::`DM_FL::`DM_FL_BODY1_Container1_ST3_ExtMirr_FL_Stat_ST3::`MirrAdj_LHD_Fold_Stat_ST3);
          if (__signalTime > __signalTimes[0])
          {
            __ReportCell(__cEmpty);
          }
          else
          {
            __ReportCell("(no update)");
            __csr = 0;
          }
        }
        __ReportCellResult(__csr, __ePassFail);
        __ReportTableEndTestStep(__cEmpty);
      }
    }
  }
  TestCommandEnd();

  TestCommandBegin(__eAwaitValueMatch, __cAwaitValueMatch, "", "28");
  {
  
    dword __signalTimes[1];
    int64 __time;
    long __setFailed;
    __setFailed = 0;
    __time = 4.5 * 1000000000;
    if (__time < 0)
    {
      testStepErrorInTestSystem(0, "1", "Unable to wait for %.3f %s. Please check input parameter.", __time / ((float)1000000000), "s");
    }
    else
    {
      __signalTimes[0] = getSignalTime(`BODY1::dbNode::`DM_FL::`DM_FL_BODY1_Container1_ST3_ExtMirr_FL_Stat_ST3::`MirrAdj_LHD_Fold_Stat_ST3);
      snprintf(__cArray, elCount(__cArray), "PDU signal '%s'", "MirrAdj_LHD_Fold_Stat_ST3");
      __setFailed |= testJoinSignal(`BODY1::dbNode::`DM_FL::`DM_FL_BODY1_Container1_ST3_ExtMirr_FL_Stat_ST3::`MirrAdj_LHD_Fold_Stat_ST3, "__tt0Callback2", __cArray, 1) < 0;
      if (__setFailed != 0)
      {
        testStepErrorInTestSystem(0, "1", "Unable to set value condition.");
      }
      else
      {
        int64 __occurrenceTime;
        if (testWaitForAllJoinedEventsNS(__time) > 0)
        {
          testStepPass(2, "1", "Waited for occurrence of 1 value condition and signal updates.");
        }
        else
        {
          testStepFail(0, "1", "Waited for occurrence of 1 value condition and signal updates.");
        }
        __ReportTableHead6Columns(__cEmpty, __cTSym, __cTOp, __cRefVal, __cActual, __cEmpty, __cRes);
        __csr = CheckSignalMatch(`BODY1::dbNode::`DM_FL::`DM_FL_BODY1_Container1_ST3_ExtMirr_FL_Stat_ST3::`MirrAdj_LHD_Fold_Stat_ST3, 1, "==") == 1;
        __ReportTableRow(0, "PDU signal 'MirrAdj_LHD_Fold_Stat_ST3'", "==", 1, "I_C03_MIRRFLD_STAT_FOLDED");
        __ReportCell(`BODY1::dbNode::`DM_FL::`DM_FL_BODY1_Container1_ST3_ExtMirr_FL_Stat_ST3::`MirrAdj_LHD_Fold_Stat_ST3);
        
        {
          dword __signalTime;
          __signalTime = getSignalTime(`BODY1::dbNode::`DM_FL::`DM_FL_BODY1_Container1_ST3_ExtMirr_FL_Stat_ST3::`MirrAdj_LHD_Fold_Stat_ST3);
          if (__signalTime > __signalTimes[0])
          {
            __ReportCell(__cEmpty);
          }
          else
          {
            __ReportCell("(no update)");
            __csr = 0;
          }
        }
        __ReportCellResult(__csr, __ePassFail);
        __ReportTableEndTestStep(__cEmpty);
      }
    }
  }
  TestCommandEnd();

  TestCommandBegin(__eWait, __cWait, "", "29");
  {
    __Wait("1", (1800 * 1000000000), 1000000000, "");
  }
  TestCommandEnd();

  TestCommandBegin(__eSet, __cSet, "", "31");
  {
  
    __ReportTableHead3Columns(__cSetCaption , __cTSym, __cTOp, __cAssigned); 
    {
      $`BODY1::dbNode::`EIS_BASE::`EIS_BODY1_Container_ST3_CLkS_Rq_ST3::`CLkS_Ext_Rq_ST3.phys = 2;
      __ReportSignalSetLValue("PDU signal 'CLkS_Ext_Rq_ST3'", `BODY1::dbNode::`EIS_BASE::`EIS_BODY1_Container_ST3_CLkS_Rq_ST3::`CLkS_Ext_Rq_ST3, __cArray);
      __ReportTableRow(0, __cArray, __cAOp, 2, "I_C02_CLKS_RQ_SNA_3H_UNLK");
    }
    __ReportTableEndTestStep("1");
  }
  TestCommandEnd();

  TestCommandBegin(__eAwaitValueMatch, __cAwaitValueMatch, "", "33");
  {
  
    dword __signalTimes[1];
    int64 __time;
    long __setFailed;
    __setFailed = 0;
    __time = 8 * 1000000000;
    if (__time < 0)
    {
      testStepErrorInTestSystem(0, "1", "Unable to wait for %.3f %s. Please check input parameter.", __time / ((float)1000000000), "s");
    }
    else
    {
      __signalTimes[0] = getSignalTime(`BODY1::dbNode::`DM_FL::`DM_FL_BODY1_Container1_ST3_ExtMirr_FL_Stat_ST3::`MirrAdj_LHD_Fold_Stat_ST3);
      snprintf(__cArray, elCount(__cArray), "PDU signal '%s'", "MirrAdj_LHD_Fold_Stat_ST3");
      __setFailed |= testJoinSignal(`BODY1::dbNode::`DM_FL::`DM_FL_BODY1_Container1_ST3_ExtMirr_FL_Stat_ST3::`MirrAdj_LHD_Fold_Stat_ST3, "__tt0Callback3", __cArray, 1) < 0;
      if (__setFailed != 0)
      {
        testStepErrorInTestSystem(0, "1", "Unable to set value condition.");
      }
      else
      {
        int64 __occurrenceTime;
        if (testWaitForAllJoinedEventsNS(__time) > 0)
        {
          testStepPass(2, "1", "Waited for occurrence of 1 value condition and signal updates.");
        }
        else
        {
          testStepFail(0, "1", "Waited for occurrence of 1 value condition and signal updates.");
        }
        __ReportTableHead6Columns(__cEmpty, __cTSym, __cTOp, __cRefVal, __cActual, __cEmpty, __cRes);
        __csr = CheckSignalMatch(`BODY1::dbNode::`DM_FL::`DM_FL_BODY1_Container1_ST3_ExtMirr_FL_Stat_ST3::`MirrAdj_LHD_Fold_Stat_ST3, 4, "==") == 1;
        __ReportTableRow(0, "PDU signal 'MirrAdj_LHD_Fold_Stat_ST3'", "==", 4, "I_C03_MIRRFLD_STAT_FOLD_OUT");
        __ReportCell(`BODY1::dbNode::`DM_FL::`DM_FL_BODY1_Container1_ST3_ExtMirr_FL_Stat_ST3::`MirrAdj_LHD_Fold_Stat_ST3);
        
        {
          dword __signalTime;
          __signalTime = getSignalTime(`BODY1::dbNode::`DM_FL::`DM_FL_BODY1_Container1_ST3_ExtMirr_FL_Stat_ST3::`MirrAdj_LHD_Fold_Stat_ST3);
          if (__signalTime > __signalTimes[0])
          {
            __ReportCell(__cEmpty);
          }
          else
          {
            __ReportCell("(no update)");
            __csr = 0;
          }
        }
        __ReportCellResult(__csr, __ePassFail);
        __ReportTableEndTestStep(__cEmpty);
      }
    }
  }
  TestCommandEnd();

  TestCommandBegin(__eAwaitValueMatch, __cAwaitValueMatch, "", "34");
  {
  
    dword __signalTimes[1];
    int64 __time;
    long __setFailed;
    __setFailed = 0;
    __time = 4.5 * 1000000000;
    if (__time < 0)
    {
      testStepErrorInTestSystem(0, "1", "Unable to wait for %.3f %s. Please check input parameter.", __time / ((float)1000000000), "s");
    }
    else
    {
      __signalTimes[0] = getSignalTime(`BODY1::dbNode::`DM_FL::`DM_FL_BODY1_Container1_ST3_ExtMirr_FL_Stat_ST3::`MirrAdj_LHD_Fold_Stat_ST3);
      snprintf(__cArray, elCount(__cArray), "PDU signal '%s'", "MirrAdj_LHD_Fold_Stat_ST3");
      __setFailed |= testJoinSignal(`BODY1::dbNode::`DM_FL::`DM_FL_BODY1_Container1_ST3_ExtMirr_FL_Stat_ST3::`MirrAdj_LHD_Fold_Stat_ST3, "__tt0Callback4", __cArray, 1) < 0;
      if (__setFailed != 0)
      {
        testStepErrorInTestSystem(0, "1", "Unable to set value condition.");
      }
      else
      {
        int64 __occurrenceTime;
        if (testWaitForAllJoinedEventsNS(__time) > 0)
        {
          testStepPass(2, "1", "Waited for occurrence of 1 value condition and signal updates.");
        }
        else
        {
          testStepFail(0, "1", "Waited for occurrence of 1 value condition and signal updates.");
        }
        __ReportTableHead6Columns(__cEmpty, __cTSym, __cTOp, __cRefVal, __cActual, __cEmpty, __cRes);
        __csr = CheckSignalMatch(`BODY1::dbNode::`DM_FL::`DM_FL_BODY1_Container1_ST3_ExtMirr_FL_Stat_ST3::`MirrAdj_LHD_Fold_Stat_ST3, 2, "==") == 1;
        __ReportTableRow(0, "PDU signal 'MirrAdj_LHD_Fold_Stat_ST3'", "==", 2, "I_C03_MIRRFLD_STAT_UNFOLDED");
        __ReportCell(`BODY1::dbNode::`DM_FL::`DM_FL_BODY1_Container1_ST3_ExtMirr_FL_Stat_ST3::`MirrAdj_LHD_Fold_Stat_ST3);
        
        {
          dword __signalTime;
          __signalTime = getSignalTime(`BODY1::dbNode::`DM_FL::`DM_FL_BODY1_Container1_ST3_ExtMirr_FL_Stat_ST3::`MirrAdj_LHD_Fold_Stat_ST3);
          if (__signalTime > __signalTimes[0])
          {
            __ReportCell(__cEmpty);
          }
          else
          {
            __ReportCell("(no update)");
            __csr = 0;
          }
        }
        __ReportCellResult(__csr, __ePassFail);
        __ReportTableEndTestStep(__cEmpty);
      }
    }
  }
  TestCommandEnd();

  TestCommandBegin(__eWait, __cWait, "", "35");
  {
    __Wait("1", (2 * 1000000000), 1000000000, "");
  }
  TestCommandEnd();

  TestCommandBegin(__eSet, __cSet, "", "37");
  {
  
    __ReportTableHead3Columns(__cSetCaption , __cTSym, __cTOp, __cAssigned); 
    {
      $`LinDB::dbNode::`DSM_WM_DOOR::`DSM_WM_Frm1_AR_DOOR::`MirrAdjUpSw_Psd_DOOR.phys = 0;
      __ReportSignalSetLValue("LIN signal 'MirrAdjUpSw_Psd_DOOR'", `LinDB::dbNode::`DSM_WM_DOOR::`DSM_WM_Frm1_AR_DOOR::`MirrAdjUpSw_Psd_DOOR, __cArray);
      __ReportTableRow(0, __cArray, __cAOp, 0, "");
    }
    __ReportTableEndTestStep("1");
  }
  TestCommandEnd();

  TestCommandBegin(__eWait, __cWait, "", "38");
  {
    __Wait("1", (300 * 1000000), 1000000, "");
  }
  TestCommandEnd();

  TestCommandBegin(__eSet, __cSet, "", "39");
  {
  
    __ReportTableHead3Columns(__cSetCaption , __cTSym, __cTOp, __cAssigned); 
    {
      $`BODY1::dbNode::`BC_F::`BC_F_BODY1_GW_Container_ST3_Ign_Stat_ST3::`ISw_Stat_ST3.phys = 4;
      __ReportSignalSetLValue("PDU signal 'ISw_Stat_ST3'", `BODY1::dbNode::`BC_F::`BC_F_BODY1_GW_Container_ST3_Ign_Stat_ST3::`ISw_Stat_ST3, __cArray);
      __ReportTableRow(0, __cArray, __cAOp, 4, "I_C03_ISW_STAT_IGN_ON");
    }
    __ReportTableEndTestStep("1");
  }
  TestCommandEnd();

  TestCommandBegin(__eWait, __cWait, "", "40");
  {
    __Wait("1", (2 * 1000000000), 1000000000, "");
  }
  TestCommandEnd();

  TestCommandBegin(__eSet, __cSet, "", "41");
  {
  
    __ReportTableHead3Columns(__cSetCaption , __cTSym, __cTOp, __cAssigned); 
    {
      $`LinDB::dbNode::`DSM_WM_DOOR::`DSM_WM_Frm1_AR_DOOR::`MirrSelLtSw_Psd_DOOR.phys = 0;
      __ReportSignalSetLValue("LIN signal 'MirrSelLtSw_Psd_DOOR'", `LinDB::dbNode::`DSM_WM_DOOR::`DSM_WM_Frm1_AR_DOOR::`MirrSelLtSw_Psd_DOOR, __cArray);
      __ReportTableRow(0, __cArray, __cAOp, 0, "");
    }
    __ReportTableEndTestStep("1");
  }
  TestCommandEnd();

}

dword __tt0Callback1(signal * __cbParam)
{

  __csr = CheckSignalMatch(__cbParam, 3, "==") == 1;
  return __csr;
}
dword __tt0Callback2(signal * __cbParam)
{

  __csr = CheckSignalMatch(__cbParam, 1, "==") == 1;
  return __csr;
}
dword __tt0Callback3(signal * __cbParam)
{

  __csr = CheckSignalMatch(__cbParam, 4, "==") == 1;
  return __csr;
}
dword __tt0Callback4(signal * __cbParam)
{

  __csr = CheckSignalMatch(__cbParam, 2, "==") == 1;
  return __csr;
}

testcase Tt0_Driver_side_mirror_selection(int64 iteration, int64 CSL_actuation_TimerMS)
{
  int64 __ifExec0;

  SetBreakOnFail(0);

  TestPreparationBegin();
  {
    TestCommandBegin(__eSet, __cSet, "", "0");
    {
    
      __ReportTableHead3Columns(__cSetCaption , __cTSym, __cTOp, __cAssigned); 
      {
        $`BODY1::dbNode::`BC_F::`BC_F_BODY1_GW_Container_ST3_ExtMirr_Settings_ST3::`MirrFldPk_Rq_ST3.phys = 1;
        __ReportSignalSetLValue("PDU signal 'MirrFldPk_Rq_ST3'", `BODY1::dbNode::`BC_F::`BC_F_BODY1_GW_Container_ST3_ExtMirr_Settings_ST3::`MirrFldPk_Rq_ST3, __cArray);
        __ReportTableRow(0, __cArray, __cAOp, 1, "I_C02_OFF_ON_ON");
      }
      __ReportTableEndTestStep("1");
    }
    TestCommandEnd();

    TestCommandBegin(__eWait, __cWait, "", "1");
    {
      __Wait("1", (2 * 1000000000), 1000000000, "");
    }
    TestCommandEnd();

  }
  TestPreparationEnd();

  TestCommandBegin(__eReport, __cReport, __cEmpty, "2");
  {
    __ReportTableHead2Columns("Mirror glass position status", __cTSym, __cValue);
    __ReportSignal("PDU signal 'MirrPosnX_D_ActualPosn_ST3'", `BODY1::dbNode::`DM_FL::`DM_BODY1_ContainerExtMirrMaster_ST3_ExtMirr_Master_Stat_ST3::`MirrPosnX_D_ActualPosn_ST3, __cArray, 0 );
    testInfoRow(__tableHandle, 0, __cArray);
    __ReportCell(`BODY1::dbNode::`DM_FL::`DM_BODY1_ContainerExtMirrMaster_ST3_ExtMirr_Master_Stat_ST3::`MirrPosnX_D_ActualPosn_ST3);
    __ReportSignal("PDU signal 'MirrPosnY_D_ActualPosn_ST3'", `BODY1::dbNode::`DM_FL::`DM_BODY1_ContainerExtMirrMaster_ST3_ExtMirr_Master_Stat_ST3::`MirrPosnY_D_ActualPosn_ST3, __cArray, 0 );
    testInfoRow(__tableHandle, 0, __cArray);
    __ReportCell(`BODY1::dbNode::`DM_FL::`DM_BODY1_ContainerExtMirrMaster_ST3_ExtMirr_Master_Stat_ST3::`MirrPosnY_D_ActualPosn_ST3);
    __ReportTableEndTestStep(__cEmpty);
  }
  TestCommandEnd();

  
  TestControlStructBegin(__cIf, "", "3");
  {
    int64 __condition;
    {
      int64 __expr0;
      __ifExec0 = 0;
  
      {
        __csr = CheckSignalMatch(`LinDB::dbNode::`DSM_WM_DOOR::`DSM_WM_Frm1_AR_DOOR::`MirrSelLtSw_Psd_DOOR, 1, "==") == 1;
      }
      {
        __expr0 = __csr;
      }
      __condition = __expr0;
  
        snprintf(__cConditionArray, 2048, "%s", "");
        snprintf(__cCompareArray, 2048, "%s", "");
        snprintf(__cCompareArray, 2048, "%s%s%s", "MirrSelLtSw_Psd_DOOR", "==", "1");
        snprintf(__cArray, 2048, "%s", __cCompareArray);
        snprintf(__cCompareArray, 2048, "( %s )", __cArray);
        snprintf(__cArray, 2048, "%s", __cConditionArray);
        snprintf(__cConditionArray, 2048, "%s%s", __cArray, __cCompareArray);
        snprintf(__cArray, 2048, "%s", __cConditionArray);
        snprintf(__cConditionArray, 2048, "%s %s", "If", __cArray);
  
      __ReportConditionTableHead(__cConditionArray, __condition);
      {
        __csr = CheckSignalMatch(`LinDB::dbNode::`DSM_WM_DOOR::`DSM_WM_Frm1_AR_DOOR::`MirrSelLtSw_Psd_DOOR, 1, "==") == 1;
        __ReportTableRow(0, "LIN signal 'MirrSelLtSw_Psd_DOOR'", "==", 1, "");
        __ReportCell(`LinDB::dbNode::`DSM_WM_DOOR::`DSM_WM_Frm1_AR_DOOR::`MirrSelLtSw_Psd_DOOR);
        __ReportCellResult(__csr, __eTrueFalse); 
      }
      __ReportTableEndCondition(__cIfCondition);
    }
  
    if(__condition)
    {  
      __ifExec0 = 1;

    }
  }
  TestControlStructEnd(__eUndefined);

  TestControlStructBegin(__cElse, "", "5");
  {
    if (__DoElse(__ifExec0))
    {
    }
  }
  TestControlStructEnd(__eUndefined);

  TestCommandBegin(__eSet, __cSet, "", "7");
  {
  
    __ReportTableHead3Columns(__cSetCaption , __cTSym, __cTOp, __cAssigned); 
    {
      $`LinDB::dbNode::`DSM_WM_DOOR::`DSM_WM_Frm1_AR_DOOR::`MirrSelLtSw_Psd_DOOR.phys = 1;
      __ReportSignalSetLValue("LIN signal 'MirrSelLtSw_Psd_DOOR'", `LinDB::dbNode::`DSM_WM_DOOR::`DSM_WM_Frm1_AR_DOOR::`MirrSelLtSw_Psd_DOOR, __cArray);
      __ReportTableRow(0, __cArray, __cAOp, 1, "");
    }
    __ReportTableEndTestStep("1");
  }
  TestCommandEnd();

  TestCommandBegin(__eWait, __cWait, "", "8");
  {
    __Wait("1", (300 * 1000000), 1000000, "");
  }
  TestCommandEnd();

  TestCommandBegin(__eCheck, __cCheck, "", "9");
  {
    __bVerdict = __eVerdictPass;
    __ReportTableHead5Columns(__cCheckCaption, __cTSym, __cTOp, __cRefVal, __cActual, __cRes);
    {
      __csr = CheckSignalMatch(`BODY1::dbNode::`DM_FL::`DM_FL_BODY1_Container1_ST3_ExtMirr_FL_Stat_ST3::`MirrAdj_LHD_Sel_Stat_ST3, 1, "==") == 1;
      __ReportTableRow(0, "PDU signal 'MirrAdj_LHD_Sel_Stat_ST3'", "==", 1, "I_C02_MIRRADJSW_STAT_DRV");
      __ReportCell(`BODY1::dbNode::`DM_FL::`DM_FL_BODY1_Container1_ST3_ExtMirr_FL_Stat_ST3::`MirrAdj_LHD_Sel_Stat_ST3);
      __ReportCellResult(__csr, __ePassFail);
      __bVerdict = __bVerdict && __csr;
    }
    __ReportTableEndVerdict("1", __bVerdict);
  }
  TestCommandEnd();

  TestCommandBegin(__eWait, __cWait, "", "11");
  {
    __Wait("1", (2 * 1000000000), 1000000000, "");
  }
  TestCommandEnd();

  TestCommandBegin(__eSet, __cSet, "", "13");
  {
  
    __ReportTableHead3Columns(__cSetCaption , __cTSym, __cTOp, __cAssigned); 
    {
      $`BODY1::dbNode::`BC_F::`BC_F_BODY1_GW_Container_ST3_Ign_Stat_ST3::`ISw_Stat_ST3.phys = 0;
      __ReportSignalSetLValue("PDU signal 'ISw_Stat_ST3'", `BODY1::dbNode::`BC_F::`BC_F_BODY1_GW_Container_ST3_Ign_Stat_ST3::`ISw_Stat_ST3, __cArray);
      __ReportTableRow(0, __cArray, __cAOp, 0, "I_C03_ISW_STAT_IGN_LOCK");
    }
    __ReportTableEndTestStep("1");
  }
  TestCommandEnd();

  TestCommandBegin(__eWait, __cWait, "", "14");
  {
    __Wait("1", (2 * 1000000000), 1000000000, "");
  }
  TestCommandEnd();

  TestCommandBegin(__eSet, __cSet, "", "15");
  {
  
    __ReportTableHead3Columns(__cSetCaption , __cTSym, __cTOp, __cAssigned); 
    {
      $`BODY1::dbNode::`BC_F::`BC_F_BODY1_GW_Container_ST3_CLkS_Dr_State_ST3::`DrRLtch_FL_Stat_ST3.phys = 1;
      __ReportSignalSetLValue("PDU signal 'DrRLtch_FL_Stat_ST3'", `BODY1::dbNode::`BC_F::`BC_F_BODY1_GW_Container_ST3_CLkS_Dr_State_ST3::`DrRLtch_FL_Stat_ST3, __cArray);
      __ReportTableRow(0, __cArray, __cAOp, 1, "I_C02_DR_STAT_CLS");
    }
    {
      $`BODY1::dbNode::`BC_F::`BC_F_BODY1_GW_Container_ST3_CLkS_Dr_State_ST3::`DrRLtch_FR_Stat_ST3.phys = 1;
      __ReportSignalSetLValue("PDU signal 'DrRLtch_FR_Stat_ST3'", `BODY1::dbNode::`BC_F::`BC_F_BODY1_GW_Container_ST3_CLkS_Dr_State_ST3::`DrRLtch_FR_Stat_ST3, __cArray);
      __ReportTableRow(0, __cArray, __cAOp, 1, "I_C02_DR_STAT_CLS");
    }
    {
      $`BODY1::dbNode::`BC_F::`BC_F_BODY1_GW_Container_ST3_CLkS_Dr_State_ST3::`DrRLtch_RL_Stat_ST3.phys = 1;
      __ReportSignalSetLValue("PDU signal 'DrRLtch_RL_Stat_ST3'", `BODY1::dbNode::`BC_F::`BC_F_BODY1_GW_Container_ST3_CLkS_Dr_State_ST3::`DrRLtch_RL_Stat_ST3, __cArray);
      __ReportTableRow(0, __cArray, __cAOp, 1, "I_C02_DR_STAT_CLS");
    }
    {
      $`BODY1::dbNode::`BC_F::`BC_F_BODY1_GW_Container_ST3_CLkS_Dr_State_ST3::`DrRLtch_RR_Stat_ST3.phys = 1;
      __ReportSignalSetLValue("PDU signal 'DrRLtch_RR_Stat_ST3'", `BODY1::dbNode::`BC_F::`BC_F_BODY1_GW_Container_ST3_CLkS_Dr_State_ST3::`DrRLtch_RR_Stat_ST3, __cArray);
      __ReportTableRow(0, __cArray, __cAOp, 1, "I_C02_DR_STAT_CLS");
    }
    __ReportTableEndTestStep("1");
  }
  TestCommandEnd();

  TestCommandBegin(__eWait, __cWait, "", "16");
  {
    __Wait("1", (2 * 1000000000), 1000000000, "");
  }
  TestCommandEnd();

  TestCommandBegin(__eSet, __cSet, "", "18");
  {
  
    __ReportTableHead3Columns(__cSetCaption , __cTSym, __cTOp, __cAssigned); 
    {
      $`BODY1::dbNode::`EIS_BASE::`EIS_BODY1_Container_ST3_CLkS_Rq_ST3::`CLkS_Ext_Rq_ST3.phys = 1;
      __ReportSignalSetLValue("PDU signal 'CLkS_Ext_Rq_ST3'", `BODY1::dbNode::`EIS_BASE::`EIS_BODY1_Container_ST3_CLkS_Rq_ST3::`CLkS_Ext_Rq_ST3, __cArray);
      __ReportTableRow(0, __cArray, __cAOp, 1, "I_C02_CLKS_RQ_SNA_3H_LK");
    }
    __ReportTableEndTestStep("1");
  }
  TestCommandEnd();

  TestCommandBegin(__eAwaitValueMatch, __cAwaitValueMatch, "", "20");
  {
  
    dword __signalTimes[1];
    int64 __time;
    long __setFailed;
    __setFailed = 0;
    __time = 8 * 1000000000;
    if (__time < 0)
    {
      testStepErrorInTestSystem(0, "1", "Unable to wait for %.3f %s. Please check input parameter.", __time / ((float)1000000000), "s");
    }
    else
    {
      __signalTimes[0] = getSignalTime(`BODY1::dbNode::`DM_FL::`DM_FL_BODY1_Container1_ST3_ExtMirr_FL_Stat_ST3::`MirrAdj_LHD_Fold_Stat_ST3);
      snprintf(__cArray, elCount(__cArray), "PDU signal '%s'", "MirrAdj_LHD_Fold_Stat_ST3");
      __setFailed |= testJoinSignal(`BODY1::dbNode::`DM_FL::`DM_FL_BODY1_Container1_ST3_ExtMirr_FL_Stat_ST3::`MirrAdj_LHD_Fold_Stat_ST3, "__tt0Callback5", __cArray, 1) < 0;
      if (__setFailed != 0)
      {
        testStepErrorInTestSystem(0, "1", "Unable to set value condition.");
      }
      else
      {
        int64 __occurrenceTime;
        if (testWaitForAllJoinedEventsNS(__time) > 0)
        {
          testStepPass(2, "1", "Waited for occurrence of 1 value condition and signal updates.");
        }
        else
        {
          testStepFail(0, "1", "Waited for occurrence of 1 value condition and signal updates.");
        }
        __ReportTableHead6Columns(__cEmpty, __cTSym, __cTOp, __cRefVal, __cActual, __cEmpty, __cRes);
        __csr = CheckSignalMatch(`BODY1::dbNode::`DM_FL::`DM_FL_BODY1_Container1_ST3_ExtMirr_FL_Stat_ST3::`MirrAdj_LHD_Fold_Stat_ST3, 3, "==") == 1;
        __ReportTableRow(0, "PDU signal 'MirrAdj_LHD_Fold_Stat_ST3'", "==", 3, "I_C03_MIRRFLD_STAT_FOLD_IN");
        __ReportCell(`BODY1::dbNode::`DM_FL::`DM_FL_BODY1_Container1_ST3_ExtMirr_FL_Stat_ST3::`MirrAdj_LHD_Fold_Stat_ST3);
        
        {
          dword __signalTime;
          __signalTime = getSignalTime(`BODY1::dbNode::`DM_FL::`DM_FL_BODY1_Container1_ST3_ExtMirr_FL_Stat_ST3::`MirrAdj_LHD_Fold_Stat_ST3);
          if (__signalTime > __signalTimes[0])
          {
            __ReportCell(__cEmpty);
          }
          else
          {
            __ReportCell("(no update)");
            __csr = 0;
          }
        }
        __ReportCellResult(__csr, __ePassFail);
        __ReportTableEndTestStep(__cEmpty);
      }
    }
  }
  TestCommandEnd();

  TestCommandBegin(__eAwaitValueMatch, __cAwaitValueMatch, "", "21");
  {
  
    dword __signalTimes[1];
    int64 __time;
    long __setFailed;
    __setFailed = 0;
    __time = 4.5 * 1000000000;
    if (__time < 0)
    {
      testStepErrorInTestSystem(0, "1", "Unable to wait for %.3f %s. Please check input parameter.", __time / ((float)1000000000), "s");
    }
    else
    {
      __signalTimes[0] = getSignalTime(`BODY1::dbNode::`DM_FL::`DM_FL_BODY1_Container1_ST3_ExtMirr_FL_Stat_ST3::`MirrAdj_LHD_Fold_Stat_ST3);
      snprintf(__cArray, elCount(__cArray), "PDU signal '%s'", "MirrAdj_LHD_Fold_Stat_ST3");
      __setFailed |= testJoinSignal(`BODY1::dbNode::`DM_FL::`DM_FL_BODY1_Container1_ST3_ExtMirr_FL_Stat_ST3::`MirrAdj_LHD_Fold_Stat_ST3, "__tt0Callback6", __cArray, 1) < 0;
      if (__setFailed != 0)
      {
        testStepErrorInTestSystem(0, "1", "Unable to set value condition.");
      }
      else
      {
        int64 __occurrenceTime;
        if (testWaitForAllJoinedEventsNS(__time) > 0)
        {
          testStepPass(2, "1", "Waited for occurrence of 1 value condition and signal updates.");
        }
        else
        {
          testStepFail(0, "1", "Waited for occurrence of 1 value condition and signal updates.");
        }
        __ReportTableHead6Columns(__cEmpty, __cTSym, __cTOp, __cRefVal, __cActual, __cEmpty, __cRes);
        __csr = CheckSignalMatch(`BODY1::dbNode::`DM_FL::`DM_FL_BODY1_Container1_ST3_ExtMirr_FL_Stat_ST3::`MirrAdj_LHD_Fold_Stat_ST3, 1, "==") == 1;
        __ReportTableRow(0, "PDU signal 'MirrAdj_LHD_Fold_Stat_ST3'", "==", 1, "I_C03_MIRRFLD_STAT_FOLDED");
        __ReportCell(`BODY1::dbNode::`DM_FL::`DM_FL_BODY1_Container1_ST3_ExtMirr_FL_Stat_ST3::`MirrAdj_LHD_Fold_Stat_ST3);
        
        {
          dword __signalTime;
          __signalTime = getSignalTime(`BODY1::dbNode::`DM_FL::`DM_FL_BODY1_Container1_ST3_ExtMirr_FL_Stat_ST3::`MirrAdj_LHD_Fold_Stat_ST3);
          if (__signalTime > __signalTimes[0])
          {
            __ReportCell(__cEmpty);
          }
          else
          {
            __ReportCell("(no update)");
            __csr = 0;
          }
        }
        __ReportCellResult(__csr, __ePassFail);
        __ReportTableEndTestStep(__cEmpty);
      }
    }
  }
  TestCommandEnd();

  TestCommandBegin(__eWait, __cWait, "", "22");
  {
    __Wait("1", (1800 * 1000000000), 1000000000, "");
  }
  TestCommandEnd();

  TestCommandBegin(__eSet, __cSet, "", "24");
  {
  
    __ReportTableHead3Columns(__cSetCaption , __cTSym, __cTOp, __cAssigned); 
    {
      $`BODY1::dbNode::`EIS_BASE::`EIS_BODY1_Container_ST3_CLkS_Rq_ST3::`CLkS_Ext_Rq_ST3.phys = 2;
      __ReportSignalSetLValue("PDU signal 'CLkS_Ext_Rq_ST3'", `BODY1::dbNode::`EIS_BASE::`EIS_BODY1_Container_ST3_CLkS_Rq_ST3::`CLkS_Ext_Rq_ST3, __cArray);
      __ReportTableRow(0, __cArray, __cAOp, 2, "I_C02_CLKS_RQ_SNA_3H_UNLK");
    }
    __ReportTableEndTestStep("1");
  }
  TestCommandEnd();

  TestCommandBegin(__eAwaitValueMatch, __cAwaitValueMatch, "", "26");
  {
  
    dword __signalTimes[1];
    int64 __time;
    long __setFailed;
    __setFailed = 0;
    __time = 8 * 1000000000;
    if (__time < 0)
    {
      testStepErrorInTestSystem(0, "1", "Unable to wait for %.3f %s. Please check input parameter.", __time / ((float)1000000000), "s");
    }
    else
    {
      __signalTimes[0] = getSignalTime(`BODY1::dbNode::`DM_FL::`DM_FL_BODY1_Container1_ST3_ExtMirr_FL_Stat_ST3::`MirrAdj_LHD_Fold_Stat_ST3);
      snprintf(__cArray, elCount(__cArray), "PDU signal '%s'", "MirrAdj_LHD_Fold_Stat_ST3");
      __setFailed |= testJoinSignal(`BODY1::dbNode::`DM_FL::`DM_FL_BODY1_Container1_ST3_ExtMirr_FL_Stat_ST3::`MirrAdj_LHD_Fold_Stat_ST3, "__tt0Callback7", __cArray, 1) < 0;
      if (__setFailed != 0)
      {
        testStepErrorInTestSystem(0, "1", "Unable to set value condition.");
      }
      else
      {
        int64 __occurrenceTime;
        if (testWaitForAllJoinedEventsNS(__time) > 0)
        {
          testStepPass(2, "1", "Waited for occurrence of 1 value condition and signal updates.");
        }
        else
        {
          testStepFail(0, "1", "Waited for occurrence of 1 value condition and signal updates.");
        }
        __ReportTableHead6Columns(__cEmpty, __cTSym, __cTOp, __cRefVal, __cActual, __cEmpty, __cRes);
        __csr = CheckSignalMatch(`BODY1::dbNode::`DM_FL::`DM_FL_BODY1_Container1_ST3_ExtMirr_FL_Stat_ST3::`MirrAdj_LHD_Fold_Stat_ST3, 4, "==") == 1;
        __ReportTableRow(0, "PDU signal 'MirrAdj_LHD_Fold_Stat_ST3'", "==", 4, "I_C03_MIRRFLD_STAT_FOLD_OUT");
        __ReportCell(`BODY1::dbNode::`DM_FL::`DM_FL_BODY1_Container1_ST3_ExtMirr_FL_Stat_ST3::`MirrAdj_LHD_Fold_Stat_ST3);
        
        {
          dword __signalTime;
          __signalTime = getSignalTime(`BODY1::dbNode::`DM_FL::`DM_FL_BODY1_Container1_ST3_ExtMirr_FL_Stat_ST3::`MirrAdj_LHD_Fold_Stat_ST3);
          if (__signalTime > __signalTimes[0])
          {
            __ReportCell(__cEmpty);
          }
          else
          {
            __ReportCell("(no update)");
            __csr = 0;
          }
        }
        __ReportCellResult(__csr, __ePassFail);
        __ReportTableEndTestStep(__cEmpty);
      }
    }
  }
  TestCommandEnd();

  TestCommandBegin(__eAwaitValueMatch, __cAwaitValueMatch, "", "27");
  {
  
    dword __signalTimes[1];
    int64 __time;
    long __setFailed;
    __setFailed = 0;
    __time = 4.5 * 1000000000;
    if (__time < 0)
    {
      testStepErrorInTestSystem(0, "1", "Unable to wait for %.3f %s. Please check input parameter.", __time / ((float)1000000000), "s");
    }
    else
    {
      __signalTimes[0] = getSignalTime(`BODY1::dbNode::`DM_FL::`DM_FL_BODY1_Container1_ST3_ExtMirr_FL_Stat_ST3::`MirrAdj_LHD_Fold_Stat_ST3);
      snprintf(__cArray, elCount(__cArray), "PDU signal '%s'", "MirrAdj_LHD_Fold_Stat_ST3");
      __setFailed |= testJoinSignal(`BODY1::dbNode::`DM_FL::`DM_FL_BODY1_Container1_ST3_ExtMirr_FL_Stat_ST3::`MirrAdj_LHD_Fold_Stat_ST3, "__tt0Callback8", __cArray, 1) < 0;
      if (__setFailed != 0)
      {
        testStepErrorInTestSystem(0, "1", "Unable to set value condition.");
      }
      else
      {
        int64 __occurrenceTime;
        if (testWaitForAllJoinedEventsNS(__time) > 0)
        {
          testStepPass(2, "1", "Waited for occurrence of 1 value condition and signal updates.");
        }
        else
        {
          testStepFail(0, "1", "Waited for occurrence of 1 value condition and signal updates.");
        }
        __ReportTableHead6Columns(__cEmpty, __cTSym, __cTOp, __cRefVal, __cActual, __cEmpty, __cRes);
        __csr = CheckSignalMatch(`BODY1::dbNode::`DM_FL::`DM_FL_BODY1_Container1_ST3_ExtMirr_FL_Stat_ST3::`MirrAdj_LHD_Fold_Stat_ST3, 2, "==") == 1;
        __ReportTableRow(0, "PDU signal 'MirrAdj_LHD_Fold_Stat_ST3'", "==", 2, "I_C03_MIRRFLD_STAT_UNFOLDED");
        __ReportCell(`BODY1::dbNode::`DM_FL::`DM_FL_BODY1_Container1_ST3_ExtMirr_FL_Stat_ST3::`MirrAdj_LHD_Fold_Stat_ST3);
        
        {
          dword __signalTime;
          __signalTime = getSignalTime(`BODY1::dbNode::`DM_FL::`DM_FL_BODY1_Container1_ST3_ExtMirr_FL_Stat_ST3::`MirrAdj_LHD_Fold_Stat_ST3);
          if (__signalTime > __signalTimes[0])
          {
            __ReportCell(__cEmpty);
          }
          else
          {
            __ReportCell("(no update)");
            __csr = 0;
          }
        }
        __ReportCellResult(__csr, __ePassFail);
        __ReportTableEndTestStep(__cEmpty);
      }
    }
  }
  TestCommandEnd();

  TestCommandBegin(__eWait, __cWait, "", "28");
  {
    __Wait("1", (2 * 1000000000), 1000000000, "");
  }
  TestCommandEnd();

  TestCommandBegin(__eSet, __cSet, "", "30");
  {
  
    __ReportTableHead3Columns(__cSetCaption , __cTSym, __cTOp, __cAssigned); 
    {
      $`LinDB::dbNode::`DSM_WM_DOOR::`DSM_WM_Frm1_AR_DOOR::`MirrSelLtSw_Psd_DOOR.phys = 0;
      __ReportSignalSetLValue("LIN signal 'MirrSelLtSw_Psd_DOOR'", `LinDB::dbNode::`DSM_WM_DOOR::`DSM_WM_Frm1_AR_DOOR::`MirrSelLtSw_Psd_DOOR, __cArray);
      __ReportTableRow(0, __cArray, __cAOp, 0, "");
    }
    __ReportTableEndTestStep("1");
  }
  TestCommandEnd();

  TestCommandBegin(__eWait, __cWait, "", "31");
  {
    __Wait("1", (300 * 1000000), 1000000, "");
  }
  TestCommandEnd();

  TestCommandBegin(__eSet, __cSet, "", "32");
  {
  
    __ReportTableHead3Columns(__cSetCaption , __cTSym, __cTOp, __cAssigned); 
    {
      $`BODY1::dbNode::`BC_F::`BC_F_BODY1_GW_Container_ST3_Ign_Stat_ST3::`ISw_Stat_ST3.phys = 4;
      __ReportSignalSetLValue("PDU signal 'ISw_Stat_ST3'", `BODY1::dbNode::`BC_F::`BC_F_BODY1_GW_Container_ST3_Ign_Stat_ST3::`ISw_Stat_ST3, __cArray);
      __ReportTableRow(0, __cArray, __cAOp, 4, "I_C03_ISW_STAT_IGN_ON");
    }
    __ReportTableEndTestStep("1");
  }
  TestCommandEnd();

  TestCommandBegin(__eWait, __cWait, "", "33");
  {
    __Wait("1", (2 * 1000000000), 1000000000, "");
  }
  TestCommandEnd();

}

dword __tt0Callback5(signal * __cbParam)
{

  __csr = CheckSignalMatch(__cbParam, 3, "==") == 1;
  return __csr;
}
dword __tt0Callback6(signal * __cbParam)
{

  __csr = CheckSignalMatch(__cbParam, 1, "==") == 1;
  return __csr;
}
dword __tt0Callback7(signal * __cbParam)
{

  __csr = CheckSignalMatch(__cbParam, 4, "==") == 1;
  return __csr;
}
dword __tt0Callback8(signal * __cbParam)
{

  __csr = CheckSignalMatch(__cbParam, 2, "==") == 1;
  return __csr;
}

testcase Tt0_Mirror_heating(int64 iteration, int64 CSL_actuation_TimerMS)
{
  SetBreakOnFail(0);

  TestPreparationBegin();
  {
    TestCommandBegin(__eSet, __cSet, "", "0");
    {
    
      __ReportTableHead3Columns(__cSetCaption , __cTSym, __cTOp, __cAssigned); 
      {
        $`BODY1::dbNode::`BC_F::`BC_F_BODY1_GW_Container_ST3_ExtMirr_Settings_ST3::`MirrFldPk_Rq_ST3.phys = 1;
        __ReportSignalSetLValue("PDU signal 'MirrFldPk_Rq_ST3'", `BODY1::dbNode::`BC_F::`BC_F_BODY1_GW_Container_ST3_ExtMirr_Settings_ST3::`MirrFldPk_Rq_ST3, __cArray);
        __ReportTableRow(0, __cArray, __cAOp, 1, "I_C02_OFF_ON_ON");
      }
      __ReportTableEndTestStep("1");
    }
    TestCommandEnd();

    TestCommandBegin(__eWait, __cWait, "", "1");
    {
      __Wait("1", (2 * 1000000000), 1000000000, "");
    }
    TestCommandEnd();

  }
  TestPreparationEnd();

  TestCommandBegin(__eSet, __cSet, "", "2");
  {
  
    __ReportTableHead3Columns(__cSetCaption , __cTSym, __cTOp, __cAssigned); 
    {
      $`BODY1::dbNode::`BC_R::`BC_R_BODY1_Container2_ST3_BackliteHtr_Stat_ST3::`EBL_Stat_ST3.phys = 1;
      __ReportSignalSetLValue("PDU signal 'EBL_Stat_ST3'", `BODY1::dbNode::`BC_R::`BC_R_BODY1_Container2_ST3_BackliteHtr_Stat_ST3::`EBL_Stat_ST3, __cArray);
      __ReportTableRow(0, __cArray, __cAOp, 1, "I_C02_EBL_STAT_MAN_ON");
    }
    __ReportTableEndTestStep("1");
  }
  TestCommandEnd();

  TestCommandBegin(__eWait, __cWait, "", "3");
  {
    __Wait("1", (1 * 1000000000), 1000000000, "");
  }
  TestCommandEnd();

  TestCommandBegin(__eCheck, __cCheck, "", "4");
  {
    __bVerdict = __eVerdictPass;
    __ReportTableHead5Columns(__cCheckCaption, __cTSym, __cTOp, __cRefVal, __cActual, __cRes);
    {
      __csr = CheckSignalMatch(`BODY1::dbNode::`DM_FL::`DM_FL_BODY1_Container1_ST3_ExtMirr_FL_Stat_ST3::`MirrHeat_FL_Stat_ST3, 1, "==") == 1;
      __ReportTableRow(0, "PDU signal 'MirrHeat_FL_Stat_ST3'", "==", 1, "I_C02_IDLE_ON_OFF_SNA_3H_ON");
      __ReportCell(`BODY1::dbNode::`DM_FL::`DM_FL_BODY1_Container1_ST3_ExtMirr_FL_Stat_ST3::`MirrHeat_FL_Stat_ST3);
      __ReportCellResult(__csr, __ePassFail);
      __bVerdict = __bVerdict && __csr;
    }
    {
      __csr = CheckSignalMatch(`BODY1::dbNode::`DM_FR::`DM_FR_BODY1_Container1_ST3_ExtMirr_FR_Stat_ST3::`MirrHeat_FR_Stat_ST3, 1, "==") == 1;
      __ReportTableRow(0, "PDU signal 'MirrHeat_FR_Stat_ST3'", "==", 1, "I_C02_IDLE_ON_OFF_SNA_3H_ON");
      __ReportCell(`BODY1::dbNode::`DM_FR::`DM_FR_BODY1_Container1_ST3_ExtMirr_FR_Stat_ST3::`MirrHeat_FR_Stat_ST3);
      __ReportCellResult(__csr, __ePassFail);
      __bVerdict = __bVerdict && __csr;
    }
    __ReportTableEndVerdict("1", __bVerdict);
  }
  TestCommandEnd();

  TestCommandBegin(__eWait, __cWait, "", "5");
  {
    __Wait("1", (2 * 1000000000), 1000000000, "");
  }
  TestCommandEnd();

  TestCommandBegin(__eSet, __cSet, "", "10");
  {
  
    __ReportTableHead3Columns(__cSetCaption , __cTSym, __cTOp, __cAssigned); 
    {
      $`BODY1::dbNode::`BC_F::`BC_F_BODY1_GW_Container_ST3_Ign_Stat_ST3::`ISw_Stat_ST3.phys = 0;
      __ReportSignalSetLValue("PDU signal 'ISw_Stat_ST3'", `BODY1::dbNode::`BC_F::`BC_F_BODY1_GW_Container_ST3_Ign_Stat_ST3::`ISw_Stat_ST3, __cArray);
      __ReportTableRow(0, __cArray, __cAOp, 0, "I_C03_ISW_STAT_IGN_LOCK");
    }
    __ReportTableEndTestStep("1");
  }
  TestCommandEnd();

  TestCommandBegin(__eWait, __cWait, "", "11");
  {
    __Wait("1", (2 * 1000000000), 1000000000, "");
  }
  TestCommandEnd();

  TestCommandBegin(__eSet, __cSet, "", "12");
  {
  
    __ReportTableHead3Columns(__cSetCaption , __cTSym, __cTOp, __cAssigned); 
    {
      $`BODY1::dbNode::`BC_F::`BC_F_BODY1_GW_Container_ST3_CLkS_Dr_State_ST3::`DrRLtch_FL_Stat_ST3.phys = 1;
      __ReportSignalSetLValue("PDU signal 'DrRLtch_FL_Stat_ST3'", `BODY1::dbNode::`BC_F::`BC_F_BODY1_GW_Container_ST3_CLkS_Dr_State_ST3::`DrRLtch_FL_Stat_ST3, __cArray);
      __ReportTableRow(0, __cArray, __cAOp, 1, "I_C02_DR_STAT_CLS");
    }
    {
      $`BODY1::dbNode::`BC_F::`BC_F_BODY1_GW_Container_ST3_CLkS_Dr_State_ST3::`DrRLtch_FR_Stat_ST3.phys = 1;
      __ReportSignalSetLValue("PDU signal 'DrRLtch_FR_Stat_ST3'", `BODY1::dbNode::`BC_F::`BC_F_BODY1_GW_Container_ST3_CLkS_Dr_State_ST3::`DrRLtch_FR_Stat_ST3, __cArray);
      __ReportTableRow(0, __cArray, __cAOp, 1, "I_C02_DR_STAT_CLS");
    }
    {
      $`BODY1::dbNode::`BC_F::`BC_F_BODY1_GW_Container_ST3_CLkS_Dr_State_ST3::`DrRLtch_RL_Stat_ST3.phys = 1;
      __ReportSignalSetLValue("PDU signal 'DrRLtch_RL_Stat_ST3'", `BODY1::dbNode::`BC_F::`BC_F_BODY1_GW_Container_ST3_CLkS_Dr_State_ST3::`DrRLtch_RL_Stat_ST3, __cArray);
      __ReportTableRow(0, __cArray, __cAOp, 1, "I_C02_DR_STAT_CLS");
    }
    {
      $`BODY1::dbNode::`BC_F::`BC_F_BODY1_GW_Container_ST3_CLkS_Dr_State_ST3::`DrRLtch_RR_Stat_ST3.phys = 1;
      __ReportSignalSetLValue("PDU signal 'DrRLtch_RR_Stat_ST3'", `BODY1::dbNode::`BC_F::`BC_F_BODY1_GW_Container_ST3_CLkS_Dr_State_ST3::`DrRLtch_RR_Stat_ST3, __cArray);
      __ReportTableRow(0, __cArray, __cAOp, 1, "I_C02_DR_STAT_CLS");
    }
    __ReportTableEndTestStep("1");
  }
  TestCommandEnd();

  TestCommandBegin(__eWait, __cWait, "", "13");
  {
    __Wait("1", (2 * 1000000000), 1000000000, "");
  }
  TestCommandEnd();

  TestCommandBegin(__eSet, __cSet, "", "15");
  {
  
    __ReportTableHead3Columns(__cSetCaption , __cTSym, __cTOp, __cAssigned); 
    {
      $`BODY1::dbNode::`EIS_BASE::`EIS_BODY1_Container_ST3_CLkS_Rq_ST3::`CLkS_Ext_Rq_ST3.phys = 1;
      __ReportSignalSetLValue("PDU signal 'CLkS_Ext_Rq_ST3'", `BODY1::dbNode::`EIS_BASE::`EIS_BODY1_Container_ST3_CLkS_Rq_ST3::`CLkS_Ext_Rq_ST3, __cArray);
      __ReportTableRow(0, __cArray, __cAOp, 1, "I_C02_CLKS_RQ_SNA_3H_LK");
    }
    __ReportTableEndTestStep("1");
  }
  TestCommandEnd();

  TestCommandBegin(__eAwaitValueMatch, __cAwaitValueMatch, "", "17");
  {
  
    dword __signalTimes[1];
    int64 __time;
    long __setFailed;
    __setFailed = 0;
    __time = 8 * 1000000000;
    if (__time < 0)
    {
      testStepErrorInTestSystem(0, "1", "Unable to wait for %.3f %s. Please check input parameter.", __time / ((float)1000000000), "s");
    }
    else
    {
      __signalTimes[0] = getSignalTime(`BODY1::dbNode::`DM_FL::`DM_FL_BODY1_Container1_ST3_ExtMirr_FL_Stat_ST3::`MirrAdj_LHD_Fold_Stat_ST3);
      snprintf(__cArray, elCount(__cArray), "PDU signal '%s'", "MirrAdj_LHD_Fold_Stat_ST3");
      __setFailed |= testJoinSignal(`BODY1::dbNode::`DM_FL::`DM_FL_BODY1_Container1_ST3_ExtMirr_FL_Stat_ST3::`MirrAdj_LHD_Fold_Stat_ST3, "__tt0Callback9", __cArray, 1) < 0;
      if (__setFailed != 0)
      {
        testStepErrorInTestSystem(0, "1", "Unable to set value condition.");
      }
      else
      {
        int64 __occurrenceTime;
        if (testWaitForAllJoinedEventsNS(__time) > 0)
        {
          testStepPass(2, "1", "Waited for occurrence of 1 value condition and signal updates.");
        }
        else
        {
          testStepFail(0, "1", "Waited for occurrence of 1 value condition and signal updates.");
        }
        __ReportTableHead6Columns(__cEmpty, __cTSym, __cTOp, __cRefVal, __cActual, __cEmpty, __cRes);
        __csr = CheckSignalMatch(`BODY1::dbNode::`DM_FL::`DM_FL_BODY1_Container1_ST3_ExtMirr_FL_Stat_ST3::`MirrAdj_LHD_Fold_Stat_ST3, 3, "==") == 1;
        __ReportTableRow(0, "PDU signal 'MirrAdj_LHD_Fold_Stat_ST3'", "==", 3, "I_C03_MIRRFLD_STAT_FOLD_IN");
        __ReportCell(`BODY1::dbNode::`DM_FL::`DM_FL_BODY1_Container1_ST3_ExtMirr_FL_Stat_ST3::`MirrAdj_LHD_Fold_Stat_ST3);
        
        {
          dword __signalTime;
          __signalTime = getSignalTime(`BODY1::dbNode::`DM_FL::`DM_FL_BODY1_Container1_ST3_ExtMirr_FL_Stat_ST3::`MirrAdj_LHD_Fold_Stat_ST3);
          if (__signalTime > __signalTimes[0])
          {
            __ReportCell(__cEmpty);
          }
          else
          {
            __ReportCell("(no update)");
            __csr = 0;
          }
        }
        __ReportCellResult(__csr, __ePassFail);
        __ReportTableEndTestStep(__cEmpty);
      }
    }
  }
  TestCommandEnd();

  TestCommandBegin(__eAwaitValueMatch, __cAwaitValueMatch, "", "18");
  {
  
    dword __signalTimes[1];
    int64 __time;
    long __setFailed;
    __setFailed = 0;
    __time = 4.5 * 1000000000;
    if (__time < 0)
    {
      testStepErrorInTestSystem(0, "1", "Unable to wait for %.3f %s. Please check input parameter.", __time / ((float)1000000000), "s");
    }
    else
    {
      __signalTimes[0] = getSignalTime(`BODY1::dbNode::`DM_FL::`DM_FL_BODY1_Container1_ST3_ExtMirr_FL_Stat_ST3::`MirrAdj_LHD_Fold_Stat_ST3);
      snprintf(__cArray, elCount(__cArray), "PDU signal '%s'", "MirrAdj_LHD_Fold_Stat_ST3");
      __setFailed |= testJoinSignal(`BODY1::dbNode::`DM_FL::`DM_FL_BODY1_Container1_ST3_ExtMirr_FL_Stat_ST3::`MirrAdj_LHD_Fold_Stat_ST3, "__tt0Callback10", __cArray, 1) < 0;
      if (__setFailed != 0)
      {
        testStepErrorInTestSystem(0, "1", "Unable to set value condition.");
      }
      else
      {
        int64 __occurrenceTime;
        if (testWaitForAllJoinedEventsNS(__time) > 0)
        {
          testStepPass(2, "1", "Waited for occurrence of 1 value condition and signal updates.");
        }
        else
        {
          testStepFail(0, "1", "Waited for occurrence of 1 value condition and signal updates.");
        }
        __ReportTableHead6Columns(__cEmpty, __cTSym, __cTOp, __cRefVal, __cActual, __cEmpty, __cRes);
        __csr = CheckSignalMatch(`BODY1::dbNode::`DM_FL::`DM_FL_BODY1_Container1_ST3_ExtMirr_FL_Stat_ST3::`MirrAdj_LHD_Fold_Stat_ST3, 1, "==") == 1;
        __ReportTableRow(0, "PDU signal 'MirrAdj_LHD_Fold_Stat_ST3'", "==", 1, "I_C03_MIRRFLD_STAT_FOLDED");
        __ReportCell(`BODY1::dbNode::`DM_FL::`DM_FL_BODY1_Container1_ST3_ExtMirr_FL_Stat_ST3::`MirrAdj_LHD_Fold_Stat_ST3);
        
        {
          dword __signalTime;
          __signalTime = getSignalTime(`BODY1::dbNode::`DM_FL::`DM_FL_BODY1_Container1_ST3_ExtMirr_FL_Stat_ST3::`MirrAdj_LHD_Fold_Stat_ST3);
          if (__signalTime > __signalTimes[0])
          {
            __ReportCell(__cEmpty);
          }
          else
          {
            __ReportCell("(no update)");
            __csr = 0;
          }
        }
        __ReportCellResult(__csr, __ePassFail);
        __ReportTableEndTestStep(__cEmpty);
      }
    }
  }
  TestCommandEnd();

  TestCommandBegin(__eWait, __cWait, "", "19");
  {
    __Wait("1", (1800 * 1000000000), 1000000000, "");
  }
  TestCommandEnd();

  TestCommandBegin(__eSet, __cSet, "", "21");
  {
  
    __ReportTableHead3Columns(__cSetCaption , __cTSym, __cTOp, __cAssigned); 
    {
      $`BODY1::dbNode::`EIS_BASE::`EIS_BODY1_Container_ST3_CLkS_Rq_ST3::`CLkS_Ext_Rq_ST3.phys = 2;
      __ReportSignalSetLValue("PDU signal 'CLkS_Ext_Rq_ST3'", `BODY1::dbNode::`EIS_BASE::`EIS_BODY1_Container_ST3_CLkS_Rq_ST3::`CLkS_Ext_Rq_ST3, __cArray);
      __ReportTableRow(0, __cArray, __cAOp, 2, "I_C02_CLKS_RQ_SNA_3H_UNLK");
    }
    __ReportTableEndTestStep("1");
  }
  TestCommandEnd();

  TestCommandBegin(__eAwaitValueMatch, __cAwaitValueMatch, "", "23");
  {
  
    dword __signalTimes[1];
    int64 __time;
    long __setFailed;
    __setFailed = 0;
    __time = 8 * 1000000000;
    if (__time < 0)
    {
      testStepErrorInTestSystem(0, "1", "Unable to wait for %.3f %s. Please check input parameter.", __time / ((float)1000000000), "s");
    }
    else
    {
      __signalTimes[0] = getSignalTime(`BODY1::dbNode::`DM_FL::`DM_FL_BODY1_Container1_ST3_ExtMirr_FL_Stat_ST3::`MirrAdj_LHD_Fold_Stat_ST3);
      snprintf(__cArray, elCount(__cArray), "PDU signal '%s'", "MirrAdj_LHD_Fold_Stat_ST3");
      __setFailed |= testJoinSignal(`BODY1::dbNode::`DM_FL::`DM_FL_BODY1_Container1_ST3_ExtMirr_FL_Stat_ST3::`MirrAdj_LHD_Fold_Stat_ST3, "__tt0Callback11", __cArray, 1) < 0;
      if (__setFailed != 0)
      {
        testStepErrorInTestSystem(0, "1", "Unable to set value condition.");
      }
      else
      {
        int64 __occurrenceTime;
        if (testWaitForAllJoinedEventsNS(__time) > 0)
        {
          testStepPass(2, "1", "Waited for occurrence of 1 value condition and signal updates.");
        }
        else
        {
          testStepFail(0, "1", "Waited for occurrence of 1 value condition and signal updates.");
        }
        __ReportTableHead6Columns(__cEmpty, __cTSym, __cTOp, __cRefVal, __cActual, __cEmpty, __cRes);
        __csr = CheckSignalMatch(`BODY1::dbNode::`DM_FL::`DM_FL_BODY1_Container1_ST3_ExtMirr_FL_Stat_ST3::`MirrAdj_LHD_Fold_Stat_ST3, 4, "==") == 1;
        __ReportTableRow(0, "PDU signal 'MirrAdj_LHD_Fold_Stat_ST3'", "==", 4, "I_C03_MIRRFLD_STAT_FOLD_OUT");
        __ReportCell(`BODY1::dbNode::`DM_FL::`DM_FL_BODY1_Container1_ST3_ExtMirr_FL_Stat_ST3::`MirrAdj_LHD_Fold_Stat_ST3);
        
        {
          dword __signalTime;
          __signalTime = getSignalTime(`BODY1::dbNode::`DM_FL::`DM_FL_BODY1_Container1_ST3_ExtMirr_FL_Stat_ST3::`MirrAdj_LHD_Fold_Stat_ST3);
          if (__signalTime > __signalTimes[0])
          {
            __ReportCell(__cEmpty);
          }
          else
          {
            __ReportCell("(no update)");
            __csr = 0;
          }
        }
        __ReportCellResult(__csr, __ePassFail);
        __ReportTableEndTestStep(__cEmpty);
      }
    }
  }
  TestCommandEnd();

  TestCommandBegin(__eAwaitValueMatch, __cAwaitValueMatch, "", "24");
  {
  
    dword __signalTimes[1];
    int64 __time;
    long __setFailed;
    __setFailed = 0;
    __time = 4.5 * 1000000000;
    if (__time < 0)
    {
      testStepErrorInTestSystem(0, "1", "Unable to wait for %.3f %s. Please check input parameter.", __time / ((float)1000000000), "s");
    }
    else
    {
      __signalTimes[0] = getSignalTime(`BODY1::dbNode::`DM_FL::`DM_FL_BODY1_Container1_ST3_ExtMirr_FL_Stat_ST3::`MirrAdj_LHD_Fold_Stat_ST3);
      snprintf(__cArray, elCount(__cArray), "PDU signal '%s'", "MirrAdj_LHD_Fold_Stat_ST3");
      __setFailed |= testJoinSignal(`BODY1::dbNode::`DM_FL::`DM_FL_BODY1_Container1_ST3_ExtMirr_FL_Stat_ST3::`MirrAdj_LHD_Fold_Stat_ST3, "__tt0Callback12", __cArray, 1) < 0;
      if (__setFailed != 0)
      {
        testStepErrorInTestSystem(0, "1", "Unable to set value condition.");
      }
      else
      {
        int64 __occurrenceTime;
        if (testWaitForAllJoinedEventsNS(__time) > 0)
        {
          testStepPass(2, "1", "Waited for occurrence of 1 value condition and signal updates.");
        }
        else
        {
          testStepFail(0, "1", "Waited for occurrence of 1 value condition and signal updates.");
        }
        __ReportTableHead6Columns(__cEmpty, __cTSym, __cTOp, __cRefVal, __cActual, __cEmpty, __cRes);
        __csr = CheckSignalMatch(`BODY1::dbNode::`DM_FL::`DM_FL_BODY1_Container1_ST3_ExtMirr_FL_Stat_ST3::`MirrAdj_LHD_Fold_Stat_ST3, 2, "==") == 1;
        __ReportTableRow(0, "PDU signal 'MirrAdj_LHD_Fold_Stat_ST3'", "==", 2, "I_C03_MIRRFLD_STAT_UNFOLDED");
        __ReportCell(`BODY1::dbNode::`DM_FL::`DM_FL_BODY1_Container1_ST3_ExtMirr_FL_Stat_ST3::`MirrAdj_LHD_Fold_Stat_ST3);
        
        {
          dword __signalTime;
          __signalTime = getSignalTime(`BODY1::dbNode::`DM_FL::`DM_FL_BODY1_Container1_ST3_ExtMirr_FL_Stat_ST3::`MirrAdj_LHD_Fold_Stat_ST3);
          if (__signalTime > __signalTimes[0])
          {
            __ReportCell(__cEmpty);
          }
          else
          {
            __ReportCell("(no update)");
            __csr = 0;
          }
        }
        __ReportCellResult(__csr, __ePassFail);
        __ReportTableEndTestStep(__cEmpty);
      }
    }
  }
  TestCommandEnd();

  TestCommandBegin(__eWait, __cWait, "", "25");
  {
    __Wait("1", (2 * 1000000000), 1000000000, "");
  }
  TestCommandEnd();

  TestCommandBegin(__eReport, __cReport, __cEmpty, "27");
  {
    __ReportTableHead2Columns("Mirror heating status", __cTSym, __cValue);
    __ReportSignal("PDU signal 'MirrHeat_FL_Stat_ST3'", `BODY1::dbNode::`DM_FL::`DM_FL_BODY1_Container1_ST3_ExtMirr_FL_Stat_ST3::`MirrHeat_FL_Stat_ST3, __cArray, 0 );
    testInfoRow(__tableHandle, 0, __cArray);
    __ReportCell(`BODY1::dbNode::`DM_FL::`DM_FL_BODY1_Container1_ST3_ExtMirr_FL_Stat_ST3::`MirrHeat_FL_Stat_ST3);
    __ReportSignal("PDU signal 'MirrHeat_FR_Stat_ST3'", `BODY1::dbNode::`DM_FR::`DM_FR_BODY1_Container1_ST3_ExtMirr_FR_Stat_ST3::`MirrHeat_FR_Stat_ST3, __cArray, 0 );
    testInfoRow(__tableHandle, 0, __cArray);
    __ReportCell(`BODY1::dbNode::`DM_FR::`DM_FR_BODY1_Container1_ST3_ExtMirr_FR_Stat_ST3::`MirrHeat_FR_Stat_ST3);
    __ReportTableEndTestStep(__cEmpty);
  }
  TestCommandEnd();

  TestCommandBegin(__eSet, __cSet, "", "28");
  {
  
    __ReportTableHead3Columns(__cSetCaption , __cTSym, __cTOp, __cAssigned); 
    {
      $`BODY1::dbNode::`BC_R::`BC_R_BODY1_Container2_ST3_BackliteHtr_Stat_ST3::`EBL_Stat_ST3.phys = 0;
      __ReportSignalSetLValue("PDU signal 'EBL_Stat_ST3'", `BODY1::dbNode::`BC_R::`BC_R_BODY1_Container2_ST3_BackliteHtr_Stat_ST3::`EBL_Stat_ST3, __cArray);
      __ReportTableRow(0, __cArray, __cAOp, 0, "I_C02_EBL_STAT_OFF");
    }
    __ReportTableEndTestStep("1");
  }
  TestCommandEnd();

  TestCommandBegin(__eWait, __cWait, "", "29");
  {
    __Wait("1", (2 * 1000000000), 1000000000, "");
  }
  TestCommandEnd();

  TestCommandBegin(__eReport, __cReport, __cEmpty, "30");
  {
    __ReportTableHead2Columns("Mirror heating status", __cTSym, __cValue);
    __ReportSignal("PDU signal 'MirrHeat_FL_Stat_ST3'", `BODY1::dbNode::`DM_FL::`DM_FL_BODY1_Container1_ST3_ExtMirr_FL_Stat_ST3::`MirrHeat_FL_Stat_ST3, __cArray, 0 );
    testInfoRow(__tableHandle, 0, __cArray);
    __ReportCell(`BODY1::dbNode::`DM_FL::`DM_FL_BODY1_Container1_ST3_ExtMirr_FL_Stat_ST3::`MirrHeat_FL_Stat_ST3);
    __ReportSignal("PDU signal 'MirrHeat_FR_Stat_ST3'", `BODY1::dbNode::`DM_FR::`DM_FR_BODY1_Container1_ST3_ExtMirr_FR_Stat_ST3::`MirrHeat_FR_Stat_ST3, __cArray, 0 );
    testInfoRow(__tableHandle, 0, __cArray);
    __ReportCell(`BODY1::dbNode::`DM_FR::`DM_FR_BODY1_Container1_ST3_ExtMirr_FR_Stat_ST3::`MirrHeat_FR_Stat_ST3);
    __ReportTableEndTestStep(__cEmpty);
  }
  TestCommandEnd();

  TestCommandBegin(__eSet, __cSet, "", "31");
  {
  
    __ReportTableHead3Columns(__cSetCaption , __cTSym, __cTOp, __cAssigned); 
    {
      $`BODY1::dbNode::`BC_F::`BC_F_BODY1_GW_Container_ST3_Ign_Stat_ST3::`ISw_Stat_ST3.phys = 4;
      __ReportSignalSetLValue("PDU signal 'ISw_Stat_ST3'", `BODY1::dbNode::`BC_F::`BC_F_BODY1_GW_Container_ST3_Ign_Stat_ST3::`ISw_Stat_ST3, __cArray);
      __ReportTableRow(0, __cArray, __cAOp, 4, "I_C03_ISW_STAT_IGN_ON");
    }
    __ReportTableEndTestStep("1");
  }
  TestCommandEnd();

  TestCommandBegin(__eWait, __cWait, "", "32");
  {
    __Wait("1", (2 * 1000000000), 1000000000, "");
  }
  TestCommandEnd();

}

dword __tt0Callback9(signal * __cbParam)
{

  __csr = CheckSignalMatch(__cbParam, 3, "==") == 1;
  return __csr;
}
dword __tt0Callback10(signal * __cbParam)
{

  __csr = CheckSignalMatch(__cbParam, 1, "==") == 1;
  return __csr;
}
dword __tt0Callback11(signal * __cbParam)
{

  __csr = CheckSignalMatch(__cbParam, 4, "==") == 1;
  return __csr;
}
dword __tt0Callback12(signal * __cbParam)
{

  __csr = CheckSignalMatch(__cbParam, 2, "==") == 1;
  return __csr;
}

testcase Tt0_Passenger_side_mirror_selection_adjustment(int64 iteration, int64 CSL_actuation_TimerMS)
{
  SetBreakOnFail(0);

  TestPreparationBegin();
  {
    TestCommandBegin(__eSet, __cSet, "", "0");
    {
    
      __ReportTableHead3Columns(__cSetCaption , __cTSym, __cTOp, __cAssigned); 
      {
        $`BODY1::dbNode::`BC_F::`BC_F_BODY1_GW_Container_ST3_ExtMirr_Settings_ST3::`MirrFldPk_Rq_ST3.phys = 1;
        __ReportSignalSetLValue("PDU signal 'MirrFldPk_Rq_ST3'", `BODY1::dbNode::`BC_F::`BC_F_BODY1_GW_Container_ST3_ExtMirr_Settings_ST3::`MirrFldPk_Rq_ST3, __cArray);
        __ReportTableRow(0, __cArray, __cAOp, 1, "I_C02_OFF_ON_ON");
      }
      __ReportTableEndTestStep("1");
    }
    TestCommandEnd();

    TestCommandBegin(__eWait, __cWait, "", "1");
    {
      __Wait("1", (2 * 1000000000), 1000000000, "");
    }
    TestCommandEnd();

  }
  TestPreparationEnd();

  TestCommandBegin(__eReport, __cReport, __cEmpty, "2");
  {
    __ReportTableHead2Columns("Mirror glass position status", __cTSym, __cValue);
    __ReportSignal("PDU signal 'MirrPosnX_P_ActualPosn_ST3'", `BODY1::dbNode::`DM_FL::`DM_BODY1_ContainerExtMirrMaster_ST3_ExtMirr_Master_Stat_ST3::`MirrPosnX_P_ActualPosn_ST3, __cArray, 0 );
    testInfoRow(__tableHandle, 0, __cArray);
    __ReportCell(`BODY1::dbNode::`DM_FL::`DM_BODY1_ContainerExtMirrMaster_ST3_ExtMirr_Master_Stat_ST3::`MirrPosnX_P_ActualPosn_ST3);
    __ReportSignal("PDU signal 'MirrPosnY_P_ActualPosn_ST3'", `BODY1::dbNode::`DM_FL::`DM_BODY1_ContainerExtMirrMaster_ST3_ExtMirr_Master_Stat_ST3::`MirrPosnY_P_ActualPosn_ST3, __cArray, 0 );
    testInfoRow(__tableHandle, 0, __cArray);
    __ReportCell(`BODY1::dbNode::`DM_FL::`DM_BODY1_ContainerExtMirrMaster_ST3_ExtMirr_Master_Stat_ST3::`MirrPosnY_P_ActualPosn_ST3);
    __ReportTableEndTestStep(__cEmpty);
  }
  TestCommandEnd();

  TestCommandBegin(__eSet, __cSet, "", "3");
  {
  
    __ReportTableHead3Columns(__cSetCaption , __cTSym, __cTOp, __cAssigned); 
    {
      $`LinDB::dbNode::`DSM_WM_DOOR::`DSM_WM_Frm1_AR_DOOR::`MirrSelRtSw_Psd_DOOR.phys = 1;
      __ReportSignalSetLValue("LIN signal 'MirrSelRtSw_Psd_DOOR'", `LinDB::dbNode::`DSM_WM_DOOR::`DSM_WM_Frm1_AR_DOOR::`MirrSelRtSw_Psd_DOOR, __cArray);
      __ReportTableRow(0, __cArray, __cAOp, 1, "");
    }
    __ReportTableEndTestStep("1");
  }
  TestCommandEnd();

  TestCommandBegin(__eWait, __cWait, "", "4");
  {
    __Wait("1", (300 * 1000000), 1000000, "");
  }
  TestCommandEnd();

  TestCommandBegin(__eCheck, __cCheck, "", "5");
  {
    __bVerdict = __eVerdictPass;
    __ReportTableHead5Columns(__cCheckCaption, __cTSym, __cTOp, __cRefVal, __cActual, __cRes);
    {
      __csr = CheckSignalMatch(`BODY1::dbNode::`DM_FL::`DM_FL_BODY1_Container1_ST3_ExtMirr_FL_Stat_ST3::`MirrAdj_LHD_Sel_Stat_ST3, 2, "==") == 1;
      __ReportTableRow(0, "PDU signal 'MirrAdj_LHD_Sel_Stat_ST3'", "==", 2, "I_C02_MIRRADJSW_STAT_PSG");
      __ReportCell(`BODY1::dbNode::`DM_FL::`DM_FL_BODY1_Container1_ST3_ExtMirr_FL_Stat_ST3::`MirrAdj_LHD_Sel_Stat_ST3);
      __ReportCellResult(__csr, __ePassFail);
      __bVerdict = __bVerdict && __csr;
    }
    __ReportTableEndVerdict("1", __bVerdict);
  }
  TestCommandEnd();

  TestCommandBegin(__eWait, __cWait, "", "6");
  {
    __Wait("1", (100 * 1000000), 1000000, "");
  }
  TestCommandEnd();

  TestCommandBegin(__eSet, __cSet, "", "7");
  {
  
    __ReportTableHead3Columns(__cSetCaption , __cTSym, __cTOp, __cAssigned); 
    {
      $`LinDB::dbNode::`DSM_WM_DOOR::`DSM_WM_Frm1_AR_DOOR::`MirrAdjDnSw_Psd_DOOR.phys = 1;
      __ReportSignalSetLValue("LIN signal 'MirrAdjDnSw_Psd_DOOR'", `LinDB::dbNode::`DSM_WM_DOOR::`DSM_WM_Frm1_AR_DOOR::`MirrAdjDnSw_Psd_DOOR, __cArray);
      __ReportTableRow(0, __cArray, __cAOp, 1, "");
    }
    __ReportTableEndTestStep("1");
  }
  TestCommandEnd();

  TestCommandBegin(__eWait, __cWait, "", "8");
  {
    __Wait("1", (1 * 1000000000), 1000000000, "");
  }
  TestCommandEnd();

  TestCommandBegin(__eSet, __cSet, "", "9");
  {
  
    __ReportTableHead3Columns(__cSetCaption , __cTSym, __cTOp, __cAssigned); 
    {
      $`LinDB::dbNode::`DSM_WM_DOOR::`DSM_WM_Frm1_AR_DOOR::`MirrAdjLtSw_Psd_DOOR.phys = 1;
      __ReportSignalSetLValue("LIN signal 'MirrAdjLtSw_Psd_DOOR'", `LinDB::dbNode::`DSM_WM_DOOR::`DSM_WM_Frm1_AR_DOOR::`MirrAdjLtSw_Psd_DOOR, __cArray);
      __ReportTableRow(0, __cArray, __cAOp, 1, "");
    }
    __ReportTableEndTestStep("1");
  }
  TestCommandEnd();

  TestCommandBegin(__eWait, __cWait, "", "10");
  {
    __Wait("1", (1 * 1000000000), 1000000000, "");
  }
  TestCommandEnd();

  TestCommandBegin(__eSet, __cSet, "", "11");
  {
  
    __ReportTableHead3Columns(__cSetCaption , __cTSym, __cTOp, __cAssigned); 
    {
      $`LinDB::dbNode::`DSM_WM_DOOR::`DSM_WM_Frm1_AR_DOOR::`MirrAdjRtSw_Psd_DOOR.phys = 1;
      __ReportSignalSetLValue("LIN signal 'MirrAdjRtSw_Psd_DOOR'", `LinDB::dbNode::`DSM_WM_DOOR::`DSM_WM_Frm1_AR_DOOR::`MirrAdjRtSw_Psd_DOOR, __cArray);
      __ReportTableRow(0, __cArray, __cAOp, 1, "");
    }
    __ReportTableEndTestStep("1");
  }
  TestCommandEnd();

  TestCommandBegin(__eWait, __cWait, "", "12");
  {
    __Wait("1", (1 * 1000000000), 1000000000, "");
  }
  TestCommandEnd();

  TestCommandBegin(__eSet, __cSet, "", "13");
  {
  
    __ReportTableHead3Columns(__cSetCaption , __cTSym, __cTOp, __cAssigned); 
    {
      $`LinDB::dbNode::`DSM_WM_DOOR::`DSM_WM_Frm1_AR_DOOR::`MirrAdjUpSw_Psd_DOOR.phys = 1;
      __ReportSignalSetLValue("LIN signal 'MirrAdjUpSw_Psd_DOOR'", `LinDB::dbNode::`DSM_WM_DOOR::`DSM_WM_Frm1_AR_DOOR::`MirrAdjUpSw_Psd_DOOR, __cArray);
      __ReportTableRow(0, __cArray, __cAOp, 1, "");
    }
    __ReportTableEndTestStep("1");
  }
  TestCommandEnd();

  TestCommandBegin(__eWait, __cWait, "", "14");
  {
    __Wait("1", (1 * 1000000000), 1000000000, "");
  }
  TestCommandEnd();

  TestCommandBegin(__eWait, __cWait, "", "15");
  {
    __Wait("1", (500 * 1000000), 1000000, "");
  }
  TestCommandEnd();

  TestCommandBegin(__eReport, __cReport, __cEmpty, "16");
  {
    __ReportTableHead2Columns("Mirror glass position status", __cTSym, __cValue);
    __ReportSignal("PDU signal 'MirrPosnX_P_ActualPosn_ST3'", `BODY1::dbNode::`DM_FL::`DM_BODY1_ContainerExtMirrMaster_ST3_ExtMirr_Master_Stat_ST3::`MirrPosnX_P_ActualPosn_ST3, __cArray, 0 );
    testInfoRow(__tableHandle, 0, __cArray);
    __ReportCell(`BODY1::dbNode::`DM_FL::`DM_BODY1_ContainerExtMirrMaster_ST3_ExtMirr_Master_Stat_ST3::`MirrPosnX_P_ActualPosn_ST3);
    __ReportSignal("PDU signal 'MirrPosnY_P_ActualPosn_ST3'", `BODY1::dbNode::`DM_FL::`DM_BODY1_ContainerExtMirrMaster_ST3_ExtMirr_Master_Stat_ST3::`MirrPosnY_P_ActualPosn_ST3, __cArray, 0 );
    testInfoRow(__tableHandle, 0, __cArray);
    __ReportCell(`BODY1::dbNode::`DM_FL::`DM_BODY1_ContainerExtMirrMaster_ST3_ExtMirr_Master_Stat_ST3::`MirrPosnY_P_ActualPosn_ST3);
    __ReportTableEndTestStep(__cEmpty);
  }
  TestCommandEnd();

  TestCommandBegin(__eWait, __cWait, "", "18");
  {
    __Wait("1", (2 * 1000000000), 1000000000, "");
  }
  TestCommandEnd();

  TestCommandBegin(__eSet, __cSet, "", "20");
  {
  
    __ReportTableHead3Columns(__cSetCaption , __cTSym, __cTOp, __cAssigned); 
    {
      $`BODY1::dbNode::`BC_F::`BC_F_BODY1_GW_Container_ST3_Ign_Stat_ST3::`ISw_Stat_ST3.phys = 0;
      __ReportSignalSetLValue("PDU signal 'ISw_Stat_ST3'", `BODY1::dbNode::`BC_F::`BC_F_BODY1_GW_Container_ST3_Ign_Stat_ST3::`ISw_Stat_ST3, __cArray);
      __ReportTableRow(0, __cArray, __cAOp, 0, "I_C03_ISW_STAT_IGN_LOCK");
    }
    __ReportTableEndTestStep("1");
  }
  TestCommandEnd();

  TestCommandBegin(__eWait, __cWait, "", "21");
  {
    __Wait("1", (2 * 1000000000), 1000000000, "");
  }
  TestCommandEnd();

  TestCommandBegin(__eSet, __cSet, "", "22");
  {
  
    __ReportTableHead3Columns(__cSetCaption , __cTSym, __cTOp, __cAssigned); 
    {
      $`BODY1::dbNode::`BC_F::`BC_F_BODY1_GW_Container_ST3_CLkS_Dr_State_ST3::`DrRLtch_FL_Stat_ST3.phys = 1;
      __ReportSignalSetLValue("PDU signal 'DrRLtch_FL_Stat_ST3'", `BODY1::dbNode::`BC_F::`BC_F_BODY1_GW_Container_ST3_CLkS_Dr_State_ST3::`DrRLtch_FL_Stat_ST3, __cArray);
      __ReportTableRow(0, __cArray, __cAOp, 1, "I_C02_DR_STAT_CLS");
    }
    {
      $`BODY1::dbNode::`BC_F::`BC_F_BODY1_GW_Container_ST3_CLkS_Dr_State_ST3::`DrRLtch_FR_Stat_ST3.phys = 1;
      __ReportSignalSetLValue("PDU signal 'DrRLtch_FR_Stat_ST3'", `BODY1::dbNode::`BC_F::`BC_F_BODY1_GW_Container_ST3_CLkS_Dr_State_ST3::`DrRLtch_FR_Stat_ST3, __cArray);
      __ReportTableRow(0, __cArray, __cAOp, 1, "I_C02_DR_STAT_CLS");
    }
    {
      $`BODY1::dbNode::`BC_F::`BC_F_BODY1_GW_Container_ST3_CLkS_Dr_State_ST3::`DrRLtch_RL_Stat_ST3.phys = 1;
      __ReportSignalSetLValue("PDU signal 'DrRLtch_RL_Stat_ST3'", `BODY1::dbNode::`BC_F::`BC_F_BODY1_GW_Container_ST3_CLkS_Dr_State_ST3::`DrRLtch_RL_Stat_ST3, __cArray);
      __ReportTableRow(0, __cArray, __cAOp, 1, "I_C02_DR_STAT_CLS");
    }
    {
      $`BODY1::dbNode::`BC_F::`BC_F_BODY1_GW_Container_ST3_CLkS_Dr_State_ST3::`DrRLtch_RR_Stat_ST3.phys = 1;
      __ReportSignalSetLValue("PDU signal 'DrRLtch_RR_Stat_ST3'", `BODY1::dbNode::`BC_F::`BC_F_BODY1_GW_Container_ST3_CLkS_Dr_State_ST3::`DrRLtch_RR_Stat_ST3, __cArray);
      __ReportTableRow(0, __cArray, __cAOp, 1, "I_C02_DR_STAT_CLS");
    }
    __ReportTableEndTestStep("1");
  }
  TestCommandEnd();

  TestCommandBegin(__eWait, __cWait, "", "23");
  {
    __Wait("1", (2 * 1000000000), 1000000000, "");
  }
  TestCommandEnd();

  TestCommandBegin(__eSet, __cSet, "", "25");
  {
  
    __ReportTableHead3Columns(__cSetCaption , __cTSym, __cTOp, __cAssigned); 
    {
      $`BODY1::dbNode::`EIS_BASE::`EIS_BODY1_Container_ST3_CLkS_Rq_ST3::`CLkS_Ext_Rq_ST3.phys = 1;
      __ReportSignalSetLValue("PDU signal 'CLkS_Ext_Rq_ST3'", `BODY1::dbNode::`EIS_BASE::`EIS_BODY1_Container_ST3_CLkS_Rq_ST3::`CLkS_Ext_Rq_ST3, __cArray);
      __ReportTableRow(0, __cArray, __cAOp, 1, "I_C02_CLKS_RQ_SNA_3H_LK");
    }
    __ReportTableEndTestStep("1");
  }
  TestCommandEnd();

  TestCommandBegin(__eAwaitValueMatch, __cAwaitValueMatch, "", "27");
  {
  
    dword __signalTimes[1];
    int64 __time;
    long __setFailed;
    __setFailed = 0;
    __time = 8 * 1000000000;
    if (__time < 0)
    {
      testStepErrorInTestSystem(0, "1", "Unable to wait for %.3f %s. Please check input parameter.", __time / ((float)1000000000), "s");
    }
    else
    {
      __signalTimes[0] = getSignalTime(`BODY1::dbNode::`DM_FL::`DM_FL_BODY1_Container1_ST3_ExtMirr_FL_Stat_ST3::`MirrAdj_LHD_Fold_Stat_ST3);
      snprintf(__cArray, elCount(__cArray), "PDU signal '%s'", "MirrAdj_LHD_Fold_Stat_ST3");
      __setFailed |= testJoinSignal(`BODY1::dbNode::`DM_FL::`DM_FL_BODY1_Container1_ST3_ExtMirr_FL_Stat_ST3::`MirrAdj_LHD_Fold_Stat_ST3, "__tt0Callback13", __cArray, 1) < 0;
      if (__setFailed != 0)
      {
        testStepErrorInTestSystem(0, "1", "Unable to set value condition.");
      }
      else
      {
        int64 __occurrenceTime;
        if (testWaitForAllJoinedEventsNS(__time) > 0)
        {
          testStepPass(2, "1", "Waited for occurrence of 1 value condition and signal updates.");
        }
        else
        {
          testStepFail(0, "1", "Waited for occurrence of 1 value condition and signal updates.");
        }
        __ReportTableHead6Columns(__cEmpty, __cTSym, __cTOp, __cRefVal, __cActual, __cEmpty, __cRes);
        __csr = CheckSignalMatch(`BODY1::dbNode::`DM_FL::`DM_FL_BODY1_Container1_ST3_ExtMirr_FL_Stat_ST3::`MirrAdj_LHD_Fold_Stat_ST3, 3, "==") == 1;
        __ReportTableRow(0, "PDU signal 'MirrAdj_LHD_Fold_Stat_ST3'", "==", 3, "I_C03_MIRRFLD_STAT_FOLD_IN");
        __ReportCell(`BODY1::dbNode::`DM_FL::`DM_FL_BODY1_Container1_ST3_ExtMirr_FL_Stat_ST3::`MirrAdj_LHD_Fold_Stat_ST3);
        
        {
          dword __signalTime;
          __signalTime = getSignalTime(`BODY1::dbNode::`DM_FL::`DM_FL_BODY1_Container1_ST3_ExtMirr_FL_Stat_ST3::`MirrAdj_LHD_Fold_Stat_ST3);
          if (__signalTime > __signalTimes[0])
          {
            __ReportCell(__cEmpty);
          }
          else
          {
            __ReportCell("(no update)");
            __csr = 0;
          }
        }
        __ReportCellResult(__csr, __ePassFail);
        __ReportTableEndTestStep(__cEmpty);
      }
    }
  }
  TestCommandEnd();

  TestCommandBegin(__eAwaitValueMatch, __cAwaitValueMatch, "", "28");
  {
  
    dword __signalTimes[1];
    int64 __time;
    long __setFailed;
    __setFailed = 0;
    __time = 4.5 * 1000000000;
    if (__time < 0)
    {
      testStepErrorInTestSystem(0, "1", "Unable to wait for %.3f %s. Please check input parameter.", __time / ((float)1000000000), "s");
    }
    else
    {
      __signalTimes[0] = getSignalTime(`BODY1::dbNode::`DM_FL::`DM_FL_BODY1_Container1_ST3_ExtMirr_FL_Stat_ST3::`MirrAdj_LHD_Fold_Stat_ST3);
      snprintf(__cArray, elCount(__cArray), "PDU signal '%s'", "MirrAdj_LHD_Fold_Stat_ST3");
      __setFailed |= testJoinSignal(`BODY1::dbNode::`DM_FL::`DM_FL_BODY1_Container1_ST3_ExtMirr_FL_Stat_ST3::`MirrAdj_LHD_Fold_Stat_ST3, "__tt0Callback14", __cArray, 1) < 0;
      if (__setFailed != 0)
      {
        testStepErrorInTestSystem(0, "1", "Unable to set value condition.");
      }
      else
      {
        int64 __occurrenceTime;
        if (testWaitForAllJoinedEventsNS(__time) > 0)
        {
          testStepPass(2, "1", "Waited for occurrence of 1 value condition and signal updates.");
        }
        else
        {
          testStepFail(0, "1", "Waited for occurrence of 1 value condition and signal updates.");
        }
        __ReportTableHead6Columns(__cEmpty, __cTSym, __cTOp, __cRefVal, __cActual, __cEmpty, __cRes);
        __csr = CheckSignalMatch(`BODY1::dbNode::`DM_FL::`DM_FL_BODY1_Container1_ST3_ExtMirr_FL_Stat_ST3::`MirrAdj_LHD_Fold_Stat_ST3, 1, "==") == 1;
        __ReportTableRow(0, "PDU signal 'MirrAdj_LHD_Fold_Stat_ST3'", "==", 1, "I_C03_MIRRFLD_STAT_FOLDED");
        __ReportCell(`BODY1::dbNode::`DM_FL::`DM_FL_BODY1_Container1_ST3_ExtMirr_FL_Stat_ST3::`MirrAdj_LHD_Fold_Stat_ST3);
        
        {
          dword __signalTime;
          __signalTime = getSignalTime(`BODY1::dbNode::`DM_FL::`DM_FL_BODY1_Container1_ST3_ExtMirr_FL_Stat_ST3::`MirrAdj_LHD_Fold_Stat_ST3);
          if (__signalTime > __signalTimes[0])
          {
            __ReportCell(__cEmpty);
          }
          else
          {
            __ReportCell("(no update)");
            __csr = 0;
          }
        }
        __ReportCellResult(__csr, __ePassFail);
        __ReportTableEndTestStep(__cEmpty);
      }
    }
  }
  TestCommandEnd();

  TestCommandBegin(__eWait, __cWait, "", "29");
  {
    __Wait("1", (1800 * 1000000000), 1000000000, "");
  }
  TestCommandEnd();

  TestCommandBegin(__eSet, __cSet, "", "31");
  {
  
    __ReportTableHead3Columns(__cSetCaption , __cTSym, __cTOp, __cAssigned); 
    {
      $`BODY1::dbNode::`EIS_BASE::`EIS_BODY1_Container_ST3_CLkS_Rq_ST3::`CLkS_Ext_Rq_ST3.phys = 2;
      __ReportSignalSetLValue("PDU signal 'CLkS_Ext_Rq_ST3'", `BODY1::dbNode::`EIS_BASE::`EIS_BODY1_Container_ST3_CLkS_Rq_ST3::`CLkS_Ext_Rq_ST3, __cArray);
      __ReportTableRow(0, __cArray, __cAOp, 2, "I_C02_CLKS_RQ_SNA_3H_UNLK");
    }
    __ReportTableEndTestStep("1");
  }
  TestCommandEnd();

  TestCommandBegin(__eAwaitValueMatch, __cAwaitValueMatch, "", "33");
  {
  
    dword __signalTimes[1];
    int64 __time;
    long __setFailed;
    __setFailed = 0;
    __time = 8 * 1000000000;
    if (__time < 0)
    {
      testStepErrorInTestSystem(0, "1", "Unable to wait for %.3f %s. Please check input parameter.", __time / ((float)1000000000), "s");
    }
    else
    {
      __signalTimes[0] = getSignalTime(`BODY1::dbNode::`DM_FL::`DM_FL_BODY1_Container1_ST3_ExtMirr_FL_Stat_ST3::`MirrAdj_LHD_Fold_Stat_ST3);
      snprintf(__cArray, elCount(__cArray), "PDU signal '%s'", "MirrAdj_LHD_Fold_Stat_ST3");
      __setFailed |= testJoinSignal(`BODY1::dbNode::`DM_FL::`DM_FL_BODY1_Container1_ST3_ExtMirr_FL_Stat_ST3::`MirrAdj_LHD_Fold_Stat_ST3, "__tt0Callback15", __cArray, 1) < 0;
      if (__setFailed != 0)
      {
        testStepErrorInTestSystem(0, "1", "Unable to set value condition.");
      }
      else
      {
        int64 __occurrenceTime;
        if (testWaitForAllJoinedEventsNS(__time) > 0)
        {
          testStepPass(2, "1", "Waited for occurrence of 1 value condition and signal updates.");
        }
        else
        {
          testStepFail(0, "1", "Waited for occurrence of 1 value condition and signal updates.");
        }
        __ReportTableHead6Columns(__cEmpty, __cTSym, __cTOp, __cRefVal, __cActual, __cEmpty, __cRes);
        __csr = CheckSignalMatch(`BODY1::dbNode::`DM_FL::`DM_FL_BODY1_Container1_ST3_ExtMirr_FL_Stat_ST3::`MirrAdj_LHD_Fold_Stat_ST3, 4, "==") == 1;
        __ReportTableRow(0, "PDU signal 'MirrAdj_LHD_Fold_Stat_ST3'", "==", 4, "I_C03_MIRRFLD_STAT_FOLD_OUT");
        __ReportCell(`BODY1::dbNode::`DM_FL::`DM_FL_BODY1_Container1_ST3_ExtMirr_FL_Stat_ST3::`MirrAdj_LHD_Fold_Stat_ST3);
        
        {
          dword __signalTime;
          __signalTime = getSignalTime(`BODY1::dbNode::`DM_FL::`DM_FL_BODY1_Container1_ST3_ExtMirr_FL_Stat_ST3::`MirrAdj_LHD_Fold_Stat_ST3);
          if (__signalTime > __signalTimes[0])
          {
            __ReportCell(__cEmpty);
          }
          else
          {
            __ReportCell("(no update)");
            __csr = 0;
          }
        }
        __ReportCellResult(__csr, __ePassFail);
        __ReportTableEndTestStep(__cEmpty);
      }
    }
  }
  TestCommandEnd();

  TestCommandBegin(__eAwaitValueMatch, __cAwaitValueMatch, "", "34");
  {
  
    dword __signalTimes[1];
    int64 __time;
    long __setFailed;
    __setFailed = 0;
    __time = 4.5 * 1000000000;
    if (__time < 0)
    {
      testStepErrorInTestSystem(0, "1", "Unable to wait for %.3f %s. Please check input parameter.", __time / ((float)1000000000), "s");
    }
    else
    {
      __signalTimes[0] = getSignalTime(`BODY1::dbNode::`DM_FL::`DM_FL_BODY1_Container1_ST3_ExtMirr_FL_Stat_ST3::`MirrAdj_LHD_Fold_Stat_ST3);
      snprintf(__cArray, elCount(__cArray), "PDU signal '%s'", "MirrAdj_LHD_Fold_Stat_ST3");
      __setFailed |= testJoinSignal(`BODY1::dbNode::`DM_FL::`DM_FL_BODY1_Container1_ST3_ExtMirr_FL_Stat_ST3::`MirrAdj_LHD_Fold_Stat_ST3, "__tt0Callback16", __cArray, 1) < 0;
      if (__setFailed != 0)
      {
        testStepErrorInTestSystem(0, "1", "Unable to set value condition.");
      }
      else
      {
        int64 __occurrenceTime;
        if (testWaitForAllJoinedEventsNS(__time) > 0)
        {
          testStepPass(2, "1", "Waited for occurrence of 1 value condition and signal updates.");
        }
        else
        {
          testStepFail(0, "1", "Waited for occurrence of 1 value condition and signal updates.");
        }
        __ReportTableHead6Columns(__cEmpty, __cTSym, __cTOp, __cRefVal, __cActual, __cEmpty, __cRes);
        __csr = CheckSignalMatch(`BODY1::dbNode::`DM_FL::`DM_FL_BODY1_Container1_ST3_ExtMirr_FL_Stat_ST3::`MirrAdj_LHD_Fold_Stat_ST3, 2, "==") == 1;
        __ReportTableRow(0, "PDU signal 'MirrAdj_LHD_Fold_Stat_ST3'", "==", 2, "I_C03_MIRRFLD_STAT_UNFOLDED");
        __ReportCell(`BODY1::dbNode::`DM_FL::`DM_FL_BODY1_Container1_ST3_ExtMirr_FL_Stat_ST3::`MirrAdj_LHD_Fold_Stat_ST3);
        
        {
          dword __signalTime;
          __signalTime = getSignalTime(`BODY1::dbNode::`DM_FL::`DM_FL_BODY1_Container1_ST3_ExtMirr_FL_Stat_ST3::`MirrAdj_LHD_Fold_Stat_ST3);
          if (__signalTime > __signalTimes[0])
          {
            __ReportCell(__cEmpty);
          }
          else
          {
            __ReportCell("(no update)");
            __csr = 0;
          }
        }
        __ReportCellResult(__csr, __ePassFail);
        __ReportTableEndTestStep(__cEmpty);
      }
    }
  }
  TestCommandEnd();

  TestCommandBegin(__eWait, __cWait, "", "35");
  {
    __Wait("1", (2 * 1000000000), 1000000000, "");
  }
  TestCommandEnd();

  TestCommandBegin(__eSet, __cSet, "", "37");
  {
  
    __ReportTableHead3Columns(__cSetCaption , __cTSym, __cTOp, __cAssigned); 
    {
      $`LinDB::dbNode::`DSM_WM_DOOR::`DSM_WM_Frm1_AR_DOOR::`MirrSelRtSw_Psd_DOOR.phys = 0;
      __ReportSignalSetLValue("LIN signal 'MirrSelRtSw_Psd_DOOR'", `LinDB::dbNode::`DSM_WM_DOOR::`DSM_WM_Frm1_AR_DOOR::`MirrSelRtSw_Psd_DOOR, __cArray);
      __ReportTableRow(0, __cArray, __cAOp, 0, "");
    }
    __ReportTableEndTestStep("1");
  }
  TestCommandEnd();

  TestCommandBegin(__eWait, __cWait, "", "38");
  {
    __Wait("1", (300 * 1000000), 1000000, "");
  }
  TestCommandEnd();

  TestCommandBegin(__eSet, __cSet, "", "39");
  {
  
    __ReportTableHead3Columns(__cSetCaption , __cTSym, __cTOp, __cAssigned); 
    {
      $`BODY1::dbNode::`BC_F::`BC_F_BODY1_GW_Container_ST3_Ign_Stat_ST3::`ISw_Stat_ST3.phys = 4;
      __ReportSignalSetLValue("PDU signal 'ISw_Stat_ST3'", `BODY1::dbNode::`BC_F::`BC_F_BODY1_GW_Container_ST3_Ign_Stat_ST3::`ISw_Stat_ST3, __cArray);
      __ReportTableRow(0, __cArray, __cAOp, 4, "I_C03_ISW_STAT_IGN_ON");
    }
    __ReportTableEndTestStep("1");
  }
  TestCommandEnd();

  TestCommandBegin(__eWait, __cWait, "", "40");
  {
    __Wait("1", (2 * 1000000000), 1000000000, "");
  }
  TestCommandEnd();

}

dword __tt0Callback13(signal * __cbParam)
{

  __csr = CheckSignalMatch(__cbParam, 3, "==") == 1;
  return __csr;
}
dword __tt0Callback14(signal * __cbParam)
{

  __csr = CheckSignalMatch(__cbParam, 1, "==") == 1;
  return __csr;
}
dword __tt0Callback15(signal * __cbParam)
{

  __csr = CheckSignalMatch(__cbParam, 4, "==") == 1;
  return __csr;
}
dword __tt0Callback16(signal * __cbParam)
{

  __csr = CheckSignalMatch(__cbParam, 2, "==") == 1;
  return __csr;
}

testcase Tt0_Passenger_side_mirror_selection(int64 iteration, int64 CSL_actuation_TimerMS)
{
  SetBreakOnFail(0);

  TestPreparationBegin();
  {
    TestCommandBegin(__eSet, __cSet, "", "0");
    {
    
      __ReportTableHead3Columns(__cSetCaption , __cTSym, __cTOp, __cAssigned); 
      {
        $`BODY1::dbNode::`BC_F::`BC_F_BODY1_GW_Container_ST3_ExtMirr_Settings_ST3::`MirrFldPk_Rq_ST3.phys = 1;
        __ReportSignalSetLValue("PDU signal 'MirrFldPk_Rq_ST3'", `BODY1::dbNode::`BC_F::`BC_F_BODY1_GW_Container_ST3_ExtMirr_Settings_ST3::`MirrFldPk_Rq_ST3, __cArray);
        __ReportTableRow(0, __cArray, __cAOp, 1, "I_C02_OFF_ON_ON");
      }
      __ReportTableEndTestStep("1");
    }
    TestCommandEnd();

    TestCommandBegin(__eWait, __cWait, "", "1");
    {
      __Wait("1", (2 * 1000000000), 1000000000, "");
    }
    TestCommandEnd();

  }
  TestPreparationEnd();

  TestCommandBegin(__eReport, __cReport, __cEmpty, "2");
  {
    __ReportTableHead2Columns("Mirror glass position status", __cTSym, __cValue);
    __ReportSignal("PDU signal 'MirrPosnX_P_ActualPosn_ST3'", `BODY1::dbNode::`DM_FL::`DM_BODY1_ContainerExtMirrMaster_ST3_ExtMirr_Master_Stat_ST3::`MirrPosnX_P_ActualPosn_ST3, __cArray, 0 );
    testInfoRow(__tableHandle, 0, __cArray);
    __ReportCell(`BODY1::dbNode::`DM_FL::`DM_BODY1_ContainerExtMirrMaster_ST3_ExtMirr_Master_Stat_ST3::`MirrPosnX_P_ActualPosn_ST3);
    __ReportSignal("PDU signal 'MirrPosnY_P_ActualPosn_ST3'", `BODY1::dbNode::`DM_FL::`DM_BODY1_ContainerExtMirrMaster_ST3_ExtMirr_Master_Stat_ST3::`MirrPosnY_P_ActualPosn_ST3, __cArray, 0 );
    testInfoRow(__tableHandle, 0, __cArray);
    __ReportCell(`BODY1::dbNode::`DM_FL::`DM_BODY1_ContainerExtMirrMaster_ST3_ExtMirr_Master_Stat_ST3::`MirrPosnY_P_ActualPosn_ST3);
    __ReportTableEndTestStep(__cEmpty);
  }
  TestCommandEnd();

  TestCommandBegin(__eSet, __cSet, "", "3");
  {
  
    __ReportTableHead3Columns(__cSetCaption , __cTSym, __cTOp, __cAssigned); 
    {
      $`LinDB::dbNode::`DSM_WM_DOOR::`DSM_WM_Frm1_AR_DOOR::`MirrSelRtSw_Psd_DOOR.phys = 1;
      __ReportSignalSetLValue("LIN signal 'MirrSelRtSw_Psd_DOOR'", `LinDB::dbNode::`DSM_WM_DOOR::`DSM_WM_Frm1_AR_DOOR::`MirrSelRtSw_Psd_DOOR, __cArray);
      __ReportTableRow(0, __cArray, __cAOp, 1, "");
    }
    __ReportTableEndTestStep("1");
  }
  TestCommandEnd();

  TestCommandBegin(__eWait, __cWait, "", "4");
  {
    __Wait("1", (300 * 1000000), 1000000, "");
  }
  TestCommandEnd();

  TestCommandBegin(__eCheck, __cCheck, "", "5");
  {
    __bVerdict = __eVerdictPass;
    __ReportTableHead5Columns(__cCheckCaption, __cTSym, __cTOp, __cRefVal, __cActual, __cRes);
    {
      __csr = CheckSignalMatch(`BODY1::dbNode::`DM_FL::`DM_FL_BODY1_Container1_ST3_ExtMirr_FL_Stat_ST3::`MirrAdj_LHD_Sel_Stat_ST3, 2, "==") == 1;
      __ReportTableRow(0, "PDU signal 'MirrAdj_LHD_Sel_Stat_ST3'", "==", 2, "I_C02_MIRRADJSW_STAT_PSG");
      __ReportCell(`BODY1::dbNode::`DM_FL::`DM_FL_BODY1_Container1_ST3_ExtMirr_FL_Stat_ST3::`MirrAdj_LHD_Sel_Stat_ST3);
      __ReportCellResult(__csr, __ePassFail);
      __bVerdict = __bVerdict && __csr;
    }
    __ReportTableEndVerdict("1", __bVerdict);
  }
  TestCommandEnd();

  TestCommandBegin(__eWait, __cWait, "", "7");
  {
    __Wait("1", (2 * 1000000000), 1000000000, "");
  }
  TestCommandEnd();

  TestCommandBegin(__eSet, __cSet, "", "9");
  {
  
    __ReportTableHead3Columns(__cSetCaption , __cTSym, __cTOp, __cAssigned); 
    {
      $`BODY1::dbNode::`BC_F::`BC_F_BODY1_GW_Container_ST3_Ign_Stat_ST3::`ISw_Stat_ST3.phys = 0;
      __ReportSignalSetLValue("PDU signal 'ISw_Stat_ST3'", `BODY1::dbNode::`BC_F::`BC_F_BODY1_GW_Container_ST3_Ign_Stat_ST3::`ISw_Stat_ST3, __cArray);
      __ReportTableRow(0, __cArray, __cAOp, 0, "I_C03_ISW_STAT_IGN_LOCK");
    }
    __ReportTableEndTestStep("1");
  }
  TestCommandEnd();

  TestCommandBegin(__eWait, __cWait, "", "10");
  {
    __Wait("1", (2 * 1000000000), 1000000000, "");
  }
  TestCommandEnd();

  TestCommandBegin(__eSet, __cSet, "", "11");
  {
  
    __ReportTableHead3Columns(__cSetCaption , __cTSym, __cTOp, __cAssigned); 
    {
      $`BODY1::dbNode::`BC_F::`BC_F_BODY1_GW_Container_ST3_CLkS_Dr_State_ST3::`DrRLtch_FL_Stat_ST3.phys = 1;
      __ReportSignalSetLValue("PDU signal 'DrRLtch_FL_Stat_ST3'", `BODY1::dbNode::`BC_F::`BC_F_BODY1_GW_Container_ST3_CLkS_Dr_State_ST3::`DrRLtch_FL_Stat_ST3, __cArray);
      __ReportTableRow(0, __cArray, __cAOp, 1, "I_C02_DR_STAT_CLS");
    }
    {
      $`BODY1::dbNode::`BC_F::`BC_F_BODY1_GW_Container_ST3_CLkS_Dr_State_ST3::`DrRLtch_FR_Stat_ST3.phys = 1;
      __ReportSignalSetLValue("PDU signal 'DrRLtch_FR_Stat_ST3'", `BODY1::dbNode::`BC_F::`BC_F_BODY1_GW_Container_ST3_CLkS_Dr_State_ST3::`DrRLtch_FR_Stat_ST3, __cArray);
      __ReportTableRow(0, __cArray, __cAOp, 1, "I_C02_DR_STAT_CLS");
    }
    {
      $`BODY1::dbNode::`BC_F::`BC_F_BODY1_GW_Container_ST3_CLkS_Dr_State_ST3::`DrRLtch_RL_Stat_ST3.phys = 1;
      __ReportSignalSetLValue("PDU signal 'DrRLtch_RL_Stat_ST3'", `BODY1::dbNode::`BC_F::`BC_F_BODY1_GW_Container_ST3_CLkS_Dr_State_ST3::`DrRLtch_RL_Stat_ST3, __cArray);
      __ReportTableRow(0, __cArray, __cAOp, 1, "I_C02_DR_STAT_CLS");
    }
    {
      $`BODY1::dbNode::`BC_F::`BC_F_BODY1_GW_Container_ST3_CLkS_Dr_State_ST3::`DrRLtch_RR_Stat_ST3.phys = 1;
      __ReportSignalSetLValue("PDU signal 'DrRLtch_RR_Stat_ST3'", `BODY1::dbNode::`BC_F::`BC_F_BODY1_GW_Container_ST3_CLkS_Dr_State_ST3::`DrRLtch_RR_Stat_ST3, __cArray);
      __ReportTableRow(0, __cArray, __cAOp, 1, "I_C02_DR_STAT_CLS");
    }
    __ReportTableEndTestStep("1");
  }
  TestCommandEnd();

  TestCommandBegin(__eWait, __cWait, "", "12");
  {
    __Wait("1", (2 * 1000000000), 1000000000, "");
  }
  TestCommandEnd();

  TestCommandBegin(__eSet, __cSet, "", "14");
  {
  
    __ReportTableHead3Columns(__cSetCaption , __cTSym, __cTOp, __cAssigned); 
    {
      $`BODY1::dbNode::`EIS_BASE::`EIS_BODY1_Container_ST3_CLkS_Rq_ST3::`CLkS_Ext_Rq_ST3.phys = 1;
      __ReportSignalSetLValue("PDU signal 'CLkS_Ext_Rq_ST3'", `BODY1::dbNode::`EIS_BASE::`EIS_BODY1_Container_ST3_CLkS_Rq_ST3::`CLkS_Ext_Rq_ST3, __cArray);
      __ReportTableRow(0, __cArray, __cAOp, 1, "I_C02_CLKS_RQ_SNA_3H_LK");
    }
    __ReportTableEndTestStep("1");
  }
  TestCommandEnd();

  TestCommandBegin(__eAwaitValueMatch, __cAwaitValueMatch, "", "16");
  {
  
    dword __signalTimes[1];
    int64 __time;
    long __setFailed;
    __setFailed = 0;
    __time = 8 * 1000000000;
    if (__time < 0)
    {
      testStepErrorInTestSystem(0, "1", "Unable to wait for %.3f %s. Please check input parameter.", __time / ((float)1000000000), "s");
    }
    else
    {
      __signalTimes[0] = getSignalTime(`BODY1::dbNode::`DM_FL::`DM_FL_BODY1_Container1_ST3_ExtMirr_FL_Stat_ST3::`MirrAdj_LHD_Fold_Stat_ST3);
      snprintf(__cArray, elCount(__cArray), "PDU signal '%s'", "MirrAdj_LHD_Fold_Stat_ST3");
      __setFailed |= testJoinSignal(`BODY1::dbNode::`DM_FL::`DM_FL_BODY1_Container1_ST3_ExtMirr_FL_Stat_ST3::`MirrAdj_LHD_Fold_Stat_ST3, "__tt0Callback17", __cArray, 1) < 0;
      if (__setFailed != 0)
      {
        testStepErrorInTestSystem(0, "1", "Unable to set value condition.");
      }
      else
      {
        int64 __occurrenceTime;
        if (testWaitForAllJoinedEventsNS(__time) > 0)
        {
          testStepPass(2, "1", "Waited for occurrence of 1 value condition and signal updates.");
        }
        else
        {
          testStepFail(0, "1", "Waited for occurrence of 1 value condition and signal updates.");
        }
        __ReportTableHead6Columns(__cEmpty, __cTSym, __cTOp, __cRefVal, __cActual, __cEmpty, __cRes);
        __csr = CheckSignalMatch(`BODY1::dbNode::`DM_FL::`DM_FL_BODY1_Container1_ST3_ExtMirr_FL_Stat_ST3::`MirrAdj_LHD_Fold_Stat_ST3, 3, "==") == 1;
        __ReportTableRow(0, "PDU signal 'MirrAdj_LHD_Fold_Stat_ST3'", "==", 3, "I_C03_MIRRFLD_STAT_FOLD_IN");
        __ReportCell(`BODY1::dbNode::`DM_FL::`DM_FL_BODY1_Container1_ST3_ExtMirr_FL_Stat_ST3::`MirrAdj_LHD_Fold_Stat_ST3);
        
        {
          dword __signalTime;
          __signalTime = getSignalTime(`BODY1::dbNode::`DM_FL::`DM_FL_BODY1_Container1_ST3_ExtMirr_FL_Stat_ST3::`MirrAdj_LHD_Fold_Stat_ST3);
          if (__signalTime > __signalTimes[0])
          {
            __ReportCell(__cEmpty);
          }
          else
          {
            __ReportCell("(no update)");
            __csr = 0;
          }
        }
        __ReportCellResult(__csr, __ePassFail);
        __ReportTableEndTestStep(__cEmpty);
      }
    }
  }
  TestCommandEnd();

  TestCommandBegin(__eAwaitValueMatch, __cAwaitValueMatch, "", "17");
  {
  
    dword __signalTimes[1];
    int64 __time;
    long __setFailed;
    __setFailed = 0;
    __time = 4.5 * 1000000000;
    if (__time < 0)
    {
      testStepErrorInTestSystem(0, "1", "Unable to wait for %.3f %s. Please check input parameter.", __time / ((float)1000000000), "s");
    }
    else
    {
      __signalTimes[0] = getSignalTime(`BODY1::dbNode::`DM_FL::`DM_FL_BODY1_Container1_ST3_ExtMirr_FL_Stat_ST3::`MirrAdj_LHD_Fold_Stat_ST3);
      snprintf(__cArray, elCount(__cArray), "PDU signal '%s'", "MirrAdj_LHD_Fold_Stat_ST3");
      __setFailed |= testJoinSignal(`BODY1::dbNode::`DM_FL::`DM_FL_BODY1_Container1_ST3_ExtMirr_FL_Stat_ST3::`MirrAdj_LHD_Fold_Stat_ST3, "__tt0Callback18", __cArray, 1) < 0;
      if (__setFailed != 0)
      {
        testStepErrorInTestSystem(0, "1", "Unable to set value condition.");
      }
      else
      {
        int64 __occurrenceTime;
        if (testWaitForAllJoinedEventsNS(__time) > 0)
        {
          testStepPass(2, "1", "Waited for occurrence of 1 value condition and signal updates.");
        }
        else
        {
          testStepFail(0, "1", "Waited for occurrence of 1 value condition and signal updates.");
        }
        __ReportTableHead6Columns(__cEmpty, __cTSym, __cTOp, __cRefVal, __cActual, __cEmpty, __cRes);
        __csr = CheckSignalMatch(`BODY1::dbNode::`DM_FL::`DM_FL_BODY1_Container1_ST3_ExtMirr_FL_Stat_ST3::`MirrAdj_LHD_Fold_Stat_ST3, 1, "==") == 1;
        __ReportTableRow(0, "PDU signal 'MirrAdj_LHD_Fold_Stat_ST3'", "==", 1, "I_C03_MIRRFLD_STAT_FOLDED");
        __ReportCell(`BODY1::dbNode::`DM_FL::`DM_FL_BODY1_Container1_ST3_ExtMirr_FL_Stat_ST3::`MirrAdj_LHD_Fold_Stat_ST3);
        
        {
          dword __signalTime;
          __signalTime = getSignalTime(`BODY1::dbNode::`DM_FL::`DM_FL_BODY1_Container1_ST3_ExtMirr_FL_Stat_ST3::`MirrAdj_LHD_Fold_Stat_ST3);
          if (__signalTime > __signalTimes[0])
          {
            __ReportCell(__cEmpty);
          }
          else
          {
            __ReportCell("(no update)");
            __csr = 0;
          }
        }
        __ReportCellResult(__csr, __ePassFail);
        __ReportTableEndTestStep(__cEmpty);
      }
    }
  }
  TestCommandEnd();

  TestCommandBegin(__eWait, __cWait, "", "18");
  {
    __Wait("1", (1800 * 1000000000), 1000000000, "");
  }
  TestCommandEnd();

  TestCommandBegin(__eSet, __cSet, "", "20");
  {
  
    __ReportTableHead3Columns(__cSetCaption , __cTSym, __cTOp, __cAssigned); 
    {
      $`BODY1::dbNode::`EIS_BASE::`EIS_BODY1_Container_ST3_CLkS_Rq_ST3::`CLkS_Ext_Rq_ST3.phys = 2;
      __ReportSignalSetLValue("PDU signal 'CLkS_Ext_Rq_ST3'", `BODY1::dbNode::`EIS_BASE::`EIS_BODY1_Container_ST3_CLkS_Rq_ST3::`CLkS_Ext_Rq_ST3, __cArray);
      __ReportTableRow(0, __cArray, __cAOp, 2, "I_C02_CLKS_RQ_SNA_3H_UNLK");
    }
    __ReportTableEndTestStep("1");
  }
  TestCommandEnd();

  TestCommandBegin(__eAwaitValueMatch, __cAwaitValueMatch, "", "22");
  {
  
    dword __signalTimes[1];
    int64 __time;
    long __setFailed;
    __setFailed = 0;
    __time = 8 * 1000000000;
    if (__time < 0)
    {
      testStepErrorInTestSystem(0, "1", "Unable to wait for %.3f %s. Please check input parameter.", __time / ((float)1000000000), "s");
    }
    else
    {
      __signalTimes[0] = getSignalTime(`BODY1::dbNode::`DM_FL::`DM_FL_BODY1_Container1_ST3_ExtMirr_FL_Stat_ST3::`MirrAdj_LHD_Fold_Stat_ST3);
      snprintf(__cArray, elCount(__cArray), "PDU signal '%s'", "MirrAdj_LHD_Fold_Stat_ST3");
      __setFailed |= testJoinSignal(`BODY1::dbNode::`DM_FL::`DM_FL_BODY1_Container1_ST3_ExtMirr_FL_Stat_ST3::`MirrAdj_LHD_Fold_Stat_ST3, "__tt0Callback19", __cArray, 1) < 0;
      if (__setFailed != 0)
      {
        testStepErrorInTestSystem(0, "1", "Unable to set value condition.");
      }
      else
      {
        int64 __occurrenceTime;
        if (testWaitForAllJoinedEventsNS(__time) > 0)
        {
          testStepPass(2, "1", "Waited for occurrence of 1 value condition and signal updates.");
        }
        else
        {
          testStepFail(0, "1", "Waited for occurrence of 1 value condition and signal updates.");
        }
        __ReportTableHead6Columns(__cEmpty, __cTSym, __cTOp, __cRefVal, __cActual, __cEmpty, __cRes);
        __csr = CheckSignalMatch(`BODY1::dbNode::`DM_FL::`DM_FL_BODY1_Container1_ST3_ExtMirr_FL_Stat_ST3::`MirrAdj_LHD_Fold_Stat_ST3, 4, "==") == 1;
        __ReportTableRow(0, "PDU signal 'MirrAdj_LHD_Fold_Stat_ST3'", "==", 4, "I_C03_MIRRFLD_STAT_FOLD_OUT");
        __ReportCell(`BODY1::dbNode::`DM_FL::`DM_FL_BODY1_Container1_ST3_ExtMirr_FL_Stat_ST3::`MirrAdj_LHD_Fold_Stat_ST3);
        
        {
          dword __signalTime;
          __signalTime = getSignalTime(`BODY1::dbNode::`DM_FL::`DM_FL_BODY1_Container1_ST3_ExtMirr_FL_Stat_ST3::`MirrAdj_LHD_Fold_Stat_ST3);
          if (__signalTime > __signalTimes[0])
          {
            __ReportCell(__cEmpty);
          }
          else
          {
            __ReportCell("(no update)");
            __csr = 0;
          }
        }
        __ReportCellResult(__csr, __ePassFail);
        __ReportTableEndTestStep(__cEmpty);
      }
    }
  }
  TestCommandEnd();

  TestCommandBegin(__eAwaitValueMatch, __cAwaitValueMatch, "", "23");
  {
  
    dword __signalTimes[1];
    int64 __time;
    long __setFailed;
    __setFailed = 0;
    __time = 4.5 * 1000000000;
    if (__time < 0)
    {
      testStepErrorInTestSystem(0, "1", "Unable to wait for %.3f %s. Please check input parameter.", __time / ((float)1000000000), "s");
    }
    else
    {
      __signalTimes[0] = getSignalTime(`BODY1::dbNode::`DM_FL::`DM_FL_BODY1_Container1_ST3_ExtMirr_FL_Stat_ST3::`MirrAdj_LHD_Fold_Stat_ST3);
      snprintf(__cArray, elCount(__cArray), "PDU signal '%s'", "MirrAdj_LHD_Fold_Stat_ST3");
      __setFailed |= testJoinSignal(`BODY1::dbNode::`DM_FL::`DM_FL_BODY1_Container1_ST3_ExtMirr_FL_Stat_ST3::`MirrAdj_LHD_Fold_Stat_ST3, "__tt0Callback20", __cArray, 1) < 0;
      if (__setFailed != 0)
      {
        testStepErrorInTestSystem(0, "1", "Unable to set value condition.");
      }
      else
      {
        int64 __occurrenceTime;
        if (testWaitForAllJoinedEventsNS(__time) > 0)
        {
          testStepPass(2, "1", "Waited for occurrence of 1 value condition and signal updates.");
        }
        else
        {
          testStepFail(0, "1", "Waited for occurrence of 1 value condition and signal updates.");
        }
        __ReportTableHead6Columns(__cEmpty, __cTSym, __cTOp, __cRefVal, __cActual, __cEmpty, __cRes);
        __csr = CheckSignalMatch(`BODY1::dbNode::`DM_FL::`DM_FL_BODY1_Container1_ST3_ExtMirr_FL_Stat_ST3::`MirrAdj_LHD_Fold_Stat_ST3, 2, "==") == 1;
        __ReportTableRow(0, "PDU signal 'MirrAdj_LHD_Fold_Stat_ST3'", "==", 2, "I_C03_MIRRFLD_STAT_UNFOLDED");
        __ReportCell(`BODY1::dbNode::`DM_FL::`DM_FL_BODY1_Container1_ST3_ExtMirr_FL_Stat_ST3::`MirrAdj_LHD_Fold_Stat_ST3);
        
        {
          dword __signalTime;
          __signalTime = getSignalTime(`BODY1::dbNode::`DM_FL::`DM_FL_BODY1_Container1_ST3_ExtMirr_FL_Stat_ST3::`MirrAdj_LHD_Fold_Stat_ST3);
          if (__signalTime > __signalTimes[0])
          {
            __ReportCell(__cEmpty);
          }
          else
          {
            __ReportCell("(no update)");
            __csr = 0;
          }
        }
        __ReportCellResult(__csr, __ePassFail);
        __ReportTableEndTestStep(__cEmpty);
      }
    }
  }
  TestCommandEnd();

  TestCommandBegin(__eWait, __cWait, "", "24");
  {
    __Wait("1", (2 * 1000000000), 1000000000, "");
  }
  TestCommandEnd();

  TestCommandBegin(__eSet, __cSet, "", "26");
  {
  
    __ReportTableHead3Columns(__cSetCaption , __cTSym, __cTOp, __cAssigned); 
    {
      $`LinDB::dbNode::`DSM_WM_DOOR::`DSM_WM_Frm1_AR_DOOR::`MirrSelRtSw_Psd_DOOR.phys = 0;
      __ReportSignalSetLValue("LIN signal 'MirrSelRtSw_Psd_DOOR'", `LinDB::dbNode::`DSM_WM_DOOR::`DSM_WM_Frm1_AR_DOOR::`MirrSelRtSw_Psd_DOOR, __cArray);
      __ReportTableRow(0, __cArray, __cAOp, 0, "");
    }
    __ReportTableEndTestStep("1");
  }
  TestCommandEnd();

  TestCommandBegin(__eWait, __cWait, "", "27");
  {
    __Wait("1", (300 * 1000000), 1000000, "");
  }
  TestCommandEnd();

  TestCommandBegin(__eSet, __cSet, "", "28");
  {
  
    __ReportTableHead3Columns(__cSetCaption , __cTSym, __cTOp, __cAssigned); 
    {
      $`BODY1::dbNode::`BC_F::`BC_F_BODY1_GW_Container_ST3_Ign_Stat_ST3::`ISw_Stat_ST3.phys = 4;
      __ReportSignalSetLValue("PDU signal 'ISw_Stat_ST3'", `BODY1::dbNode::`BC_F::`BC_F_BODY1_GW_Container_ST3_Ign_Stat_ST3::`ISw_Stat_ST3, __cArray);
      __ReportTableRow(0, __cArray, __cAOp, 4, "I_C03_ISW_STAT_IGN_ON");
    }
    __ReportTableEndTestStep("1");
  }
  TestCommandEnd();

  TestCommandBegin(__eWait, __cWait, "", "29");
  {
    __Wait("1", (2 * 1000000000), 1000000000, "");
  }
  TestCommandEnd();

}

dword __tt0Callback17(signal * __cbParam)
{

  __csr = CheckSignalMatch(__cbParam, 3, "==") == 1;
  return __csr;
}
dword __tt0Callback18(signal * __cbParam)
{

  __csr = CheckSignalMatch(__cbParam, 1, "==") == 1;
  return __csr;
}
dword __tt0Callback19(signal * __cbParam)
{

  __csr = CheckSignalMatch(__cbParam, 4, "==") == 1;
  return __csr;
}
dword __tt0Callback20(signal * __cbParam)
{

  __csr = CheckSignalMatch(__cbParam, 2, "==") == 1;
  return __csr;
}

testcase Tt0_Mirror_folding_unfolding(int64 iteration, int64 CSL_actuation_TimerMS)
{
  SetBreakOnFail(0);

  TestPreparationBegin();
  {
    TestCommandBegin(__eSet, __cSet, "", "0");
    {
    
      __ReportTableHead3Columns(__cSetCaption , __cTSym, __cTOp, __cAssigned); 
      {
        $`BODY1::dbNode::`BC_F::`BC_F_BODY1_GW_Container_ST3_ExtMirr_Settings_ST3::`MirrFldPk_Rq_ST3.phys = 1;
        __ReportSignalSetLValue("PDU signal 'MirrFldPk_Rq_ST3'", `BODY1::dbNode::`BC_F::`BC_F_BODY1_GW_Container_ST3_ExtMirr_Settings_ST3::`MirrFldPk_Rq_ST3, __cArray);
        __ReportTableRow(0, __cArray, __cAOp, 1, "I_C02_OFF_ON_ON");
      }
      __ReportTableEndTestStep("1");
    }
    TestCommandEnd();

    TestCommandBegin(__eWait, __cWait, "", "1");
    {
      __Wait("1", (2 * 1000000000), 1000000000, "");
    }
    TestCommandEnd();

  }
  TestPreparationEnd();

  TestCommandBegin(__eSet, __cSet, "", "3");
  {
  
    __ReportTableHead3Columns(__cSetCaption , __cTSym, __cTOp, __cAssigned); 
    {
      $`LinDB::dbNode::`DSM_WM_DOOR::`DSM_WM_Frm1_AR_DOOR::`MirrFldSw_Psd_DOOR.phys = 1;
      __ReportSignalSetLValue("LIN signal 'MirrFldSw_Psd_DOOR'", `LinDB::dbNode::`DSM_WM_DOOR::`DSM_WM_Frm1_AR_DOOR::`MirrFldSw_Psd_DOOR, __cArray);
      __ReportTableRow(0, __cArray, __cAOp, 1, "");
    }
    __ReportTableEndTestStep("1");
  }
  TestCommandEnd();

  TestCommandBegin(__eWait, __cWait, "", "4");
  {
    __Wait("1", (4 * 1000000000), 1000000000, "");
  }
  TestCommandEnd();

  TestCommandBegin(__eSet, __cSet, "", "5");
  {
  
    __ReportTableHead3Columns(__cSetCaption , __cTSym, __cTOp, __cAssigned); 
    {
      $`LinDB::dbNode::`DSM_WM_DOOR::`DSM_WM_Frm1_AR_DOOR::`MirrFldSw_Psd_DOOR.phys = 0;
      __ReportSignalSetLValue("LIN signal 'MirrFldSw_Psd_DOOR'", `LinDB::dbNode::`DSM_WM_DOOR::`DSM_WM_Frm1_AR_DOOR::`MirrFldSw_Psd_DOOR, __cArray);
      __ReportTableRow(0, __cArray, __cAOp, 0, "");
    }
    __ReportTableEndTestStep("1");
  }
  TestCommandEnd();

  TestCommandBegin(__eAwaitValueMatch, __cAwaitValueMatch, "", "6");
  {
  
    dword __signalTimes[1];
    int64 __time;
    long __setFailed;
    __setFailed = 0;
    __time = 4.5 * 1000000000;
    if (__time < 0)
    {
      testStepErrorInTestSystem(0, "1", "Unable to wait for %.3f %s. Please check input parameter.", __time / ((float)1000000000), "s");
    }
    else
    {
      __signalTimes[0] = getSignalTime(`BODY1::dbNode::`DM_FL::`DM_FL_BODY1_Container1_ST3_ExtMirr_FL_Stat_ST3::`MirrAdj_LHD_Fold_Stat_ST3);
      snprintf(__cArray, elCount(__cArray), "PDU signal '%s'", "MirrAdj_LHD_Fold_Stat_ST3");
      __setFailed |= testJoinSignal(`BODY1::dbNode::`DM_FL::`DM_FL_BODY1_Container1_ST3_ExtMirr_FL_Stat_ST3::`MirrAdj_LHD_Fold_Stat_ST3, "__tt0Callback21", __cArray, 1) < 0;
      if (__setFailed != 0)
      {
        testStepErrorInTestSystem(0, "1", "Unable to set value condition.");
      }
      else
      {
        int64 __occurrenceTime;
        if (testWaitForAllJoinedEventsNS(__time) > 0)
        {
          testStepPass(2, "1", "Waited for occurrence of 1 value condition and signal updates.");
        }
        else
        {
          testStepFail(0, "1", "Waited for occurrence of 1 value condition and signal updates.");
        }
        __ReportTableHead6Columns(__cEmpty, __cTSym, __cTOp, __cRefVal, __cActual, __cEmpty, __cRes);
        __csr = CheckSignalMatch(`BODY1::dbNode::`DM_FL::`DM_FL_BODY1_Container1_ST3_ExtMirr_FL_Stat_ST3::`MirrAdj_LHD_Fold_Stat_ST3, 1, "==") == 1;
        __ReportTableRow(0, "PDU signal 'MirrAdj_LHD_Fold_Stat_ST3'", "==", 1, "I_C03_MIRRFLD_STAT_FOLDED");
        __ReportCell(`BODY1::dbNode::`DM_FL::`DM_FL_BODY1_Container1_ST3_ExtMirr_FL_Stat_ST3::`MirrAdj_LHD_Fold_Stat_ST3);
        
        {
          dword __signalTime;
          __signalTime = getSignalTime(`BODY1::dbNode::`DM_FL::`DM_FL_BODY1_Container1_ST3_ExtMirr_FL_Stat_ST3::`MirrAdj_LHD_Fold_Stat_ST3);
          if (__signalTime > __signalTimes[0])
          {
            __ReportCell(__cEmpty);
          }
          else
          {
            __ReportCell("(no update)");
            __csr = 0;
          }
        }
        __ReportCellResult(__csr, __ePassFail);
        __ReportTableEndTestStep(__cEmpty);
      }
    }
  }
  TestCommandEnd();

  TestCommandBegin(__eWait, __cWait, "", "7");
  {
    __Wait("1", (1 * 1000000000), 1000000000, "");
  }
  TestCommandEnd();

  TestCommandBegin(__eSet, __cSet, "", "8");
  {
  
    __ReportTableHead3Columns(__cSetCaption , __cTSym, __cTOp, __cAssigned); 
    {
      $`LinDB::dbNode::`DSM_WM_DOOR::`DSM_WM_Frm1_AR_DOOR::`MirrFldSw_Psd_DOOR.phys = 1;
      __ReportSignalSetLValue("LIN signal 'MirrFldSw_Psd_DOOR'", `LinDB::dbNode::`DSM_WM_DOOR::`DSM_WM_Frm1_AR_DOOR::`MirrFldSw_Psd_DOOR, __cArray);
      __ReportTableRow(0, __cArray, __cAOp, 1, "");
    }
    __ReportTableEndTestStep("1");
  }
  TestCommandEnd();

  TestCommandBegin(__eWait, __cWait, "", "9");
  {
    __Wait("1", (4 * 1000000000), 1000000000, "");
  }
  TestCommandEnd();

  TestCommandBegin(__eAwaitValueMatch, __cAwaitValueMatch, "", "10");
  {
  
    dword __signalTimes[1];
    int64 __time;
    long __setFailed;
    __setFailed = 0;
    __time = 4.5 * 1000000000;
    if (__time < 0)
    {
      testStepErrorInTestSystem(0, "1", "Unable to wait for %.3f %s. Please check input parameter.", __time / ((float)1000000000), "s");
    }
    else
    {
      __signalTimes[0] = getSignalTime(`BODY1::dbNode::`DM_FL::`DM_FL_BODY1_Container1_ST3_ExtMirr_FL_Stat_ST3::`MirrAdj_LHD_Fold_Stat_ST3);
      snprintf(__cArray, elCount(__cArray), "PDU signal '%s'", "MirrAdj_LHD_Fold_Stat_ST3");
      __setFailed |= testJoinSignal(`BODY1::dbNode::`DM_FL::`DM_FL_BODY1_Container1_ST3_ExtMirr_FL_Stat_ST3::`MirrAdj_LHD_Fold_Stat_ST3, "__tt0Callback22", __cArray, 1) < 0;
      if (__setFailed != 0)
      {
        testStepErrorInTestSystem(0, "1", "Unable to set value condition.");
      }
      else
      {
        int64 __occurrenceTime;
        if (testWaitForAllJoinedEventsNS(__time) > 0)
        {
          testStepPass(2, "1", "Waited for occurrence of 1 value condition and signal updates.");
        }
        else
        {
          testStepFail(0, "1", "Waited for occurrence of 1 value condition and signal updates.");
        }
        __ReportTableHead6Columns(__cEmpty, __cTSym, __cTOp, __cRefVal, __cActual, __cEmpty, __cRes);
        __csr = CheckSignalMatch(`BODY1::dbNode::`DM_FL::`DM_FL_BODY1_Container1_ST3_ExtMirr_FL_Stat_ST3::`MirrAdj_LHD_Fold_Stat_ST3, 4, "==") == 1;
        __ReportTableRow(0, "PDU signal 'MirrAdj_LHD_Fold_Stat_ST3'", "==", 4, "I_C03_MIRRFLD_STAT_FOLD_OUT");
        __ReportCell(`BODY1::dbNode::`DM_FL::`DM_FL_BODY1_Container1_ST3_ExtMirr_FL_Stat_ST3::`MirrAdj_LHD_Fold_Stat_ST3);
        
        {
          dword __signalTime;
          __signalTime = getSignalTime(`BODY1::dbNode::`DM_FL::`DM_FL_BODY1_Container1_ST3_ExtMirr_FL_Stat_ST3::`MirrAdj_LHD_Fold_Stat_ST3);
          if (__signalTime > __signalTimes[0])
          {
            __ReportCell(__cEmpty);
          }
          else
          {
            __ReportCell("(no update)");
            __csr = 0;
          }
        }
        __ReportCellResult(__csr, __ePassFail);
        __ReportTableEndTestStep(__cEmpty);
      }
    }
  }
  TestCommandEnd();

  TestCommandBegin(__eCheck, __cCheck, "", "11");
  {
    __bVerdict = __eVerdictPass;
    __ReportTableHead5Columns(__cCheckCaption, __cTSym, __cTOp, __cRefVal, __cActual, __cRes);
    {
      __csr = CheckSignalMatch(`BODY1::dbNode::`DM_FL::`DM_FL_BODY1_Container1_ST3_ExtMirr_FL_Stat_ST3::`MirrAdj_LHD_Fold_Stat_ST3, 4, "==") == 1;
      __ReportTableRow(0, "PDU signal 'MirrAdj_LHD_Fold_Stat_ST3'", "==", 4, "I_C03_MIRRFLD_STAT_FOLD_OUT");
      __ReportCell(`BODY1::dbNode::`DM_FL::`DM_FL_BODY1_Container1_ST3_ExtMirr_FL_Stat_ST3::`MirrAdj_LHD_Fold_Stat_ST3);
      __ReportCellResult(__csr, __ePassFail);
      __bVerdict = __bVerdict && __csr;
    }
    __ReportTableEndVerdict("1", __bVerdict);
  }
  TestCommandEnd();

  TestCommandBegin(__eSet, __cSet, "", "12");
  {
  
    __ReportTableHead3Columns(__cSetCaption , __cTSym, __cTOp, __cAssigned); 
    {
      $`LinDB::dbNode::`DSM_WM_DOOR::`DSM_WM_Frm1_AR_DOOR::`MirrFldSw_Psd_DOOR.phys = 0;
      __ReportSignalSetLValue("LIN signal 'MirrFldSw_Psd_DOOR'", `LinDB::dbNode::`DSM_WM_DOOR::`DSM_WM_Frm1_AR_DOOR::`MirrFldSw_Psd_DOOR, __cArray);
      __ReportTableRow(0, __cArray, __cAOp, 0, "");
    }
    __ReportTableEndTestStep("1");
  }
  TestCommandEnd();

  TestCommandBegin(__eWait, __cWait, "", "13");
  {
    __Wait("1", (2 * 1000000000), 1000000000, "");
  }
  TestCommandEnd();

  TestCommandBegin(__eSet, __cSet, "", "15");
  {
  
    __ReportTableHead3Columns(__cSetCaption , __cTSym, __cTOp, __cAssigned); 
    {
      $`BODY1::dbNode::`BC_F::`BC_F_BODY1_GW_Container_ST3_Ign_Stat_ST3::`ISw_Stat_ST3.phys = 0;
      __ReportSignalSetLValue("PDU signal 'ISw_Stat_ST3'", `BODY1::dbNode::`BC_F::`BC_F_BODY1_GW_Container_ST3_Ign_Stat_ST3::`ISw_Stat_ST3, __cArray);
      __ReportTableRow(0, __cArray, __cAOp, 0, "I_C03_ISW_STAT_IGN_LOCK");
    }
    __ReportTableEndTestStep("1");
  }
  TestCommandEnd();

  TestCommandBegin(__eWait, __cWait, "", "16");
  {
    __Wait("1", (2 * 1000000000), 1000000000, "");
  }
  TestCommandEnd();

  TestCommandBegin(__eSet, __cSet, "", "17");
  {
  
    __ReportTableHead3Columns(__cSetCaption , __cTSym, __cTOp, __cAssigned); 
    {
      $`BODY1::dbNode::`BC_F::`BC_F_BODY1_GW_Container_ST3_CLkS_Dr_State_ST3::`DrRLtch_FL_Stat_ST3.phys = 1;
      __ReportSignalSetLValue("PDU signal 'DrRLtch_FL_Stat_ST3'", `BODY1::dbNode::`BC_F::`BC_F_BODY1_GW_Container_ST3_CLkS_Dr_State_ST3::`DrRLtch_FL_Stat_ST3, __cArray);
      __ReportTableRow(0, __cArray, __cAOp, 1, "I_C02_DR_STAT_CLS");
    }
    {
      $`BODY1::dbNode::`BC_F::`BC_F_BODY1_GW_Container_ST3_CLkS_Dr_State_ST3::`DrRLtch_FR_Stat_ST3.phys = 1;
      __ReportSignalSetLValue("PDU signal 'DrRLtch_FR_Stat_ST3'", `BODY1::dbNode::`BC_F::`BC_F_BODY1_GW_Container_ST3_CLkS_Dr_State_ST3::`DrRLtch_FR_Stat_ST3, __cArray);
      __ReportTableRow(0, __cArray, __cAOp, 1, "I_C02_DR_STAT_CLS");
    }
    {
      $`BODY1::dbNode::`BC_F::`BC_F_BODY1_GW_Container_ST3_CLkS_Dr_State_ST3::`DrRLtch_RL_Stat_ST3.phys = 1;
      __ReportSignalSetLValue("PDU signal 'DrRLtch_RL_Stat_ST3'", `BODY1::dbNode::`BC_F::`BC_F_BODY1_GW_Container_ST3_CLkS_Dr_State_ST3::`DrRLtch_RL_Stat_ST3, __cArray);
      __ReportTableRow(0, __cArray, __cAOp, 1, "I_C02_DR_STAT_CLS");
    }
    {
      $`BODY1::dbNode::`BC_F::`BC_F_BODY1_GW_Container_ST3_CLkS_Dr_State_ST3::`DrRLtch_RR_Stat_ST3.phys = 1;
      __ReportSignalSetLValue("PDU signal 'DrRLtch_RR_Stat_ST3'", `BODY1::dbNode::`BC_F::`BC_F_BODY1_GW_Container_ST3_CLkS_Dr_State_ST3::`DrRLtch_RR_Stat_ST3, __cArray);
      __ReportTableRow(0, __cArray, __cAOp, 1, "I_C02_DR_STAT_CLS");
    }
    __ReportTableEndTestStep("1");
  }
  TestCommandEnd();

  TestCommandBegin(__eWait, __cWait, "", "18");
  {
    __Wait("1", (2 * 1000000000), 1000000000, "");
  }
  TestCommandEnd();

  TestCommandBegin(__eSet, __cSet, "", "20");
  {
  
    __ReportTableHead3Columns(__cSetCaption , __cTSym, __cTOp, __cAssigned); 
    {
      $`BODY1::dbNode::`EIS_BASE::`EIS_BODY1_Container_ST3_CLkS_Rq_ST3::`CLkS_Ext_Rq_ST3.phys = 1;
      __ReportSignalSetLValue("PDU signal 'CLkS_Ext_Rq_ST3'", `BODY1::dbNode::`EIS_BASE::`EIS_BODY1_Container_ST3_CLkS_Rq_ST3::`CLkS_Ext_Rq_ST3, __cArray);
      __ReportTableRow(0, __cArray, __cAOp, 1, "I_C02_CLKS_RQ_SNA_3H_LK");
    }
    __ReportTableEndTestStep("1");
  }
  TestCommandEnd();

  TestCommandBegin(__eAwaitValueMatch, __cAwaitValueMatch, "", "22");
  {
  
    dword __signalTimes[1];
    int64 __time;
    long __setFailed;
    __setFailed = 0;
    __time = 8 * 1000000000;
    if (__time < 0)
    {
      testStepErrorInTestSystem(0, "1", "Unable to wait for %.3f %s. Please check input parameter.", __time / ((float)1000000000), "s");
    }
    else
    {
      __signalTimes[0] = getSignalTime(`BODY1::dbNode::`DM_FL::`DM_FL_BODY1_Container1_ST3_ExtMirr_FL_Stat_ST3::`MirrAdj_LHD_Fold_Stat_ST3);
      snprintf(__cArray, elCount(__cArray), "PDU signal '%s'", "MirrAdj_LHD_Fold_Stat_ST3");
      __setFailed |= testJoinSignal(`BODY1::dbNode::`DM_FL::`DM_FL_BODY1_Container1_ST3_ExtMirr_FL_Stat_ST3::`MirrAdj_LHD_Fold_Stat_ST3, "__tt0Callback23", __cArray, 1) < 0;
      if (__setFailed != 0)
      {
        testStepErrorInTestSystem(0, "1", "Unable to set value condition.");
      }
      else
      {
        int64 __occurrenceTime;
        if (testWaitForAllJoinedEventsNS(__time) > 0)
        {
          testStepPass(2, "1", "Waited for occurrence of 1 value condition and signal updates.");
        }
        else
        {
          testStepFail(0, "1", "Waited for occurrence of 1 value condition and signal updates.");
        }
        __ReportTableHead6Columns(__cEmpty, __cTSym, __cTOp, __cRefVal, __cActual, __cEmpty, __cRes);
        __csr = CheckSignalMatch(`BODY1::dbNode::`DM_FL::`DM_FL_BODY1_Container1_ST3_ExtMirr_FL_Stat_ST3::`MirrAdj_LHD_Fold_Stat_ST3, 3, "==") == 1;
        __ReportTableRow(0, "PDU signal 'MirrAdj_LHD_Fold_Stat_ST3'", "==", 3, "I_C03_MIRRFLD_STAT_FOLD_IN");
        __ReportCell(`BODY1::dbNode::`DM_FL::`DM_FL_BODY1_Container1_ST3_ExtMirr_FL_Stat_ST3::`MirrAdj_LHD_Fold_Stat_ST3);
        
        {
          dword __signalTime;
          __signalTime = getSignalTime(`BODY1::dbNode::`DM_FL::`DM_FL_BODY1_Container1_ST3_ExtMirr_FL_Stat_ST3::`MirrAdj_LHD_Fold_Stat_ST3);
          if (__signalTime > __signalTimes[0])
          {
            __ReportCell(__cEmpty);
          }
          else
          {
            __ReportCell("(no update)");
            __csr = 0;
          }
        }
        __ReportCellResult(__csr, __ePassFail);
        __ReportTableEndTestStep(__cEmpty);
      }
    }
  }
  TestCommandEnd();

  TestCommandBegin(__eAwaitValueMatch, __cAwaitValueMatch, "", "23");
  {
  
    dword __signalTimes[1];
    int64 __time;
    long __setFailed;
    __setFailed = 0;
    __time = 4.5 * 1000000000;
    if (__time < 0)
    {
      testStepErrorInTestSystem(0, "1", "Unable to wait for %.3f %s. Please check input parameter.", __time / ((float)1000000000), "s");
    }
    else
    {
      __signalTimes[0] = getSignalTime(`BODY1::dbNode::`DM_FL::`DM_FL_BODY1_Container1_ST3_ExtMirr_FL_Stat_ST3::`MirrAdj_LHD_Fold_Stat_ST3);
      snprintf(__cArray, elCount(__cArray), "PDU signal '%s'", "MirrAdj_LHD_Fold_Stat_ST3");
      __setFailed |= testJoinSignal(`BODY1::dbNode::`DM_FL::`DM_FL_BODY1_Container1_ST3_ExtMirr_FL_Stat_ST3::`MirrAdj_LHD_Fold_Stat_ST3, "__tt0Callback24", __cArray, 1) < 0;
      if (__setFailed != 0)
      {
        testStepErrorInTestSystem(0, "1", "Unable to set value condition.");
      }
      else
      {
        int64 __occurrenceTime;
        if (testWaitForAllJoinedEventsNS(__time) > 0)
        {
          testStepPass(2, "1", "Waited for occurrence of 1 value condition and signal updates.");
        }
        else
        {
          testStepFail(0, "1", "Waited for occurrence of 1 value condition and signal updates.");
        }
        __ReportTableHead6Columns(__cEmpty, __cTSym, __cTOp, __cRefVal, __cActual, __cEmpty, __cRes);
        __csr = CheckSignalMatch(`BODY1::dbNode::`DM_FL::`DM_FL_BODY1_Container1_ST3_ExtMirr_FL_Stat_ST3::`MirrAdj_LHD_Fold_Stat_ST3, 1, "==") == 1;
        __ReportTableRow(0, "PDU signal 'MirrAdj_LHD_Fold_Stat_ST3'", "==", 1, "I_C03_MIRRFLD_STAT_FOLDED");
        __ReportCell(`BODY1::dbNode::`DM_FL::`DM_FL_BODY1_Container1_ST3_ExtMirr_FL_Stat_ST3::`MirrAdj_LHD_Fold_Stat_ST3);
        
        {
          dword __signalTime;
          __signalTime = getSignalTime(`BODY1::dbNode::`DM_FL::`DM_FL_BODY1_Container1_ST3_ExtMirr_FL_Stat_ST3::`MirrAdj_LHD_Fold_Stat_ST3);
          if (__signalTime > __signalTimes[0])
          {
            __ReportCell(__cEmpty);
          }
          else
          {
            __ReportCell("(no update)");
            __csr = 0;
          }
        }
        __ReportCellResult(__csr, __ePassFail);
        __ReportTableEndTestStep(__cEmpty);
      }
    }
  }
  TestCommandEnd();

  TestCommandBegin(__eWait, __cWait, "", "24");
  {
    __Wait("1", (1800 * 1000000000), 1000000000, "");
  }
  TestCommandEnd();

  TestCommandBegin(__eSet, __cSet, "", "26");
  {
  
    __ReportTableHead3Columns(__cSetCaption , __cTSym, __cTOp, __cAssigned); 
    {
      $`BODY1::dbNode::`EIS_BASE::`EIS_BODY1_Container_ST3_CLkS_Rq_ST3::`CLkS_Ext_Rq_ST3.phys = 2;
      __ReportSignalSetLValue("PDU signal 'CLkS_Ext_Rq_ST3'", `BODY1::dbNode::`EIS_BASE::`EIS_BODY1_Container_ST3_CLkS_Rq_ST3::`CLkS_Ext_Rq_ST3, __cArray);
      __ReportTableRow(0, __cArray, __cAOp, 2, "I_C02_CLKS_RQ_SNA_3H_UNLK");
    }
    __ReportTableEndTestStep("1");
  }
  TestCommandEnd();

  TestCommandBegin(__eAwaitValueMatch, __cAwaitValueMatch, "", "28");
  {
  
    dword __signalTimes[1];
    int64 __time;
    long __setFailed;
    __setFailed = 0;
    __time = 8 * 1000000000;
    if (__time < 0)
    {
      testStepErrorInTestSystem(0, "1", "Unable to wait for %.3f %s. Please check input parameter.", __time / ((float)1000000000), "s");
    }
    else
    {
      __signalTimes[0] = getSignalTime(`BODY1::dbNode::`DM_FL::`DM_FL_BODY1_Container1_ST3_ExtMirr_FL_Stat_ST3::`MirrAdj_LHD_Fold_Stat_ST3);
      snprintf(__cArray, elCount(__cArray), "PDU signal '%s'", "MirrAdj_LHD_Fold_Stat_ST3");
      __setFailed |= testJoinSignal(`BODY1::dbNode::`DM_FL::`DM_FL_BODY1_Container1_ST3_ExtMirr_FL_Stat_ST3::`MirrAdj_LHD_Fold_Stat_ST3, "__tt0Callback25", __cArray, 1) < 0;
      if (__setFailed != 0)
      {
        testStepErrorInTestSystem(0, "1", "Unable to set value condition.");
      }
      else
      {
        int64 __occurrenceTime;
        if (testWaitForAllJoinedEventsNS(__time) > 0)
        {
          testStepPass(2, "1", "Waited for occurrence of 1 value condition and signal updates.");
        }
        else
        {
          testStepFail(0, "1", "Waited for occurrence of 1 value condition and signal updates.");
        }
        __ReportTableHead6Columns(__cEmpty, __cTSym, __cTOp, __cRefVal, __cActual, __cEmpty, __cRes);
        __csr = CheckSignalMatch(`BODY1::dbNode::`DM_FL::`DM_FL_BODY1_Container1_ST3_ExtMirr_FL_Stat_ST3::`MirrAdj_LHD_Fold_Stat_ST3, 4, "==") == 1;
        __ReportTableRow(0, "PDU signal 'MirrAdj_LHD_Fold_Stat_ST3'", "==", 4, "I_C03_MIRRFLD_STAT_FOLD_OUT");
        __ReportCell(`BODY1::dbNode::`DM_FL::`DM_FL_BODY1_Container1_ST3_ExtMirr_FL_Stat_ST3::`MirrAdj_LHD_Fold_Stat_ST3);
        
        {
          dword __signalTime;
          __signalTime = getSignalTime(`BODY1::dbNode::`DM_FL::`DM_FL_BODY1_Container1_ST3_ExtMirr_FL_Stat_ST3::`MirrAdj_LHD_Fold_Stat_ST3);
          if (__signalTime > __signalTimes[0])
          {
            __ReportCell(__cEmpty);
          }
          else
          {
            __ReportCell("(no update)");
            __csr = 0;
          }
        }
        __ReportCellResult(__csr, __ePassFail);
        __ReportTableEndTestStep(__cEmpty);
      }
    }
  }
  TestCommandEnd();

  TestCommandBegin(__eAwaitValueMatch, __cAwaitValueMatch, "", "29");
  {
  
    dword __signalTimes[1];
    int64 __time;
    long __setFailed;
    __setFailed = 0;
    __time = 4.5 * 1000000000;
    if (__time < 0)
    {
      testStepErrorInTestSystem(0, "1", "Unable to wait for %.3f %s. Please check input parameter.", __time / ((float)1000000000), "s");
    }
    else
    {
      __signalTimes[0] = getSignalTime(`BODY1::dbNode::`DM_FL::`DM_FL_BODY1_Container1_ST3_ExtMirr_FL_Stat_ST3::`MirrAdj_LHD_Fold_Stat_ST3);
      snprintf(__cArray, elCount(__cArray), "PDU signal '%s'", "MirrAdj_LHD_Fold_Stat_ST3");
      __setFailed |= testJoinSignal(`BODY1::dbNode::`DM_FL::`DM_FL_BODY1_Container1_ST3_ExtMirr_FL_Stat_ST3::`MirrAdj_LHD_Fold_Stat_ST3, "__tt0Callback26", __cArray, 1) < 0;
      if (__setFailed != 0)
      {
        testStepErrorInTestSystem(0, "1", "Unable to set value condition.");
      }
      else
      {
        int64 __occurrenceTime;
        if (testWaitForAllJoinedEventsNS(__time) > 0)
        {
          testStepPass(2, "1", "Waited for occurrence of 1 value condition and signal updates.");
        }
        else
        {
          testStepFail(0, "1", "Waited for occurrence of 1 value condition and signal updates.");
        }
        __ReportTableHead6Columns(__cEmpty, __cTSym, __cTOp, __cRefVal, __cActual, __cEmpty, __cRes);
        __csr = CheckSignalMatch(`BODY1::dbNode::`DM_FL::`DM_FL_BODY1_Container1_ST3_ExtMirr_FL_Stat_ST3::`MirrAdj_LHD_Fold_Stat_ST3, 2, "==") == 1;
        __ReportTableRow(0, "PDU signal 'MirrAdj_LHD_Fold_Stat_ST3'", "==", 2, "I_C03_MIRRFLD_STAT_UNFOLDED");
        __ReportCell(`BODY1::dbNode::`DM_FL::`DM_FL_BODY1_Container1_ST3_ExtMirr_FL_Stat_ST3::`MirrAdj_LHD_Fold_Stat_ST3);
        
        {
          dword __signalTime;
          __signalTime = getSignalTime(`BODY1::dbNode::`DM_FL::`DM_FL_BODY1_Container1_ST3_ExtMirr_FL_Stat_ST3::`MirrAdj_LHD_Fold_Stat_ST3);
          if (__signalTime > __signalTimes[0])
          {
            __ReportCell(__cEmpty);
          }
          else
          {
            __ReportCell("(no update)");
            __csr = 0;
          }
        }
        __ReportCellResult(__csr, __ePassFail);
        __ReportTableEndTestStep(__cEmpty);
      }
    }
  }
  TestCommandEnd();

  TestCommandBegin(__eWait, __cWait, "", "30");
  {
    __Wait("1", (2 * 1000000000), 1000000000, "");
  }
  TestCommandEnd();

  TestCommandBegin(__eSet, __cSet, "", "32");
  {
  
    __ReportTableHead3Columns(__cSetCaption , __cTSym, __cTOp, __cAssigned); 
    {
      $`BODY1::dbNode::`BC_F::`BC_F_BODY1_GW_Container_ST3_Ign_Stat_ST3::`ISw_Stat_ST3.phys = 4;
      __ReportSignalSetLValue("PDU signal 'ISw_Stat_ST3'", `BODY1::dbNode::`BC_F::`BC_F_BODY1_GW_Container_ST3_Ign_Stat_ST3::`ISw_Stat_ST3, __cArray);
      __ReportTableRow(0, __cArray, __cAOp, 4, "I_C03_ISW_STAT_IGN_ON");
    }
    __ReportTableEndTestStep("1");
  }
  TestCommandEnd();

  TestCommandBegin(__eWait, __cWait, "", "33");
  {
    __Wait("1", (2 * 1000000000), 1000000000, "");
  }
  TestCommandEnd();

}

dword __tt0Callback21(signal * __cbParam)
{

  __csr = CheckSignalMatch(__cbParam, 1, "==") == 1;
  return __csr;
}
dword __tt0Callback22(signal * __cbParam)
{

  __csr = CheckSignalMatch(__cbParam, 4, "==") == 1;
  return __csr;
}
dword __tt0Callback23(signal * __cbParam)
{

  __csr = CheckSignalMatch(__cbParam, 3, "==") == 1;
  return __csr;
}
dword __tt0Callback24(signal * __cbParam)
{

  __csr = CheckSignalMatch(__cbParam, 1, "==") == 1;
  return __csr;
}
dword __tt0Callback25(signal * __cbParam)
{

  __csr = CheckSignalMatch(__cbParam, 4, "==") == 1;
  return __csr;
}
dword __tt0Callback26(signal * __cbParam)
{

  __csr = CheckSignalMatch(__cbParam, 2, "==") == 1;
  return __csr;
}

testcase Tt0_LockSimul_Test_CSL_deactivated(int64 iteration, int64 CSL_actuation_TimerMS)
{
  int64 __ifExec1;

  SetBreakOnFail(0);

  TestPreparationBegin();
  {
    TestCommandBegin(__eSet, __cSet, "", "0");
    {
    
      __ReportTableHead3Columns(__cSetCaption , __cTSym, __cTOp, __cAssigned); 
      {
        $`BODY1::dbNode::`BC_F::`BC_F_BODY1_GW_Container_ST3_ExtMirr_Settings_ST3::`MirrFldPk_Rq_ST3.phys = 1;
        __ReportSignalSetLValue("PDU signal 'MirrFldPk_Rq_ST3'", `BODY1::dbNode::`BC_F::`BC_F_BODY1_GW_Container_ST3_ExtMirr_Settings_ST3::`MirrFldPk_Rq_ST3, __cArray);
        __ReportTableRow(0, __cArray, __cAOp, 1, "I_C02_OFF_ON_ON");
      }
      __ReportTableEndTestStep("1");
    }
    TestCommandEnd();

    TestCommandBegin(__eWait, __cWait, "", "1");
    {
      __Wait("1", (2 * 1000000000), 1000000000, "");
    }
    TestCommandEnd();

    
    TestControlStructBegin(__cIf, "", "3");
    {
      int64 __condition;
      {
        int64 __expr0;
        __ifExec1 = 0;
    
        {
          __csr = CheckSignalMatch(`BODY1::dbNode::`DM_FL::`DM_FL_BODY1_Container2_ST3_PW_FL_Stat_ST3::`CSL_LHD_Inact_ST3, 1, "==") == 1;
        }
        {
          __expr0 = __csr;
        }
        __condition = __expr0;
    
          snprintf(__cConditionArray, 2048, "%s", "");
          snprintf(__cCompareArray, 2048, "%s", "");
          snprintf(__cCompareArray, 2048, "%s%s%s", "CSL_LHD_Inact_ST3", "==", "I_C02_NDEF_FALSE_TRUE_ST3_FALSE");
          snprintf(__cArray, 2048, "%s", __cCompareArray);
          snprintf(__cCompareArray, 2048, "( %s )", __cArray);
          snprintf(__cArray, 2048, "%s", __cConditionArray);
          snprintf(__cConditionArray, 2048, "%s%s", __cArray, __cCompareArray);
          snprintf(__cArray, 2048, "%s", __cConditionArray);
          snprintf(__cConditionArray, 2048, "%s %s", "If", __cArray);
    
        __ReportConditionTableHead(__cConditionArray, __condition);
        {
          __csr = CheckSignalMatch(`BODY1::dbNode::`DM_FL::`DM_FL_BODY1_Container2_ST3_PW_FL_Stat_ST3::`CSL_LHD_Inact_ST3, 1, "==") == 1;
          __ReportTableRow(0, "PDU signal 'CSL_LHD_Inact_ST3'", "==", 1, "I_C02_NDEF_FALSE_TRUE_ST3_FALSE");
          __ReportCell(`BODY1::dbNode::`DM_FL::`DM_FL_BODY1_Container2_ST3_PW_FL_Stat_ST3::`CSL_LHD_Inact_ST3);
          __ReportCellResult(__csr, __eTrueFalse); 
        }
        __ReportTableEndCondition(__cIfCondition);
      }
    
      if(__condition)
      {  
        __ifExec1 = 1;

        TestCommandBegin(__eSet, __cSet, "", "4");
        {
        
          __ReportTableHead3Columns(__cSetCaption , __cTSym, __cTOp, __cAssigned); 
          {
            $`LinDB::dbNode::`DSM_WM_DOOR::`DSM_WM_Frm1_AR_DOOR::`CSL_Sw_Psd_DOOR.phys = 1;
            __ReportSignalSetLValue("LIN signal 'CSL_Sw_Psd_DOOR'", `LinDB::dbNode::`DSM_WM_DOOR::`DSM_WM_Frm1_AR_DOOR::`CSL_Sw_Psd_DOOR, __cArray);
            __ReportTableRow(0, __cArray, __cAOp, 1, "");
          }
          __ReportTableEndTestStep("1");
        }
        TestCommandEnd();

        TestCommandBegin(__eWait, __cWait, "", "5");
        {
          __Wait("1", (((int64)CSL_actuation_TimerMS) * 1000000), 1000000, "CSL_actuation_TimerMS");
        }
        TestCommandEnd();

        TestCommandBegin(__eSet, __cSet, "", "6");
        {
        
          __ReportTableHead3Columns(__cSetCaption , __cTSym, __cTOp, __cAssigned); 
          {
            $`LinDB::dbNode::`DSM_WM_DOOR::`DSM_WM_Frm1_AR_DOOR::`CSL_Sw_Psd_DOOR.phys = 0;
            __ReportSignalSetLValue("LIN signal 'CSL_Sw_Psd_DOOR'", `LinDB::dbNode::`DSM_WM_DOOR::`DSM_WM_Frm1_AR_DOOR::`CSL_Sw_Psd_DOOR, __cArray);
            __ReportTableRow(0, __cArray, __cAOp, 0, "");
          }
          __ReportTableEndTestStep("1");
        }
        TestCommandEnd();

        TestCommandBegin(__eWait, __cWait, "", "7");
        {
          __Wait("1", (2 * 1000000000), 1000000000, "");
        }
        TestCommandEnd();

      }
    }
    TestControlStructEnd(__eUndefined);

    TestCommandBegin(__eAwaitValueMatch, __cAwaitValueMatch, "", "8");
    {
    
      dword __signalTimes[1];
      int64 __time;
      long __setFailed;
      __setFailed = 0;
      __time = 4 * 1000000000;
      if (__time < 0)
      {
        testStepErrorInTestSystem(0, "1", "Unable to wait for %.3f %s. Please check input parameter.", __time / ((float)1000000000), "s");
      }
      else
      {
        __signalTimes[0] = getSignalTime(`BODY1::dbNode::`DM_FL::`DM_FL_BODY1_Container2_ST3_PW_FL_Stat_ST3::`CSL_LHD_Inact_ST3);
        snprintf(__cArray, elCount(__cArray), "PDU signal '%s'", "CSL_LHD_Inact_ST3");
        __setFailed |= testJoinSignal(`BODY1::dbNode::`DM_FL::`DM_FL_BODY1_Container2_ST3_PW_FL_Stat_ST3::`CSL_LHD_Inact_ST3, "__tt0Callback27", __cArray, 1) < 0;
        if (__setFailed != 0)
        {
          testStepErrorInTestSystem(0, "1", "Unable to set value condition.");
        }
        else
        {
          int64 __occurrenceTime;
          if (testWaitForAllJoinedEventsNS(__time) > 0)
          {
            testStepPass(2, "1", "Waited for occurrence of 1 value condition and signal updates.");
          }
          else
          {
            testStepFail(0, "1", "Waited for occurrence of 1 value condition and signal updates.");
          }
          __ReportTableHead6Columns(__cEmpty, __cTSym, __cTOp, __cRefVal, __cActual, __cEmpty, __cRes);
          __csr = CheckSignalMatch(`BODY1::dbNode::`DM_FL::`DM_FL_BODY1_Container2_ST3_PW_FL_Stat_ST3::`CSL_LHD_Inact_ST3, 2, "==") == 1;
          __ReportTableRow(0, "PDU signal 'CSL_LHD_Inact_ST3'", "==", 2, "I_C02_NDEF_FALSE_TRUE_ST3_TRUE");
          __ReportCell(`BODY1::dbNode::`DM_FL::`DM_FL_BODY1_Container2_ST3_PW_FL_Stat_ST3::`CSL_LHD_Inact_ST3);
          
          {
            dword __signalTime;
            __signalTime = getSignalTime(`BODY1::dbNode::`DM_FL::`DM_FL_BODY1_Container2_ST3_PW_FL_Stat_ST3::`CSL_LHD_Inact_ST3);
            if (__signalTime > __signalTimes[0])
            {
              __ReportCell(__cEmpty);
            }
            else
            {
              __ReportCell("(no update)");
              __csr = 0;
            }
          }
          __ReportCellResult(__csr, __ePassFail);
          __ReportTableEndTestStep(__cEmpty);
        }
      }
    }
    TestCommandEnd();

  }
  TestPreparationEnd();

  TestCommandBegin(__eWait, __cWait, "", "10");
  {
    __Wait("1", (2 * 1000000000), 1000000000, "");
  }
  TestCommandEnd();

  TestCommandBegin(__eSet, __cSet, "", "12");
  {
  
    __ReportTableHead3Columns(__cSetCaption , __cTSym, __cTOp, __cAssigned); 
    {
      $`BODY1::dbNode::`BC_F::`BC_F_BODY1_GW_Container_ST3_Ign_Stat_ST3::`ISw_Stat_ST3.phys = 0;
      __ReportSignalSetLValue("PDU signal 'ISw_Stat_ST3'", `BODY1::dbNode::`BC_F::`BC_F_BODY1_GW_Container_ST3_Ign_Stat_ST3::`ISw_Stat_ST3, __cArray);
      __ReportTableRow(0, __cArray, __cAOp, 0, "I_C03_ISW_STAT_IGN_LOCK");
    }
    __ReportTableEndTestStep("1");
  }
  TestCommandEnd();

  TestCommandBegin(__eWait, __cWait, "", "13");
  {
    __Wait("1", (2 * 1000000000), 1000000000, "");
  }
  TestCommandEnd();

  TestCommandBegin(__eSet, __cSet, "", "14");
  {
  
    __ReportTableHead3Columns(__cSetCaption , __cTSym, __cTOp, __cAssigned); 
    {
      $`BODY1::dbNode::`BC_F::`BC_F_BODY1_GW_Container_ST3_CLkS_Dr_State_ST3::`DrRLtch_FL_Stat_ST3.phys = 1;
      __ReportSignalSetLValue("PDU signal 'DrRLtch_FL_Stat_ST3'", `BODY1::dbNode::`BC_F::`BC_F_BODY1_GW_Container_ST3_CLkS_Dr_State_ST3::`DrRLtch_FL_Stat_ST3, __cArray);
      __ReportTableRow(0, __cArray, __cAOp, 1, "I_C02_DR_STAT_CLS");
    }
    {
      $`BODY1::dbNode::`BC_F::`BC_F_BODY1_GW_Container_ST3_CLkS_Dr_State_ST3::`DrRLtch_FR_Stat_ST3.phys = 1;
      __ReportSignalSetLValue("PDU signal 'DrRLtch_FR_Stat_ST3'", `BODY1::dbNode::`BC_F::`BC_F_BODY1_GW_Container_ST3_CLkS_Dr_State_ST3::`DrRLtch_FR_Stat_ST3, __cArray);
      __ReportTableRow(0, __cArray, __cAOp, 1, "I_C02_DR_STAT_CLS");
    }
    {
      $`BODY1::dbNode::`BC_F::`BC_F_BODY1_GW_Container_ST3_CLkS_Dr_State_ST3::`DrRLtch_RL_Stat_ST3.phys = 1;
      __ReportSignalSetLValue("PDU signal 'DrRLtch_RL_Stat_ST3'", `BODY1::dbNode::`BC_F::`BC_F_BODY1_GW_Container_ST3_CLkS_Dr_State_ST3::`DrRLtch_RL_Stat_ST3, __cArray);
      __ReportTableRow(0, __cArray, __cAOp, 1, "I_C02_DR_STAT_CLS");
    }
    {
      $`BODY1::dbNode::`BC_F::`BC_F_BODY1_GW_Container_ST3_CLkS_Dr_State_ST3::`DrRLtch_RR_Stat_ST3.phys = 1;
      __ReportSignalSetLValue("PDU signal 'DrRLtch_RR_Stat_ST3'", `BODY1::dbNode::`BC_F::`BC_F_BODY1_GW_Container_ST3_CLkS_Dr_State_ST3::`DrRLtch_RR_Stat_ST3, __cArray);
      __ReportTableRow(0, __cArray, __cAOp, 1, "I_C02_DR_STAT_CLS");
    }
    __ReportTableEndTestStep("1");
  }
  TestCommandEnd();

  TestCommandBegin(__eWait, __cWait, "", "15");
  {
    __Wait("1", (2 * 1000000000), 1000000000, "");
  }
  TestCommandEnd();

  TestCommandBegin(__eSet, __cSet, "", "17");
  {
  
    __ReportTableHead3Columns(__cSetCaption , __cTSym, __cTOp, __cAssigned); 
    {
      $`BODY1::dbNode::`EIS_BASE::`EIS_BODY1_Container_ST3_CLkS_Rq_ST3::`CLkS_Ext_Rq_ST3.phys = 1;
      __ReportSignalSetLValue("PDU signal 'CLkS_Ext_Rq_ST3'", `BODY1::dbNode::`EIS_BASE::`EIS_BODY1_Container_ST3_CLkS_Rq_ST3::`CLkS_Ext_Rq_ST3, __cArray);
      __ReportTableRow(0, __cArray, __cAOp, 1, "I_C02_CLKS_RQ_SNA_3H_LK");
    }
    __ReportTableEndTestStep("1");
  }
  TestCommandEnd();

  TestCommandBegin(__eAwaitValueMatch, __cAwaitValueMatch, "", "19");
  {
  
    dword __signalTimes[1];
    int64 __time;
    long __setFailed;
    __setFailed = 0;
    __time = 8 * 1000000000;
    if (__time < 0)
    {
      testStepErrorInTestSystem(0, "1", "Unable to wait for %.3f %s. Please check input parameter.", __time / ((float)1000000000), "s");
    }
    else
    {
      __signalTimes[0] = getSignalTime(`BODY1::dbNode::`DM_FL::`DM_FL_BODY1_Container1_ST3_ExtMirr_FL_Stat_ST3::`MirrAdj_LHD_Fold_Stat_ST3);
      snprintf(__cArray, elCount(__cArray), "PDU signal '%s'", "MirrAdj_LHD_Fold_Stat_ST3");
      __setFailed |= testJoinSignal(`BODY1::dbNode::`DM_FL::`DM_FL_BODY1_Container1_ST3_ExtMirr_FL_Stat_ST3::`MirrAdj_LHD_Fold_Stat_ST3, "__tt0Callback28", __cArray, 1) < 0;
      if (__setFailed != 0)
      {
        testStepErrorInTestSystem(0, "1", "Unable to set value condition.");
      }
      else
      {
        int64 __occurrenceTime;
        if (testWaitForAllJoinedEventsNS(__time) > 0)
        {
          testStepPass(2, "1", "Waited for occurrence of 1 value condition and signal updates.");
        }
        else
        {
          testStepFail(0, "1", "Waited for occurrence of 1 value condition and signal updates.");
        }
        __ReportTableHead6Columns(__cEmpty, __cTSym, __cTOp, __cRefVal, __cActual, __cEmpty, __cRes);
        __csr = CheckSignalMatch(`BODY1::dbNode::`DM_FL::`DM_FL_BODY1_Container1_ST3_ExtMirr_FL_Stat_ST3::`MirrAdj_LHD_Fold_Stat_ST3, 3, "==") == 1;
        __ReportTableRow(0, "PDU signal 'MirrAdj_LHD_Fold_Stat_ST3'", "==", 3, "I_C03_MIRRFLD_STAT_FOLD_IN");
        __ReportCell(`BODY1::dbNode::`DM_FL::`DM_FL_BODY1_Container1_ST3_ExtMirr_FL_Stat_ST3::`MirrAdj_LHD_Fold_Stat_ST3);
        
        {
          dword __signalTime;
          __signalTime = getSignalTime(`BODY1::dbNode::`DM_FL::`DM_FL_BODY1_Container1_ST3_ExtMirr_FL_Stat_ST3::`MirrAdj_LHD_Fold_Stat_ST3);
          if (__signalTime > __signalTimes[0])
          {
            __ReportCell(__cEmpty);
          }
          else
          {
            __ReportCell("(no update)");
            __csr = 0;
          }
        }
        __ReportCellResult(__csr, __ePassFail);
        __ReportTableEndTestStep(__cEmpty);
      }
    }
  }
  TestCommandEnd();

  TestCommandBegin(__eAwaitValueMatch, __cAwaitValueMatch, "", "20");
  {
  
    dword __signalTimes[1];
    int64 __time;
    long __setFailed;
    __setFailed = 0;
    __time = 4.5 * 1000000000;
    if (__time < 0)
    {
      testStepErrorInTestSystem(0, "1", "Unable to wait for %.3f %s. Please check input parameter.", __time / ((float)1000000000), "s");
    }
    else
    {
      __signalTimes[0] = getSignalTime(`BODY1::dbNode::`DM_FL::`DM_FL_BODY1_Container1_ST3_ExtMirr_FL_Stat_ST3::`MirrAdj_LHD_Fold_Stat_ST3);
      snprintf(__cArray, elCount(__cArray), "PDU signal '%s'", "MirrAdj_LHD_Fold_Stat_ST3");
      __setFailed |= testJoinSignal(`BODY1::dbNode::`DM_FL::`DM_FL_BODY1_Container1_ST3_ExtMirr_FL_Stat_ST3::`MirrAdj_LHD_Fold_Stat_ST3, "__tt0Callback29", __cArray, 1) < 0;
      if (__setFailed != 0)
      {
        testStepErrorInTestSystem(0, "1", "Unable to set value condition.");
      }
      else
      {
        int64 __occurrenceTime;
        if (testWaitForAllJoinedEventsNS(__time) > 0)
        {
          testStepPass(2, "1", "Waited for occurrence of 1 value condition and signal updates.");
        }
        else
        {
          testStepFail(0, "1", "Waited for occurrence of 1 value condition and signal updates.");
        }
        __ReportTableHead6Columns(__cEmpty, __cTSym, __cTOp, __cRefVal, __cActual, __cEmpty, __cRes);
        __csr = CheckSignalMatch(`BODY1::dbNode::`DM_FL::`DM_FL_BODY1_Container1_ST3_ExtMirr_FL_Stat_ST3::`MirrAdj_LHD_Fold_Stat_ST3, 1, "==") == 1;
        __ReportTableRow(0, "PDU signal 'MirrAdj_LHD_Fold_Stat_ST3'", "==", 1, "I_C03_MIRRFLD_STAT_FOLDED");
        __ReportCell(`BODY1::dbNode::`DM_FL::`DM_FL_BODY1_Container1_ST3_ExtMirr_FL_Stat_ST3::`MirrAdj_LHD_Fold_Stat_ST3);
        
        {
          dword __signalTime;
          __signalTime = getSignalTime(`BODY1::dbNode::`DM_FL::`DM_FL_BODY1_Container1_ST3_ExtMirr_FL_Stat_ST3::`MirrAdj_LHD_Fold_Stat_ST3);
          if (__signalTime > __signalTimes[0])
          {
            __ReportCell(__cEmpty);
          }
          else
          {
            __ReportCell("(no update)");
            __csr = 0;
          }
        }
        __ReportCellResult(__csr, __ePassFail);
        __ReportTableEndTestStep(__cEmpty);
      }
    }
  }
  TestCommandEnd();

  TestCommandBegin(__eWait, __cWait, "", "21");
  {
    __Wait("1", (1500 * 1000000000), 1000000000, "");
  }
  TestCommandEnd();

  TestCommandBegin(__eSet, __cSet, "", "23");
  {
  
    __ReportTableHead3Columns(__cSetCaption , __cTSym, __cTOp, __cAssigned); 
    {
      $`BODY1::dbNode::`EIS_BASE::`EIS_BODY1_Container_ST3_CLkS_Rq_ST3::`CLkS_Ext_Rq_ST3.phys = 2;
      __ReportSignalSetLValue("PDU signal 'CLkS_Ext_Rq_ST3'", `BODY1::dbNode::`EIS_BASE::`EIS_BODY1_Container_ST3_CLkS_Rq_ST3::`CLkS_Ext_Rq_ST3, __cArray);
      __ReportTableRow(0, __cArray, __cAOp, 2, "I_C02_CLKS_RQ_SNA_3H_UNLK");
    }
    __ReportTableEndTestStep("1");
  }
  TestCommandEnd();

  TestCommandBegin(__eAwaitValueMatch, __cAwaitValueMatch, "", "25");
  {
  
    dword __signalTimes[1];
    int64 __time;
    long __setFailed;
    __setFailed = 0;
    __time = 8 * 1000000000;
    if (__time < 0)
    {
      testStepErrorInTestSystem(0, "1", "Unable to wait for %.3f %s. Please check input parameter.", __time / ((float)1000000000), "s");
    }
    else
    {
      __signalTimes[0] = getSignalTime(`BODY1::dbNode::`DM_FL::`DM_FL_BODY1_Container1_ST3_ExtMirr_FL_Stat_ST3::`MirrAdj_LHD_Fold_Stat_ST3);
      snprintf(__cArray, elCount(__cArray), "PDU signal '%s'", "MirrAdj_LHD_Fold_Stat_ST3");
      __setFailed |= testJoinSignal(`BODY1::dbNode::`DM_FL::`DM_FL_BODY1_Container1_ST3_ExtMirr_FL_Stat_ST3::`MirrAdj_LHD_Fold_Stat_ST3, "__tt0Callback30", __cArray, 1) < 0;
      if (__setFailed != 0)
      {
        testStepErrorInTestSystem(0, "1", "Unable to set value condition.");
      }
      else
      {
        int64 __occurrenceTime;
        if (testWaitForAllJoinedEventsNS(__time) > 0)
        {
          testStepPass(2, "1", "Waited for occurrence of 1 value condition and signal updates.");
        }
        else
        {
          testStepFail(0, "1", "Waited for occurrence of 1 value condition and signal updates.");
        }
        __ReportTableHead6Columns(__cEmpty, __cTSym, __cTOp, __cRefVal, __cActual, __cEmpty, __cRes);
        __csr = CheckSignalMatch(`BODY1::dbNode::`DM_FL::`DM_FL_BODY1_Container1_ST3_ExtMirr_FL_Stat_ST3::`MirrAdj_LHD_Fold_Stat_ST3, 4, "==") == 1;
        __ReportTableRow(0, "PDU signal 'MirrAdj_LHD_Fold_Stat_ST3'", "==", 4, "I_C03_MIRRFLD_STAT_FOLD_OUT");
        __ReportCell(`BODY1::dbNode::`DM_FL::`DM_FL_BODY1_Container1_ST3_ExtMirr_FL_Stat_ST3::`MirrAdj_LHD_Fold_Stat_ST3);
        
        {
          dword __signalTime;
          __signalTime = getSignalTime(`BODY1::dbNode::`DM_FL::`DM_FL_BODY1_Container1_ST3_ExtMirr_FL_Stat_ST3::`MirrAdj_LHD_Fold_Stat_ST3);
          if (__signalTime > __signalTimes[0])
          {
            __ReportCell(__cEmpty);
          }
          else
          {
            __ReportCell("(no update)");
            __csr = 0;
          }
        }
        __ReportCellResult(__csr, __ePassFail);
        __ReportTableEndTestStep(__cEmpty);
      }
    }
  }
  TestCommandEnd();

  TestCommandBegin(__eAwaitValueMatch, __cAwaitValueMatch, "", "26");
  {
  
    dword __signalTimes[1];
    int64 __time;
    long __setFailed;
    __setFailed = 0;
    __time = 4.5 * 1000000000;
    if (__time < 0)
    {
      testStepErrorInTestSystem(0, "1", "Unable to wait for %.3f %s. Please check input parameter.", __time / ((float)1000000000), "s");
    }
    else
    {
      __signalTimes[0] = getSignalTime(`BODY1::dbNode::`DM_FL::`DM_FL_BODY1_Container1_ST3_ExtMirr_FL_Stat_ST3::`MirrAdj_LHD_Fold_Stat_ST3);
      snprintf(__cArray, elCount(__cArray), "PDU signal '%s'", "MirrAdj_LHD_Fold_Stat_ST3");
      __setFailed |= testJoinSignal(`BODY1::dbNode::`DM_FL::`DM_FL_BODY1_Container1_ST3_ExtMirr_FL_Stat_ST3::`MirrAdj_LHD_Fold_Stat_ST3, "__tt0Callback31", __cArray, 1) < 0;
      if (__setFailed != 0)
      {
        testStepErrorInTestSystem(0, "1", "Unable to set value condition.");
      }
      else
      {
        int64 __occurrenceTime;
        if (testWaitForAllJoinedEventsNS(__time) > 0)
        {
          testStepPass(2, "1", "Waited for occurrence of 1 value condition and signal updates.");
        }
        else
        {
          testStepFail(0, "1", "Waited for occurrence of 1 value condition and signal updates.");
        }
        __ReportTableHead6Columns(__cEmpty, __cTSym, __cTOp, __cRefVal, __cActual, __cEmpty, __cRes);
        __csr = CheckSignalMatch(`BODY1::dbNode::`DM_FL::`DM_FL_BODY1_Container1_ST3_ExtMirr_FL_Stat_ST3::`MirrAdj_LHD_Fold_Stat_ST3, 2, "==") == 1;
        __ReportTableRow(0, "PDU signal 'MirrAdj_LHD_Fold_Stat_ST3'", "==", 2, "I_C03_MIRRFLD_STAT_UNFOLDED");
        __ReportCell(`BODY1::dbNode::`DM_FL::`DM_FL_BODY1_Container1_ST3_ExtMirr_FL_Stat_ST3::`MirrAdj_LHD_Fold_Stat_ST3);
        
        {
          dword __signalTime;
          __signalTime = getSignalTime(`BODY1::dbNode::`DM_FL::`DM_FL_BODY1_Container1_ST3_ExtMirr_FL_Stat_ST3::`MirrAdj_LHD_Fold_Stat_ST3);
          if (__signalTime > __signalTimes[0])
          {
            __ReportCell(__cEmpty);
          }
          else
          {
            __ReportCell("(no update)");
            __csr = 0;
          }
        }
        __ReportCellResult(__csr, __ePassFail);
        __ReportTableEndTestStep(__cEmpty);
      }
    }
  }
  TestCommandEnd();

  TestCommandBegin(__eWait, __cWait, "", "27");
  {
    __Wait("1", (2 * 1000000000), 1000000000, "");
  }
  TestCommandEnd();

  TestCommandBegin(__eReport, __cReport, __cEmpty, "29");
  {
    __ReportTableHead2Columns("Child Lock safety status", __cTSym, __cValue);
    __ReportSignal("PDU signal 'CSL_LHD_Inact_ST3'", `BODY1::dbNode::`DM_FL::`DM_FL_BODY1_Container2_ST3_PW_FL_Stat_ST3::`CSL_LHD_Inact_ST3, __cArray, 0 );
    testInfoRow(__tableHandle, 0, __cArray);
    __ReportCell(`BODY1::dbNode::`DM_FL::`DM_FL_BODY1_Container2_ST3_PW_FL_Stat_ST3::`CSL_LHD_Inact_ST3);
    __ReportTableEndTestStep(__cEmpty);
  }
  TestCommandEnd();

  TestCommandBegin(__eSet, __cSet, "", "30");
  {
  
    __ReportTableHead3Columns(__cSetCaption , __cTSym, __cTOp, __cAssigned); 
    {
      $`BODY1::dbNode::`BC_F::`BC_F_BODY1_GW_Container_ST3_Ign_Stat_ST3::`ISw_Stat_ST3.phys = 4;
      __ReportSignalSetLValue("PDU signal 'ISw_Stat_ST3'", `BODY1::dbNode::`BC_F::`BC_F_BODY1_GW_Container_ST3_Ign_Stat_ST3::`ISw_Stat_ST3, __cArray);
      __ReportTableRow(0, __cArray, __cAOp, 4, "I_C03_ISW_STAT_IGN_ON");
    }
    __ReportTableEndTestStep("1");
  }
  TestCommandEnd();

  TestCommandBegin(__eWait, __cWait, "", "31");
  {
    __Wait("1", (2 * 1000000000), 1000000000, "");
  }
  TestCommandEnd();

  TestCommandBegin(__eReport, __cReport, __cEmpty, "32");
  {
    __ReportTableHead2Columns("Child Lock safety status", __cTSym, __cValue);
    __ReportSignal("PDU signal 'CSL_LHD_Inact_ST3'", `BODY1::dbNode::`DM_FL::`DM_FL_BODY1_Container2_ST3_PW_FL_Stat_ST3::`CSL_LHD_Inact_ST3, __cArray, 0 );
    testInfoRow(__tableHandle, 0, __cArray);
    __ReportCell(`BODY1::dbNode::`DM_FL::`DM_FL_BODY1_Container2_ST3_PW_FL_Stat_ST3::`CSL_LHD_Inact_ST3);
    __ReportTableEndTestStep(__cEmpty);
  }
  TestCommandEnd();

}

dword __tt0Callback27(signal * __cbParam)
{

  __csr = CheckSignalMatch(__cbParam, 2, "==") == 1;
  return __csr;
}
dword __tt0Callback28(signal * __cbParam)
{

  __csr = CheckSignalMatch(__cbParam, 3, "==") == 1;
  return __csr;
}
dword __tt0Callback29(signal * __cbParam)
{

  __csr = CheckSignalMatch(__cbParam, 1, "==") == 1;
  return __csr;
}
dword __tt0Callback30(signal * __cbParam)
{

  __csr = CheckSignalMatch(__cbParam, 4, "==") == 1;
  return __csr;
}
dword __tt0Callback31(signal * __cbParam)
{

  __csr = CheckSignalMatch(__cbParam, 2, "==") == 1;
  return __csr;
}

testcase Tt0_LockSimul_Test_CSL_activated(int64 iteration, int64 CSL_actuation_TimerMS)
{
  int64 __ifExec2;

  SetBreakOnFail(0);

  TestPreparationBegin();
  {
    TestCommandBegin(__eSet, __cSet, "", "0");
    {
    
      __ReportTableHead3Columns(__cSetCaption , __cTSym, __cTOp, __cAssigned); 
      {
        $`BODY1::dbNode::`BC_F::`BC_F_BODY1_GW_Container_ST3_ExtMirr_Settings_ST3::`MirrFldPk_Rq_ST3.phys = 1;
        __ReportSignalSetLValue("PDU signal 'MirrFldPk_Rq_ST3'", `BODY1::dbNode::`BC_F::`BC_F_BODY1_GW_Container_ST3_ExtMirr_Settings_ST3::`MirrFldPk_Rq_ST3, __cArray);
        __ReportTableRow(0, __cArray, __cAOp, 1, "I_C02_OFF_ON_ON");
      }
      __ReportTableEndTestStep("1");
    }
    TestCommandEnd();

    TestCommandBegin(__eWait, __cWait, "", "1");
    {
      __Wait("1", (2 * 1000000000), 1000000000, "");
    }
    TestCommandEnd();

    
    TestControlStructBegin(__cIf, "", "3");
    {
      int64 __condition;
      {
        int64 __expr0;
        __ifExec2 = 0;
    
        {
          __csr = CheckSignalMatch(`BODY1::dbNode::`DM_FL::`DM_FL_BODY1_Container2_ST3_PW_FL_Stat_ST3::`CSL_LHD_Inact_ST3, 2, "==") == 1;
        }
        {
          __expr0 = __csr;
        }
        __condition = __expr0;
    
          snprintf(__cConditionArray, 2048, "%s", "");
          snprintf(__cCompareArray, 2048, "%s", "");
          snprintf(__cCompareArray, 2048, "%s%s%s", "CSL_LHD_Inact_ST3", "==", "I_C02_NDEF_FALSE_TRUE_ST3_TRUE");
          snprintf(__cArray, 2048, "%s", __cCompareArray);
          snprintf(__cCompareArray, 2048, "( %s )", __cArray);
          snprintf(__cArray, 2048, "%s", __cConditionArray);
          snprintf(__cConditionArray, 2048, "%s%s", __cArray, __cCompareArray);
          snprintf(__cArray, 2048, "%s", __cConditionArray);
          snprintf(__cConditionArray, 2048, "%s %s", "If", __cArray);
    
        __ReportConditionTableHead(__cConditionArray, __condition);
        {
          __csr = CheckSignalMatch(`BODY1::dbNode::`DM_FL::`DM_FL_BODY1_Container2_ST3_PW_FL_Stat_ST3::`CSL_LHD_Inact_ST3, 2, "==") == 1;
          __ReportTableRow(0, "PDU signal 'CSL_LHD_Inact_ST3'", "==", 2, "I_C02_NDEF_FALSE_TRUE_ST3_TRUE");
          __ReportCell(`BODY1::dbNode::`DM_FL::`DM_FL_BODY1_Container2_ST3_PW_FL_Stat_ST3::`CSL_LHD_Inact_ST3);
          __ReportCellResult(__csr, __eTrueFalse); 
        }
        __ReportTableEndCondition(__cIfCondition);
      }
    
      if(__condition)
      {  
        __ifExec2 = 1;

        TestCommandBegin(__eSet, __cSet, "", "4");
        {
        
          __ReportTableHead3Columns(__cSetCaption , __cTSym, __cTOp, __cAssigned); 
          {
            $`LinDB::dbNode::`DSM_WM_DOOR::`DSM_WM_Frm1_AR_DOOR::`CSL_Sw_Psd_DOOR.phys = 1;
            __ReportSignalSetLValue("LIN signal 'CSL_Sw_Psd_DOOR'", `LinDB::dbNode::`DSM_WM_DOOR::`DSM_WM_Frm1_AR_DOOR::`CSL_Sw_Psd_DOOR, __cArray);
            __ReportTableRow(0, __cArray, __cAOp, 1, "");
          }
          __ReportTableEndTestStep("1");
        }
        TestCommandEnd();

        TestCommandBegin(__eWait, __cWait, "", "5");
        {
          __Wait("1", (((int64)CSL_actuation_TimerMS) * 1000000), 1000000, "CSL_actuation_TimerMS");
        }
        TestCommandEnd();

        TestCommandBegin(__eSet, __cSet, "", "6");
        {
        
          __ReportTableHead3Columns(__cSetCaption , __cTSym, __cTOp, __cAssigned); 
          {
            $`LinDB::dbNode::`DSM_WM_DOOR::`DSM_WM_Frm1_AR_DOOR::`CSL_Sw_Psd_DOOR.phys = 0;
            __ReportSignalSetLValue("LIN signal 'CSL_Sw_Psd_DOOR'", `LinDB::dbNode::`DSM_WM_DOOR::`DSM_WM_Frm1_AR_DOOR::`CSL_Sw_Psd_DOOR, __cArray);
            __ReportTableRow(0, __cArray, __cAOp, 0, "");
          }
          __ReportTableEndTestStep("1");
        }
        TestCommandEnd();

        TestCommandBegin(__eWait, __cWait, "", "7");
        {
          __Wait("1", (2 * 1000000000), 1000000000, "");
        }
        TestCommandEnd();

      }
    }
    TestControlStructEnd(__eUndefined);

    TestCommandBegin(__eAwaitValueMatch, __cAwaitValueMatch, "", "8");
    {
    
      dword __signalTimes[1];
      int64 __time;
      long __setFailed;
      __setFailed = 0;
      __time = 4 * 1000000000;
      if (__time < 0)
      {
        testStepErrorInTestSystem(0, "1", "Unable to wait for %.3f %s. Please check input parameter.", __time / ((float)1000000000), "s");
      }
      else
      {
        __signalTimes[0] = getSignalTime(`BODY1::dbNode::`DM_FL::`DM_FL_BODY1_Container2_ST3_PW_FL_Stat_ST3::`CSL_LHD_Inact_ST3);
        snprintf(__cArray, elCount(__cArray), "PDU signal '%s'", "CSL_LHD_Inact_ST3");
        __setFailed |= testJoinSignal(`BODY1::dbNode::`DM_FL::`DM_FL_BODY1_Container2_ST3_PW_FL_Stat_ST3::`CSL_LHD_Inact_ST3, "__tt0Callback32", __cArray, 1) < 0;
        if (__setFailed != 0)
        {
          testStepErrorInTestSystem(0, "1", "Unable to set value condition.");
        }
        else
        {
          int64 __occurrenceTime;
          if (testWaitForAllJoinedEventsNS(__time) > 0)
          {
            testStepPass(2, "1", "Waited for occurrence of 1 value condition and signal updates.");
          }
          else
          {
            testStepFail(0, "1", "Waited for occurrence of 1 value condition and signal updates.");
          }
          __ReportTableHead6Columns(__cEmpty, __cTSym, __cTOp, __cRefVal, __cActual, __cEmpty, __cRes);
          __csr = CheckSignalMatch(`BODY1::dbNode::`DM_FL::`DM_FL_BODY1_Container2_ST3_PW_FL_Stat_ST3::`CSL_LHD_Inact_ST3, 1, "==") == 1;
          __ReportTableRow(0, "PDU signal 'CSL_LHD_Inact_ST3'", "==", 1, "I_C02_NDEF_FALSE_TRUE_ST3_FALSE");
          __ReportCell(`BODY1::dbNode::`DM_FL::`DM_FL_BODY1_Container2_ST3_PW_FL_Stat_ST3::`CSL_LHD_Inact_ST3);
          
          {
            dword __signalTime;
            __signalTime = getSignalTime(`BODY1::dbNode::`DM_FL::`DM_FL_BODY1_Container2_ST3_PW_FL_Stat_ST3::`CSL_LHD_Inact_ST3);
            if (__signalTime > __signalTimes[0])
            {
              __ReportCell(__cEmpty);
            }
            else
            {
              __ReportCell("(no update)");
              __csr = 0;
            }
          }
          __ReportCellResult(__csr, __ePassFail);
          __ReportTableEndTestStep(__cEmpty);
        }
      }
    }
    TestCommandEnd();

  }
  TestPreparationEnd();

  TestCommandBegin(__eWait, __cWait, "", "10");
  {
    __Wait("1", (2 * 1000000000), 1000000000, "");
  }
  TestCommandEnd();

  TestCommandBegin(__eSet, __cSet, "", "12");
  {
  
    __ReportTableHead3Columns(__cSetCaption , __cTSym, __cTOp, __cAssigned); 
    {
      $`BODY1::dbNode::`BC_F::`BC_F_BODY1_GW_Container_ST3_Ign_Stat_ST3::`ISw_Stat_ST3.phys = 0;
      __ReportSignalSetLValue("PDU signal 'ISw_Stat_ST3'", `BODY1::dbNode::`BC_F::`BC_F_BODY1_GW_Container_ST3_Ign_Stat_ST3::`ISw_Stat_ST3, __cArray);
      __ReportTableRow(0, __cArray, __cAOp, 0, "I_C03_ISW_STAT_IGN_LOCK");
    }
    __ReportTableEndTestStep("1");
  }
  TestCommandEnd();

  TestCommandBegin(__eWait, __cWait, "", "13");
  {
    __Wait("1", (2 * 1000000000), 1000000000, "");
  }
  TestCommandEnd();

  TestCommandBegin(__eSet, __cSet, "", "14");
  {
  
    __ReportTableHead3Columns(__cSetCaption , __cTSym, __cTOp, __cAssigned); 
    {
      $`BODY1::dbNode::`BC_F::`BC_F_BODY1_GW_Container_ST3_CLkS_Dr_State_ST3::`DrRLtch_FL_Stat_ST3.phys = 1;
      __ReportSignalSetLValue("PDU signal 'DrRLtch_FL_Stat_ST3'", `BODY1::dbNode::`BC_F::`BC_F_BODY1_GW_Container_ST3_CLkS_Dr_State_ST3::`DrRLtch_FL_Stat_ST3, __cArray);
      __ReportTableRow(0, __cArray, __cAOp, 1, "I_C02_DR_STAT_CLS");
    }
    {
      $`BODY1::dbNode::`BC_F::`BC_F_BODY1_GW_Container_ST3_CLkS_Dr_State_ST3::`DrRLtch_FR_Stat_ST3.phys = 1;
      __ReportSignalSetLValue("PDU signal 'DrRLtch_FR_Stat_ST3'", `BODY1::dbNode::`BC_F::`BC_F_BODY1_GW_Container_ST3_CLkS_Dr_State_ST3::`DrRLtch_FR_Stat_ST3, __cArray);
      __ReportTableRow(0, __cArray, __cAOp, 1, "I_C02_DR_STAT_CLS");
    }
    {
      $`BODY1::dbNode::`BC_F::`BC_F_BODY1_GW_Container_ST3_CLkS_Dr_State_ST3::`DrRLtch_RL_Stat_ST3.phys = 1;
      __ReportSignalSetLValue("PDU signal 'DrRLtch_RL_Stat_ST3'", `BODY1::dbNode::`BC_F::`BC_F_BODY1_GW_Container_ST3_CLkS_Dr_State_ST3::`DrRLtch_RL_Stat_ST3, __cArray);
      __ReportTableRow(0, __cArray, __cAOp, 1, "I_C02_DR_STAT_CLS");
    }
    {
      $`BODY1::dbNode::`BC_F::`BC_F_BODY1_GW_Container_ST3_CLkS_Dr_State_ST3::`DrRLtch_RR_Stat_ST3.phys = 1;
      __ReportSignalSetLValue("PDU signal 'DrRLtch_RR_Stat_ST3'", `BODY1::dbNode::`BC_F::`BC_F_BODY1_GW_Container_ST3_CLkS_Dr_State_ST3::`DrRLtch_RR_Stat_ST3, __cArray);
      __ReportTableRow(0, __cArray, __cAOp, 1, "I_C02_DR_STAT_CLS");
    }
    __ReportTableEndTestStep("1");
  }
  TestCommandEnd();

  TestCommandBegin(__eWait, __cWait, "", "15");
  {
    __Wait("1", (2 * 1000000000), 1000000000, "");
  }
  TestCommandEnd();

  TestCommandBegin(__eSet, __cSet, "", "17");
  {
  
    __ReportTableHead3Columns(__cSetCaption , __cTSym, __cTOp, __cAssigned); 
    {
      $`BODY1::dbNode::`EIS_BASE::`EIS_BODY1_Container_ST3_CLkS_Rq_ST3::`CLkS_Ext_Rq_ST3.phys = 1;
      __ReportSignalSetLValue("PDU signal 'CLkS_Ext_Rq_ST3'", `BODY1::dbNode::`EIS_BASE::`EIS_BODY1_Container_ST3_CLkS_Rq_ST3::`CLkS_Ext_Rq_ST3, __cArray);
      __ReportTableRow(0, __cArray, __cAOp, 1, "I_C02_CLKS_RQ_SNA_3H_LK");
    }
    __ReportTableEndTestStep("1");
  }
  TestCommandEnd();

  TestCommandBegin(__eAwaitValueMatch, __cAwaitValueMatch, "", "19");
  {
  
    dword __signalTimes[1];
    int64 __time;
    long __setFailed;
    __setFailed = 0;
    __time = 8 * 1000000000;
    if (__time < 0)
    {
      testStepErrorInTestSystem(0, "1", "Unable to wait for %.3f %s. Please check input parameter.", __time / ((float)1000000000), "s");
    }
    else
    {
      __signalTimes[0] = getSignalTime(`BODY1::dbNode::`DM_FL::`DM_FL_BODY1_Container1_ST3_ExtMirr_FL_Stat_ST3::`MirrAdj_LHD_Fold_Stat_ST3);
      snprintf(__cArray, elCount(__cArray), "PDU signal '%s'", "MirrAdj_LHD_Fold_Stat_ST3");
      __setFailed |= testJoinSignal(`BODY1::dbNode::`DM_FL::`DM_FL_BODY1_Container1_ST3_ExtMirr_FL_Stat_ST3::`MirrAdj_LHD_Fold_Stat_ST3, "__tt0Callback33", __cArray, 1) < 0;
      if (__setFailed != 0)
      {
        testStepErrorInTestSystem(0, "1", "Unable to set value condition.");
      }
      else
      {
        int64 __occurrenceTime;
        if (testWaitForAllJoinedEventsNS(__time) > 0)
        {
          testStepPass(2, "1", "Waited for occurrence of 1 value condition and signal updates.");
        }
        else
        {
          testStepFail(0, "1", "Waited for occurrence of 1 value condition and signal updates.");
        }
        __ReportTableHead6Columns(__cEmpty, __cTSym, __cTOp, __cRefVal, __cActual, __cEmpty, __cRes);
        __csr = CheckSignalMatch(`BODY1::dbNode::`DM_FL::`DM_FL_BODY1_Container1_ST3_ExtMirr_FL_Stat_ST3::`MirrAdj_LHD_Fold_Stat_ST3, 3, "==") == 1;
        __ReportTableRow(0, "PDU signal 'MirrAdj_LHD_Fold_Stat_ST3'", "==", 3, "I_C03_MIRRFLD_STAT_FOLD_IN");
        __ReportCell(`BODY1::dbNode::`DM_FL::`DM_FL_BODY1_Container1_ST3_ExtMirr_FL_Stat_ST3::`MirrAdj_LHD_Fold_Stat_ST3);
        
        {
          dword __signalTime;
          __signalTime = getSignalTime(`BODY1::dbNode::`DM_FL::`DM_FL_BODY1_Container1_ST3_ExtMirr_FL_Stat_ST3::`MirrAdj_LHD_Fold_Stat_ST3);
          if (__signalTime > __signalTimes[0])
          {
            __ReportCell(__cEmpty);
          }
          else
          {
            __ReportCell("(no update)");
            __csr = 0;
          }
        }
        __ReportCellResult(__csr, __ePassFail);
        __ReportTableEndTestStep(__cEmpty);
      }
    }
  }
  TestCommandEnd();

  TestCommandBegin(__eAwaitValueMatch, __cAwaitValueMatch, "", "20");
  {
  
    dword __signalTimes[1];
    int64 __time;
    long __setFailed;
    __setFailed = 0;
    __time = 4.5 * 1000000000;
    if (__time < 0)
    {
      testStepErrorInTestSystem(0, "1", "Unable to wait for %.3f %s. Please check input parameter.", __time / ((float)1000000000), "s");
    }
    else
    {
      __signalTimes[0] = getSignalTime(`BODY1::dbNode::`DM_FL::`DM_FL_BODY1_Container1_ST3_ExtMirr_FL_Stat_ST3::`MirrAdj_LHD_Fold_Stat_ST3);
      snprintf(__cArray, elCount(__cArray), "PDU signal '%s'", "MirrAdj_LHD_Fold_Stat_ST3");
      __setFailed |= testJoinSignal(`BODY1::dbNode::`DM_FL::`DM_FL_BODY1_Container1_ST3_ExtMirr_FL_Stat_ST3::`MirrAdj_LHD_Fold_Stat_ST3, "__tt0Callback34", __cArray, 1) < 0;
      if (__setFailed != 0)
      {
        testStepErrorInTestSystem(0, "1", "Unable to set value condition.");
      }
      else
      {
        int64 __occurrenceTime;
        if (testWaitForAllJoinedEventsNS(__time) > 0)
        {
          testStepPass(2, "1", "Waited for occurrence of 1 value condition and signal updates.");
        }
        else
        {
          testStepFail(0, "1", "Waited for occurrence of 1 value condition and signal updates.");
        }
        __ReportTableHead6Columns(__cEmpty, __cTSym, __cTOp, __cRefVal, __cActual, __cEmpty, __cRes);
        __csr = CheckSignalMatch(`BODY1::dbNode::`DM_FL::`DM_FL_BODY1_Container1_ST3_ExtMirr_FL_Stat_ST3::`MirrAdj_LHD_Fold_Stat_ST3, 1, "==") == 1;
        __ReportTableRow(0, "PDU signal 'MirrAdj_LHD_Fold_Stat_ST3'", "==", 1, "I_C03_MIRRFLD_STAT_FOLDED");
        __ReportCell(`BODY1::dbNode::`DM_FL::`DM_FL_BODY1_Container1_ST3_ExtMirr_FL_Stat_ST3::`MirrAdj_LHD_Fold_Stat_ST3);
        
        {
          dword __signalTime;
          __signalTime = getSignalTime(`BODY1::dbNode::`DM_FL::`DM_FL_BODY1_Container1_ST3_ExtMirr_FL_Stat_ST3::`MirrAdj_LHD_Fold_Stat_ST3);
          if (__signalTime > __signalTimes[0])
          {
            __ReportCell(__cEmpty);
          }
          else
          {
            __ReportCell("(no update)");
            __csr = 0;
          }
        }
        __ReportCellResult(__csr, __ePassFail);
        __ReportTableEndTestStep(__cEmpty);
      }
    }
  }
  TestCommandEnd();

  TestCommandBegin(__eWait, __cWait, "", "21");
  {
    __Wait("1", (10 * 1000000000), 1000000000, "");
  }
  TestCommandEnd();

  TestCommandBegin(__eSet, __cSet, "", "23");
  {
  
    __ReportTableHead3Columns(__cSetCaption , __cTSym, __cTOp, __cAssigned); 
    {
      $`BODY1::dbNode::`EIS_BASE::`EIS_BODY1_Container_ST3_CLkS_Rq_ST3::`CLkS_Ext_Rq_ST3.phys = 2;
      __ReportSignalSetLValue("PDU signal 'CLkS_Ext_Rq_ST3'", `BODY1::dbNode::`EIS_BASE::`EIS_BODY1_Container_ST3_CLkS_Rq_ST3::`CLkS_Ext_Rq_ST3, __cArray);
      __ReportTableRow(0, __cArray, __cAOp, 2, "I_C02_CLKS_RQ_SNA_3H_UNLK");
    }
    __ReportTableEndTestStep("1");
  }
  TestCommandEnd();

  TestCommandBegin(__eAwaitValueMatch, __cAwaitValueMatch, "", "25");
  {
  
    dword __signalTimes[1];
    int64 __time;
    long __setFailed;
    __setFailed = 0;
    __time = 8 * 1000000000;
    if (__time < 0)
    {
      testStepErrorInTestSystem(0, "1", "Unable to wait for %.3f %s. Please check input parameter.", __time / ((float)1000000000), "s");
    }
    else
    {
      __signalTimes[0] = getSignalTime(`BODY1::dbNode::`DM_FL::`DM_FL_BODY1_Container1_ST3_ExtMirr_FL_Stat_ST3::`MirrAdj_LHD_Fold_Stat_ST3);
      snprintf(__cArray, elCount(__cArray), "PDU signal '%s'", "MirrAdj_LHD_Fold_Stat_ST3");
      __setFailed |= testJoinSignal(`BODY1::dbNode::`DM_FL::`DM_FL_BODY1_Container1_ST3_ExtMirr_FL_Stat_ST3::`MirrAdj_LHD_Fold_Stat_ST3, "__tt0Callback35", __cArray, 1) < 0;
      if (__setFailed != 0)
      {
        testStepErrorInTestSystem(0, "1", "Unable to set value condition.");
      }
      else
      {
        int64 __occurrenceTime;
        if (testWaitForAllJoinedEventsNS(__time) > 0)
        {
          testStepPass(2, "1", "Waited for occurrence of 1 value condition and signal updates.");
        }
        else
        {
          testStepFail(0, "1", "Waited for occurrence of 1 value condition and signal updates.");
        }
        __ReportTableHead6Columns(__cEmpty, __cTSym, __cTOp, __cRefVal, __cActual, __cEmpty, __cRes);
        __csr = CheckSignalMatch(`BODY1::dbNode::`DM_FL::`DM_FL_BODY1_Container1_ST3_ExtMirr_FL_Stat_ST3::`MirrAdj_LHD_Fold_Stat_ST3, 4, "==") == 1;
        __ReportTableRow(0, "PDU signal 'MirrAdj_LHD_Fold_Stat_ST3'", "==", 4, "I_C03_MIRRFLD_STAT_FOLD_OUT");
        __ReportCell(`BODY1::dbNode::`DM_FL::`DM_FL_BODY1_Container1_ST3_ExtMirr_FL_Stat_ST3::`MirrAdj_LHD_Fold_Stat_ST3);
        
        {
          dword __signalTime;
          __signalTime = getSignalTime(`BODY1::dbNode::`DM_FL::`DM_FL_BODY1_Container1_ST3_ExtMirr_FL_Stat_ST3::`MirrAdj_LHD_Fold_Stat_ST3);
          if (__signalTime > __signalTimes[0])
          {
            __ReportCell(__cEmpty);
          }
          else
          {
            __ReportCell("(no update)");
            __csr = 0;
          }
        }
        __ReportCellResult(__csr, __ePassFail);
        __ReportTableEndTestStep(__cEmpty);
      }
    }
  }
  TestCommandEnd();

  TestCommandBegin(__eAwaitValueMatch, __cAwaitValueMatch, "", "26");
  {
  
    dword __signalTimes[1];
    int64 __time;
    long __setFailed;
    __setFailed = 0;
    __time = 4.5 * 1000000000;
    if (__time < 0)
    {
      testStepErrorInTestSystem(0, "1", "Unable to wait for %.3f %s. Please check input parameter.", __time / ((float)1000000000), "s");
    }
    else
    {
      __signalTimes[0] = getSignalTime(`BODY1::dbNode::`DM_FL::`DM_FL_BODY1_Container1_ST3_ExtMirr_FL_Stat_ST3::`MirrAdj_LHD_Fold_Stat_ST3);
      snprintf(__cArray, elCount(__cArray), "PDU signal '%s'", "MirrAdj_LHD_Fold_Stat_ST3");
      __setFailed |= testJoinSignal(`BODY1::dbNode::`DM_FL::`DM_FL_BODY1_Container1_ST3_ExtMirr_FL_Stat_ST3::`MirrAdj_LHD_Fold_Stat_ST3, "__tt0Callback36", __cArray, 1) < 0;
      if (__setFailed != 0)
      {
        testStepErrorInTestSystem(0, "1", "Unable to set value condition.");
      }
      else
      {
        int64 __occurrenceTime;
        if (testWaitForAllJoinedEventsNS(__time) > 0)
        {
          testStepPass(2, "1", "Waited for occurrence of 1 value condition and signal updates.");
        }
        else
        {
          testStepFail(0, "1", "Waited for occurrence of 1 value condition and signal updates.");
        }
        __ReportTableHead6Columns(__cEmpty, __cTSym, __cTOp, __cRefVal, __cActual, __cEmpty, __cRes);
        __csr = CheckSignalMatch(`BODY1::dbNode::`DM_FL::`DM_FL_BODY1_Container1_ST3_ExtMirr_FL_Stat_ST3::`MirrAdj_LHD_Fold_Stat_ST3, 2, "==") == 1;
        __ReportTableRow(0, "PDU signal 'MirrAdj_LHD_Fold_Stat_ST3'", "==", 2, "I_C03_MIRRFLD_STAT_UNFOLDED");
        __ReportCell(`BODY1::dbNode::`DM_FL::`DM_FL_BODY1_Container1_ST3_ExtMirr_FL_Stat_ST3::`MirrAdj_LHD_Fold_Stat_ST3);
        
        {
          dword __signalTime;
          __signalTime = getSignalTime(`BODY1::dbNode::`DM_FL::`DM_FL_BODY1_Container1_ST3_ExtMirr_FL_Stat_ST3::`MirrAdj_LHD_Fold_Stat_ST3);
          if (__signalTime > __signalTimes[0])
          {
            __ReportCell(__cEmpty);
          }
          else
          {
            __ReportCell("(no update)");
            __csr = 0;
          }
        }
        __ReportCellResult(__csr, __ePassFail);
        __ReportTableEndTestStep(__cEmpty);
      }
    }
  }
  TestCommandEnd();

  TestCommandBegin(__eWait, __cWait, "", "27");
  {
    __Wait("1", (2 * 1000000000), 1000000000, "");
  }
  TestCommandEnd();

  TestCommandBegin(__eSet, __cSet, "", "29");
  {
  
    __ReportTableHead3Columns(__cSetCaption , __cTSym, __cTOp, __cAssigned); 
    {
      $`BODY1::dbNode::`BC_F::`BC_F_BODY1_GW_Container_ST3_Ign_Stat_ST3::`ISw_Stat_ST3.phys = 4;
      __ReportSignalSetLValue("PDU signal 'ISw_Stat_ST3'", `BODY1::dbNode::`BC_F::`BC_F_BODY1_GW_Container_ST3_Ign_Stat_ST3::`ISw_Stat_ST3, __cArray);
      __ReportTableRow(0, __cArray, __cAOp, 4, "I_C03_ISW_STAT_IGN_ON");
    }
    __ReportTableEndTestStep("1");
  }
  TestCommandEnd();

  TestCommandBegin(__eWait, __cWait, "", "30");
  {
    __Wait("1", (2 * 1000000000), 1000000000, "");
  }
  TestCommandEnd();

  TestCommandBegin(__eReport, __cReport, __cEmpty, "31");
  {
    __ReportTableHead2Columns("Child Lock safety status", __cTSym, __cValue);
    __ReportSignal("PDU signal 'CSL_LHD_Inact_ST3'", `BODY1::dbNode::`DM_FL::`DM_FL_BODY1_Container2_ST3_PW_FL_Stat_ST3::`CSL_LHD_Inact_ST3, __cArray, 0 );
    testInfoRow(__tableHandle, 0, __cArray);
    __ReportCell(`BODY1::dbNode::`DM_FL::`DM_FL_BODY1_Container2_ST3_PW_FL_Stat_ST3::`CSL_LHD_Inact_ST3);
    __ReportTableEndTestStep(__cEmpty);
  }
  TestCommandEnd();

}

dword __tt0Callback32(signal * __cbParam)
{

  __csr = CheckSignalMatch(__cbParam, 1, "==") == 1;
  return __csr;
}
dword __tt0Callback33(signal * __cbParam)
{

  __csr = CheckSignalMatch(__cbParam, 3, "==") == 1;
  return __csr;
}
dword __tt0Callback34(signal * __cbParam)
{

  __csr = CheckSignalMatch(__cbParam, 1, "==") == 1;
  return __csr;
}
dword __tt0Callback35(signal * __cbParam)
{

  __csr = CheckSignalMatch(__cbParam, 4, "==") == 1;
  return __csr;
}
dword __tt0Callback36(signal * __cbParam)
{

  __csr = CheckSignalMatch(__cbParam, 2, "==") == 1;
  return __csr;
}

void Tt0_Tet_TtInit()
{

}

void Tt0_Tet_Tf_Preparation0()
{
  TestPreparationBegin();
  {
    TestCommandBegin(__eSet, __cSet, "", "0");
    {
    
      __ReportTableHead3Columns(__cSetCaption , __cTSym, __cTOp, __cAssigned); 
      {
        $`BODY1::dbNode::`BC_F::`BC_F_BODY1_GW_Container_ST3_Ign_Stat_ST3::`ISw_Stat_ST3.phys = 4;
        __ReportSignalSetLValue("PDU signal 'ISw_Stat_ST3'", `BODY1::dbNode::`BC_F::`BC_F_BODY1_GW_Container_ST3_Ign_Stat_ST3::`ISw_Stat_ST3, __cArray);
        __ReportTableRow(0, __cArray, __cAOp, 4, "I_C03_ISW_STAT_IGN_ON");
      }
      __ReportTableEndTestStep("1");
    }
    TestCommandEnd();

    TestCommandBegin(__eSet, __cSet, "", "1");
    {
    
      __ReportTableHead3Columns(__cSetCaption , __cTSym, __cTOp, __cAssigned); 
      {
        $`LinDB::dbNode::`DSM_WM_DOOR::`DSM_WM_Frm1_AR_DOOR::`CSL_Sw_Psd_DOOR.phys = 0;
        __ReportSignalSetLValue("LIN signal 'CSL_Sw_Psd_DOOR'", `LinDB::dbNode::`DSM_WM_DOOR::`DSM_WM_Frm1_AR_DOOR::`CSL_Sw_Psd_DOOR, __cArray);
        __ReportTableRow(0, __cArray, __cAOp, 0, "");
      }
      __ReportTableEndTestStep("1");
    }
    TestCommandEnd();

    TestCommandBegin(__eWait, __cWait, "", "2");
    {
      __Wait("1", (2 * 1000000000), 1000000000, "");
    }
    TestCommandEnd();

    {
      CreateTTEIFFunction("Tt0_SecTick_Synchronization", __eFct, __eLocal);
      CallInterfaceFunction(__cEmpty, __cEmpty, "cbac9f23-f272-4e1f-84e4-a8e282666e36");
    }


    TestCommandBegin(__eCAPLInline, __cCAPLInline, "Deactivating Tester present", "4");
    {
      __tt0CaplInline0();
    }
    TestCommandEnd();

  }
  TestPreparationEnd();
}


void __tt0CaplInline0 ()
{
  {
diagStopTesterPresent("DMD223");
diagStopTesterPresent("DMP223");
diagStopTesterPresent("DMRL223");
diagStopTesterPresent("DMRR223");
  }
}

void Tt0_Tet_TcListCall0()
{
  CallTTETCList("Tt0_LockSimul_Test_CSL_activated", "6,6", "2450cbb50185e956a8d282115e3a5cf7", __eLocal);
}

void Tt0_Tet_TcListCall1()
{
  CallTTETCList("Tt0_LockSimul_Test_CSL_deactivated", "6,6", "786413964ba20caf6478ee3d6be00847", __eLocal);
}

void Tt0_Tet_TcListCall2()
{
  CallTTETCList("Tt0_Mirror_heating", "6,6", "110152ae8e0d7b489088fab695617261", __eLocal);
}

void Tt0_Tet_TcListCall3()
{
  CallTTETCList("Tt0_Driver_side_mirror_selection", "6,6", "d13c1771615aae18944e319daa1ad43d", __eLocal);
}

void Tt0_Tet_TcListCall4()
{
  CallTTETCList("Tt0_Driver_side_mirror_selection_adjustment", "6,6", "8e0a4edd2e02fa6a2ecddfbad78efc18", __eLocal);
}

void Tt0_Tet_TcListCall5()
{
  CallTTETCList("Tt0_Passenger_side_mirror_selection", "6,6", "1c34b365d519d816d9906d19429437f1", __eLocal);
}

void Tt0_Tet_TcListCall6()
{
  CallTTETCList("Tt0_Passenger_side_mirror_selection_adjustment", "6,6", "4f505a39ecad9a6a7f5a8fc345e59682", __eLocal);
}

void Tt0_Tet_TcListCall7()
{
  CallTTETCList("Tt0_Mirror_folding_unfolding", "6,6", "5c3060493a9afce08feda4dc6b5c085a", __eLocal);
}

