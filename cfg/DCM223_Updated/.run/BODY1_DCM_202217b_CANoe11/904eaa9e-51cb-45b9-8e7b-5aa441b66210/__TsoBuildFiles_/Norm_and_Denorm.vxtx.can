/* !Encoding: 65001  */
includes
{
  #include "__VariablesLib.cin"
  #include "__CaplGeneratorLib.cin"
  #include "__CANoeReportFuntionsLib.cin"
}

variables
{
  // Global variables defined within this CAPL file
}

void Tt08ot1m1_Manual_Close_FL()
{
  TestCommandBegin(__eSet, __cSet, "Press Button", "0");
  {
  
    __ReportTableHead3Columns(__cSetCaption , __cTSym, __cTOp, __cAssigned); 
    {
      @sysvarInt::`SysVar_PW_Adj_FL_ST3::`SysVar_PW_Adj_FL_ST3 = 1;
      __ReportTableRow(0, "System variable 'SysVar_PW_Adj_FL_ST3'", __cAOp, 1, "");
    }
    __ReportTableEndTestStep("1");
  }
  TestCommandEnd();

  TestCommandBegin(__eCheck, __cCheck, "Check Manual Closing of FL Window", "1");
  {
    __bVerdict = __eVerdictPass;
    __ReportTableHead5Columns(__cCheckCaption, __cTSym, __cTOp, __cRefVal, __cActual, __cRes);
    {
      __csr = CheckSignalMatch(`Network::dbNode::`DM_FL::`DM_FL_BODY1_Container1_ST3_PW_Adj_Rq_Dr_FL_ST3::`PW_Adj_FL_Dr_FL_ST3, 2, "==") == 1;
      __ReportTableRow(0, "PDU signal 'PW_Adj_FL_Dr_FL_ST3'", "==", 2, "I_C03_NPSD_MAN_STP_AUTOPNCLS_IMP_MANCLS");
      __ReportCell(`Network::dbNode::`DM_FL::`DM_FL_BODY1_Container1_ST3_PW_Adj_Rq_Dr_FL_ST3::`PW_Adj_FL_Dr_FL_ST3);
      __ReportCellResult(__csr, __ePassFail);
      __bVerdict = __bVerdict && __csr;
    }
    __ReportTableEndVerdict("1", __bVerdict);
  }
  TestCommandEnd();

  TestCommandBegin(__eWait, __cWait, "wait for 4 sec", "2");
  {
    __Wait("1", (4 * 1000000000), 1000000000, "");
  }
  TestCommandEnd();

  TestCommandBegin(__eSet, __cSet, "Release Button", "3");
  {
  
    __ReportTableHead3Columns(__cSetCaption , __cTSym, __cTOp, __cAssigned); 
    {
      @sysvarInt::`SysVar_PW_Adj_FL_ST3::`SysVar_PW_Adj_FL_ST3 = 0;
      __ReportTableRow(0, "System variable 'SysVar_PW_Adj_FL_ST3'", __cAOp, 0, "");
    }
    __ReportTableEndTestStep("1");
  }
  TestCommandEnd();

  TestCommandBegin(__eCheck, __cCheck, "Check Button Not Pressed of Fl after Button Release", "4");
  {
    __bVerdict = __eVerdictPass;
    __ReportTableHead5Columns(__cCheckCaption, __cTSym, __cTOp, __cRefVal, __cActual, __cRes);
    {
      __csr = CheckSignalMatch(`Network::dbNode::`DM_FL::`DM_FL_BODY1_Container1_ST3_PW_Adj_Rq_Dr_FL_ST3::`PW_Adj_FL_Dr_FL_ST3, 0, "==") == 1;
      __ReportTableRow(0, "PDU signal 'PW_Adj_FL_Dr_FL_ST3'", "==", 0, "I_C03_NPSD_MAN_STP_AUTOPNCLS_IMP_NPSD");
      __ReportCell(`Network::dbNode::`DM_FL::`DM_FL_BODY1_Container1_ST3_PW_Adj_Rq_Dr_FL_ST3::`PW_Adj_FL_Dr_FL_ST3);
      __ReportCellResult(__csr, __ePassFail);
      __bVerdict = __bVerdict && __csr;
    }
    __ReportTableEndVerdict("1", __bVerdict);
  }
  TestCommandEnd();

  TestCommandBegin(__eCheck, __cCheck, "Verfiy after first Button Press & Release", "5");
  {
    __bVerdict = __eVerdictPass;
    __ReportTableHead5Columns(__cCheckCaption, __cTSym, __cTOp, __cRefVal, __cActual, __cRes);
    {
      {
        int __res1,__res2;
        __csr = CheckSignalMatch(`Network::dbNode::`DM_FL::`DM_FL_BODY1_Container2_ST3_PW_FL_Stat_ST3::`PW_FL_Posn_ST3, 0, ">=") == 1;
        __res1 = __csr;
        __csr = CheckSignalMatch(`Network::dbNode::`DM_FL::`DM_FL_BODY1_Container2_ST3_PW_FL_Stat_ST3::`PW_FL_Posn_ST3, 30, "<=") == 1;
        __res2 = __csr;
        __csr = __res1 && __res2;
      
        snprintf(__cArray, elCount(__cArray), "0..30");
        __ReportTableRow(0, "PDU signal 'PW_FL_Posn_ST3'", __cRange, __cArray, __cEmpty);
        __ReportCell(`Network::dbNode::`DM_FL::`DM_FL_BODY1_Container2_ST3_PW_FL_Stat_ST3::`PW_FL_Posn_ST3);
        __ReportCellResult(__csr, __ePassFail);
      }
      __bVerdict = __bVerdict && __csr;
    }
    __ReportTableEndVerdict("1", __bVerdict);
  }
  TestCommandEnd();

}

void Tt08ot1m1_Tet_TtInit()
{

}

void Tt08ot1m1_Tet_Tc0()
{
  CreateTTEIFFunction("Tt08ot1m1_Tc0", __eTcDef, __eLocal);  
  CallInterfaceFunction("Normalization", __cEmpty , __cEmpty );
}
testcase Tt08ot1m1_Tc0()
{	
int64 __ifExec0;

  SetBreakOnFail(1);

  
  TestControlStructBegin(__cIf, "Check Whether the Windows are Denormalized", "0");
  {
    int64 __condition;
    {
      int64 __expr0;
      __ifExec0 = 0;
  
      {
        __csr = CheckSignalMatch(`Network::dbNode::`DM_FL::`DM_FL_BODY1_Container2_ST3_PW_FL_Stat_ST3::`PW_FL_Norm_ST3, 1, "==") == 1;
      }
      {
        __expr0 = __csr;
      }
      __condition = __expr0;
  
        snprintf(__cConditionArray, 2048, "%s", "");
        snprintf(__cCompareArray, 2048, "%s", "");
        snprintf(__cCompareArray, 2048, "%s%s%s", "PW_FL_Norm_ST3", "==", "I_C02_NDEF_FALSE_TRUE_ST3_FALSE");
        snprintf(__cArray, 2048, "%s", __cCompareArray);
        snprintf(__cCompareArray, 2048, "( %s )", __cArray);
        snprintf(__cArray, 2048, "%s", __cConditionArray);
        snprintf(__cConditionArray, 2048, "%s%s", __cArray, __cCompareArray);
        snprintf(__cArray, 2048, "%s", __cConditionArray);
        snprintf(__cConditionArray, 2048, "%s %s", "If", __cArray);
  
      __ReportConditionTableHead(__cConditionArray, __condition);
      {
        __csr = CheckSignalMatch(`Network::dbNode::`DM_FL::`DM_FL_BODY1_Container2_ST3_PW_FL_Stat_ST3::`PW_FL_Norm_ST3, 1, "==") == 1;
        __ReportTableRow(0, "PDU signal 'PW_FL_Norm_ST3'", "==", 1, "I_C02_NDEF_FALSE_TRUE_ST3_FALSE");
        __ReportCell(`Network::dbNode::`DM_FL::`DM_FL_BODY1_Container2_ST3_PW_FL_Stat_ST3::`PW_FL_Norm_ST3);
        __ReportCellResult(__csr, __eTrueFalse); 
      }
      __ReportTableEndCondition(__cIfCondition);
    }
  
    if(__condition)
    {  
      __ifExec0 = 1;

      {
      snprintf(__cConditionArray, 2048, "%s", "");
    snprintf(__cCompareArray, 2048, "%s", "");
    snprintf(__cCompareArray, 2048, "%s%s%s", "PW_FL_Norm_ST3", "!=", "I_C02_NDEF_FALSE_TRUE_ST3_TRUE");
    snprintf(__cArray, 2048, "%s", __cCompareArray);
    snprintf(__cCompareArray, 2048, "( %s )", __cArray);
    snprintf(__cArray, 2048, "%s", __cConditionArray);
    snprintf(__cConditionArray, 2048, "%s%s", __cArray, __cCompareArray);
    snprintf(__cArray, 2048, "%s", __cConditionArray);
    snprintf(__cConditionArray, 2048, "%s %s", "While", __cArray);

    snprintf(__cConditionArray, 2048, "%s%s", "Check if Normalization is not TRUE (", __cConditionArray);
    snprintf(__cConditionArray, 2048, "%s%s", __cConditionArray, ")");
    TestControlStructBegin(__cWhile, __cConditionArray, "0");
    while(1)
    {
      int64 __expr0;
      int64 __condition;
  
      {
        __csr = CheckSignalMatch(`Network::dbNode::`DM_FL::`DM_FL_BODY1_Container2_ST3_PW_FL_Stat_ST3::`PW_FL_Norm_ST3, 2, "!=") == 1;
      }
      {
        __expr0 = __csr;
      }
      __condition = __expr0;
  
          snprintf(__cConditionArray, 2048, "%s", "");
      snprintf(__cCompareArray, 2048, "%s", "");
      snprintf(__cCompareArray, 2048, "%s%s%s", "PW_FL_Norm_ST3", "!=", "I_C02_NDEF_FALSE_TRUE_ST3_TRUE");
      snprintf(__cArray, 2048, "%s", __cCompareArray);
      snprintf(__cCompareArray, 2048, "( %s )", __cArray);
      snprintf(__cArray, 2048, "%s", __cConditionArray);
      snprintf(__cConditionArray, 2048, "%s%s", __cArray, __cCompareArray);
      snprintf(__cArray, 2048, "%s", __cConditionArray);
      snprintf(__cConditionArray, 2048, "%s %s", "While", __cArray);
  
      snprintf(__cConditionArray, 2048, "%s%s", "Check if Normalization is not TRUE (", __cConditionArray);
      snprintf(__cConditionArray, 2048, "%s%s", __cConditionArray, ")");
      if(__condition == 1)
      {
        snprintf(__cArray2, 2048, "%s%s", __cConditionArray, " : true");
      }
      else
      {
        snprintf(__cArray2, 2048, "%s%s", __cConditionArray, " : false");
      }
      TestControlStructBegin(__cWhileIteration, __cArray2, "1");
      {
      __ReportTableHead5Columns("Condition", __cTSym, __cTOp, __cRefVal, __cActual, __cRes);
      {
            __csr = CheckSignalMatch(`Network::dbNode::`DM_FL::`DM_FL_BODY1_Container2_ST3_PW_FL_Stat_ST3::`PW_FL_Norm_ST3, 2, "!=") == 1;
      __ReportTableRow(0, "PDU signal 'PW_FL_Norm_ST3'", "!=", 2, "I_C02_NDEF_FALSE_TRUE_ST3_TRUE");
      __ReportCell(`Network::dbNode::`DM_FL::`DM_FL_BODY1_Container2_ST3_PW_FL_Stat_ST3::`PW_FL_Norm_ST3);
      __ReportCellResult(__csr, __eTrueFalse); 
      }
      __ReportTableEndCondition(__cWhileCondition, 1);
  
      if(__LoopIsBlocking())
      {
        TestControlStructEnd(__eErrorInTestSystem);
        break;
      }
  
      if (0 == __condition)
      {
        TestControlStructEnd(__eUndefined);
        break;
      }
    }

          {
            CreateTTEIFFunction("Tt08ot1m1_Manual_Close_FL", __eFct, __eLocal);
            CallInterfaceFunction(__cEmpty, __cEmpty, "71702c7e-6cb7-4125-9bf3-c061754db11d");
          }


          TestCommandBegin(__eWait, __cWait, "Wait for 0.2 sec", "3");
          {
            __Wait("1", (0.2 * 1000000000), 1000000000, "");
          }
          TestCommandEnd();

          {
            CreateTTEIFFunction("Tt08ot1m1_Manual_Close_FL", __eFct, __eLocal);
            CallInterfaceFunction(__cEmpty, __cEmpty, "71702c7e-6cb7-4125-9bf3-c061754db11d");
          }


          TestCommandBegin(__eWait, __cWait, "Wait for 0.2 sec", "5");
          {
            __Wait("1", (0.2 * 1000000000), 1000000000, "");
          }
          TestCommandEnd();

          {
            CreateTTEIFFunction("Tt08ot1m1_Manual_Close_FL", __eFct, __eLocal);
            CallInterfaceFunction(__cEmpty, __cEmpty, "71702c7e-6cb7-4125-9bf3-c061754db11d");
          }


          TestControlStructEnd(__eUndefined);
        }
        TestControlStructEnd(__eUndefined);
      }
      

    }
  }
  TestControlStructEnd(__eUndefined);

  TestCommandBegin(__eCheck, __cCheck, "Check Whether Normalization is TRUE", "7");
  {
    __bVerdict = __eVerdictPass;
    __ReportTableHead5Columns(__cCheckCaption, __cTSym, __cTOp, __cRefVal, __cActual, __cRes);
    {
      __csr = CheckSignalMatch(`Network::dbNode::`DM_FL::`DM_FL_BODY1_Container2_ST3_PW_FL_Stat_ST3::`PW_FL_Norm_ST3, 2, "==") == 1;
      __ReportTableRow(0, "PDU signal 'PW_FL_Norm_ST3'", "==", 2, "I_C02_NDEF_FALSE_TRUE_ST3_TRUE");
      __ReportCell(`Network::dbNode::`DM_FL::`DM_FL_BODY1_Container2_ST3_PW_FL_Stat_ST3::`PW_FL_Norm_ST3);
      __ReportCellResult(__csr, __ePassFail);
      __bVerdict = __bVerdict && __csr;
    }
    __ReportTableEndVerdict("1", __bVerdict);
  }
  TestCommandEnd();

}

void Tt08ot1m1_Tet_Tc1()
{
  CreateTTEIFFunction("Tt08ot1m1_Tc1", __eTcDef, __eLocal);  
  CallInterfaceFunction("DeNormalization", __cEmpty , __cEmpty );
}
testcase Tt08ot1m1_Tc1()
{	
  SetBreakOnFail(1);

}

