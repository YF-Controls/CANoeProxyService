/* !Encoding: 65001  */
includes
{
  #include "__VariablesLib.cin"
  #include "__CaplGeneratorLib.cin"
  #include "__CANoeReportFuntionsLib.cin"
}

variables
{
  // Global variables defined within this CAPL file
}

void Ttc9e1859_PreCondition()
{
  TestCommandBegin(__eSet, __cSet, "Set Steering style to LHD", "0");
  {
  
    __ReportTableHead3Columns(__cSetCaption , __cTSym, __cTOp, __cAssigned); 
    {
      $`Network::dbNode::`BC_F::`BC_F_BODY1_GW_Container_ST3_EVC_CfgList_01_08_Pr5_ST3::`EVC_List03_StStyle_ST3.phys = 1;
      __ReportSignalSetLValue("PDU signal 'EVC_List03_StStyle_ST3'", `Network::dbNode::`BC_F::`BC_F_BODY1_GW_Container_ST3_EVC_CfgList_01_08_Pr5_ST3::`EVC_List03_StStyle_ST3, __cArray);
      __ReportTableRow(0, __cArray, __cAOp, 1, "I_C02_STSTYLE_LHD");
    }
    __ReportTableEndTestStep("1");
  }
  TestCommandEnd();

  TestCommandBegin(__eSet, __cSet, "Set Ignition to ON", "1");
  {
  
    __ReportTableHead3Columns(__cSetCaption , __cTSym, __cTOp, __cAssigned); 
    {
      $`Network::dbNode::`BC_F::`BC_F_BODY1_GW_Container_ST3_Ign_Stat_ST3::`ISw_Stat_ST3.phys = 4;
      __ReportSignalSetLValue("PDU signal 'ISw_Stat_ST3'", `Network::dbNode::`BC_F::`BC_F_BODY1_GW_Container_ST3_Ign_Stat_ST3::`ISw_Stat_ST3, __cArray);
      __ReportTableRow(0, __cArray, __cAOp, 4, "I_C03_ISW_STAT_IGN_ON");
    }
    __ReportTableEndTestStep("1");
  }
  TestCommandEnd();

  TestCommandBegin(__eWait, __cWait, "Wait for 2 s", "2");
  {
    __Wait("1", (2 * 1000000000), 1000000000, "");
  }
  TestCommandEnd();

  TestCommandBegin(__eSet, __cSet, "Close all windows", "3");
  {
  
    __ReportTableHead3Columns(__cSetCaption , __cTSym, __cTOp, __cAssigned); 
    {
      $`Network::dbNode::`DM_FL::`DM_FL_BODY1_Container2_ST3_PW_FL_Stat_ST3::`PW_FL_Posn_Stat_ST3.phys = 2;
      __ReportSignalSetLValue("PDU signal 'PW_FL_Posn_Stat_ST3'", `Network::dbNode::`DM_FL::`DM_FL_BODY1_Container2_ST3_PW_FL_Stat_ST3::`PW_FL_Posn_Stat_ST3, __cArray);
      __ReportTableRow(0, __cArray, __cAOp, 2, "I_C04_PW_POSN_STAT_ST3_WNDW_CLS");
    }
    {
      $`Network::dbNode::`DM_FR::`DM_FR_BODY1_Container2_ST3_PW_FR_Stat_ST3::`PW_FR_Posn_Stat_ST3.phys = 2;
      __ReportSignalSetLValue("PDU signal 'PW_FR_Posn_Stat_ST3'", `Network::dbNode::`DM_FR::`DM_FR_BODY1_Container2_ST3_PW_FR_Stat_ST3::`PW_FR_Posn_Stat_ST3, __cArray);
      __ReportTableRow(0, __cArray, __cAOp, 2, "I_C04_PW_POSN_STAT_ST3_WNDW_CLS");
    }
    {
      $`Network::dbNode::`DM_RL::`DM_RL_BODY1_Container2_ST3_PW_RL_Stat_ST3::`PW_RL_Posn_Stat_ST3.phys = 2;
      __ReportSignalSetLValue("PDU signal 'PW_RL_Posn_Stat_ST3'", `Network::dbNode::`DM_RL::`DM_RL_BODY1_Container2_ST3_PW_RL_Stat_ST3::`PW_RL_Posn_Stat_ST3, __cArray);
      __ReportTableRow(0, __cArray, __cAOp, 2, "I_C04_PW_POSN_STAT_ST3_WNDW_CLS");
    }
    {
      $`Network::dbNode::`DM_RR::`DM_RR_BODY1_Container2_ST3_PW_RR_Stat_ST3::`PW_RR_Posn_Stat_ST3.phys = 2;
      __ReportSignalSetLValue("PDU signal 'PW_RR_Posn_Stat_ST3'", `Network::dbNode::`DM_RR::`DM_RR_BODY1_Container2_ST3_PW_RR_Stat_ST3::`PW_RR_Posn_Stat_ST3, __cArray);
      __ReportTableRow(0, __cArray, __cAOp, 2, "I_C04_PW_POSN_STAT_ST3_WNDW_CLS");
    }
    __ReportTableEndTestStep("1");
  }
  TestCommandEnd();

}

void Ttc9e1859_PostCondition_X()
{
  TestCommandBegin(__eSet, __cSet, "Set trigger crash signal Impact_X_ST3=0(default value)", "0");
  {
  
    __ReportTableHead3Columns(__cSetCaption , __cTSym, __cTOp, __cAssigned); 
    {
      $`Network::dbNode::`BC_F::`BC_F_BODY1_GW_Container_ST3_Impact3_ST3::`Impact_X_ST3.phys = 0;
      __ReportSignalSetLValue("PDU signal 'Impact_X_ST3'", `Network::dbNode::`BC_F::`BC_F_BODY1_GW_Container_ST3_Impact3_ST3::`Impact_X_ST3, __cArray);
      __ReportTableRow(0, __cArray, __cAOp, 0, "");
    }
    __ReportTableEndTestStep("1");
  }
  TestCommandEnd();

  TestCommandBegin(__eCheck, __cCheck, "verify all vehicle doors close and locking rearlid,fuel filler flap lock", "1");
  {
    __bVerdict = __eVerdictPass;
    __ReportTableHead5Columns(__cCheckCaption, __cTSym, __cTOp, __cRefVal, __cActual, __cRes);
    {
      __csr = CheckSignalMatch(`Network::dbNode::`BC_F::`BC_F_BODY1_GW_Container_ST3_CLkS_Dr_State_ST3::`DrRLtch_FL_Stat_ST3, 1, "==") == 1;
      __ReportTableRow(0, "PDU signal 'DrRLtch_FL_Stat_ST3'", "==", 1, "I_C02_DR_STAT_CLS");
      __ReportCell(`Network::dbNode::`BC_F::`BC_F_BODY1_GW_Container_ST3_CLkS_Dr_State_ST3::`DrRLtch_FL_Stat_ST3);
      __ReportCellResult(__csr, __ePassFail);
      __bVerdict = __bVerdict && __csr;
    }
    {
      __csr = CheckSignalMatch(`Network::dbNode::`BC_F::`BC_F_BODY1_GW_Container_ST3_CLkS_Dr_State_ST3::`DrRLtch_FR_Stat_ST3, 1, "==") == 1;
      __ReportTableRow(0, "PDU signal 'DrRLtch_FR_Stat_ST3'", "==", 1, "I_C02_DR_STAT_CLS");
      __ReportCell(`Network::dbNode::`BC_F::`BC_F_BODY1_GW_Container_ST3_CLkS_Dr_State_ST3::`DrRLtch_FR_Stat_ST3);
      __ReportCellResult(__csr, __ePassFail);
      __bVerdict = __bVerdict && __csr;
    }
    {
      __csr = CheckSignalMatch(`Network::dbNode::`BC_F::`BC_F_BODY1_GW_Container_ST3_CLkS_Dr_State_ST3::`DrRLtch_RL_Stat_ST3, 1, "==") == 1;
      __ReportTableRow(0, "PDU signal 'DrRLtch_RL_Stat_ST3'", "==", 1, "I_C02_DR_STAT_CLS");
      __ReportCell(`Network::dbNode::`BC_F::`BC_F_BODY1_GW_Container_ST3_CLkS_Dr_State_ST3::`DrRLtch_RL_Stat_ST3);
      __ReportCellResult(__csr, __ePassFail);
      __bVerdict = __bVerdict && __csr;
    }
    {
      __csr = CheckSignalMatch(`Network::dbNode::`BC_F::`BC_F_BODY1_GW_Container_ST3_CLkS_Dr_State_ST3::`DrRLtch_RR_Stat_ST3, 1, "==") == 1;
      __ReportTableRow(0, "PDU signal 'DrRLtch_RR_Stat_ST3'", "==", 1, "I_C02_DR_STAT_CLS");
      __ReportCell(`Network::dbNode::`BC_F::`BC_F_BODY1_GW_Container_ST3_CLkS_Dr_State_ST3::`DrRLtch_RR_Stat_ST3);
      __ReportCellResult(__csr, __ePassFail);
      __bVerdict = __bVerdict && __csr;
    }
    __ReportTableEndVerdict("1", __bVerdict);
  }
  TestCommandEnd();

}

void Ttc9e1859_PostCondition_Y()
{
  TestCommandBegin(__eSet, __cSet, "Set trigger crash signal Impact_Y_ST3=0(default value)", "0");
  {
  
    __ReportTableHead3Columns(__cSetCaption , __cTSym, __cTOp, __cAssigned); 
    {
      $`Network::dbNode::`EIS_BASE::`EIS_BODY1_Container_ST3_Impact2_ST3::`Impact_Y_ST3.phys = 0;
      __ReportSignalSetLValue("PDU signal 'Impact_Y_ST3'", `Network::dbNode::`EIS_BASE::`EIS_BODY1_Container_ST3_Impact2_ST3::`Impact_Y_ST3, __cArray);
      __ReportTableRow(0, __cArray, __cAOp, 0, "");
    }
    __ReportTableEndTestStep("1");
  }
  TestCommandEnd();

  TestCommandBegin(__eCheck, __cCheck, "verify all vehicle doors close and locking rearlid,fuel filler flap lock", "1");
  {
    __bVerdict = __eVerdictPass;
    __ReportTableHead5Columns(__cCheckCaption, __cTSym, __cTOp, __cRefVal, __cActual, __cRes);
    {
      __csr = CheckSignalMatch(`Network::dbNode::`BC_F::`BC_F_BODY1_GW_Container_ST3_CLkS_Dr_State_ST3::`DrRLtch_FL_Stat_ST3, 1, "==") == 1;
      __ReportTableRow(0, "PDU signal 'DrRLtch_FL_Stat_ST3'", "==", 1, "I_C02_DR_STAT_CLS");
      __ReportCell(`Network::dbNode::`BC_F::`BC_F_BODY1_GW_Container_ST3_CLkS_Dr_State_ST3::`DrRLtch_FL_Stat_ST3);
      __ReportCellResult(__csr, __ePassFail);
      __bVerdict = __bVerdict && __csr;
    }
    {
      __csr = CheckSignalMatch(`Network::dbNode::`BC_F::`BC_F_BODY1_GW_Container_ST3_CLkS_Dr_State_ST3::`DrRLtch_FR_Stat_ST3, 1, "==") == 1;
      __ReportTableRow(0, "PDU signal 'DrRLtch_FR_Stat_ST3'", "==", 1, "I_C02_DR_STAT_CLS");
      __ReportCell(`Network::dbNode::`BC_F::`BC_F_BODY1_GW_Container_ST3_CLkS_Dr_State_ST3::`DrRLtch_FR_Stat_ST3);
      __ReportCellResult(__csr, __ePassFail);
      __bVerdict = __bVerdict && __csr;
    }
    {
      __csr = CheckSignalMatch(`Network::dbNode::`BC_F::`BC_F_BODY1_GW_Container_ST3_CLkS_Dr_State_ST3::`DrRLtch_RL_Stat_ST3, 1, "==") == 1;
      __ReportTableRow(0, "PDU signal 'DrRLtch_RL_Stat_ST3'", "==", 1, "I_C02_DR_STAT_CLS");
      __ReportCell(`Network::dbNode::`BC_F::`BC_F_BODY1_GW_Container_ST3_CLkS_Dr_State_ST3::`DrRLtch_RL_Stat_ST3);
      __ReportCellResult(__csr, __ePassFail);
      __bVerdict = __bVerdict && __csr;
    }
    {
      __csr = CheckSignalMatch(`Network::dbNode::`BC_F::`BC_F_BODY1_GW_Container_ST3_CLkS_Dr_State_ST3::`DrRLtch_RR_Stat_ST3, 1, "==") == 1;
      __ReportTableRow(0, "PDU signal 'DrRLtch_RR_Stat_ST3'", "==", 1, "I_C02_DR_STAT_CLS");
      __ReportCell(`Network::dbNode::`BC_F::`BC_F_BODY1_GW_Container_ST3_CLkS_Dr_State_ST3::`DrRLtch_RR_Stat_ST3);
      __ReportCellResult(__csr, __ePassFail);
      __bVerdict = __bVerdict && __csr;
    }
    __ReportTableEndVerdict("1", __bVerdict);
  }
  TestCommandEnd();

}

void Ttc9e1859_Tet_TtInit()
{

}

void Ttc9e1859_Tet_Tc0()
{
  CreateTTEIFFunction("Ttc9e1859_Tc0", __eTcDef, __eLocal);  
  CallInterfaceFunction("TC_WL-Star3-TS-34572_Door lock release any crash event X", __cEmpty , __cEmpty );
}
testcase Ttc9e1859_Tc0()
{	
  SetBreakOnFail(1);

  TestPreparationBegin();
  {
    {
      CreateTTEIFFunction("Ttc9e1859_PreCondition", __eFct, __eLocal);
      CallInterfaceFunction(__cEmpty, __cEmpty, "2c26847c-6531-4243-a0ff-f9a3432fa9f9");
    }


  }
  TestPreparationEnd();

  TestCommandBegin(__eSet, __cSet, "Set trigger crash signal Impact_X_ST3=1", "2");
  {
  
    __ReportTableHead3Columns(__cSetCaption , __cTSym, __cTOp, __cAssigned); 
    {
      $`Network::dbNode::`BC_F::`BC_F_BODY1_GW_Container_ST3_Impact3_ST3::`Impact_X_ST3.phys = 1;
      __ReportSignalSetLValue("PDU signal 'Impact_X_ST3'", `Network::dbNode::`BC_F::`BC_F_BODY1_GW_Container_ST3_Impact3_ST3::`Impact_X_ST3, __cArray);
      __ReportTableRow(0, __cArray, __cAOp, 1, "");
    }
    __ReportTableEndTestStep("1");
  }
  TestCommandEnd();

  TestCommandBegin(__eWait, __cWait, "wait for 10 s", "3");
  {
    __Wait("1", (10 * 1000000000), 1000000000, "");
  }
  TestCommandEnd();

  TestCommandBegin(__eCheck, __cCheck, "verify all vehicle doors open and unlocking rearlid,fuel filler flap lock", "5");
  {
    __bVerdict = __eVerdictPass;
    __ReportTableHead5Columns(__cCheckCaption, __cTSym, __cTOp, __cRefVal, __cActual, __cRes);
    {
      __csr = CheckSignalMatch(`Network::dbNode::`BC_F::`BC_F_BODY1_GW_Container_ST3_CLkS_Dr_State_ST3::`DrRLtch_FL_Stat_ST3, 2, "==") == 1;
      __ReportTableRow(0, "PDU signal 'DrRLtch_FL_Stat_ST3'", "==", 2, "I_C02_DR_STAT_OPN");
      __ReportCell(`Network::dbNode::`BC_F::`BC_F_BODY1_GW_Container_ST3_CLkS_Dr_State_ST3::`DrRLtch_FL_Stat_ST3);
      __ReportCellResult(__csr, __ePassFail);
      __bVerdict = __bVerdict && __csr;
    }
    {
      __csr = CheckSignalMatch(`Network::dbNode::`BC_F::`BC_F_BODY1_GW_Container_ST3_CLkS_Dr_State_ST3::`DrRLtch_FR_Stat_ST3, 2, "==") == 1;
      __ReportTableRow(0, "PDU signal 'DrRLtch_FR_Stat_ST3'", "==", 2, "I_C02_DR_STAT_OPN");
      __ReportCell(`Network::dbNode::`BC_F::`BC_F_BODY1_GW_Container_ST3_CLkS_Dr_State_ST3::`DrRLtch_FR_Stat_ST3);
      __ReportCellResult(__csr, __ePassFail);
      __bVerdict = __bVerdict && __csr;
    }
    {
      __csr = CheckSignalMatch(`Network::dbNode::`BC_F::`BC_F_BODY1_GW_Container_ST3_CLkS_Dr_State_ST3::`DrRLtch_RL_Stat_ST3, 2, "==") == 1;
      __ReportTableRow(0, "PDU signal 'DrRLtch_RL_Stat_ST3'", "==", 2, "I_C02_DR_STAT_OPN");
      __ReportCell(`Network::dbNode::`BC_F::`BC_F_BODY1_GW_Container_ST3_CLkS_Dr_State_ST3::`DrRLtch_RL_Stat_ST3);
      __ReportCellResult(__csr, __ePassFail);
      __bVerdict = __bVerdict && __csr;
    }
    {
      __csr = CheckSignalMatch(`Network::dbNode::`BC_F::`BC_F_BODY1_GW_Container_ST3_CLkS_Dr_State_ST3::`DrRLtch_RR_Stat_ST3, 2, "==") == 1;
      __ReportTableRow(0, "PDU signal 'DrRLtch_RR_Stat_ST3'", "==", 2, "I_C02_DR_STAT_OPN");
      __ReportCell(`Network::dbNode::`BC_F::`BC_F_BODY1_GW_Container_ST3_CLkS_Dr_State_ST3::`DrRLtch_RR_Stat_ST3);
      __ReportCellResult(__csr, __ePassFail);
      __bVerdict = __bVerdict && __csr;
    }
    __ReportTableEndVerdict("1", __bVerdict);
  }
  TestCommandEnd();

}

void Ttc9e1859_Tet_Tc1()
{
  CreateTTEIFFunction("Ttc9e1859_Tc1", __eTcDef, __eLocal);  
  CallInterfaceFunction("TC_WL-Star3-TS-34574_Door lock release any crash event Y", __cEmpty , __cEmpty );
}
testcase Ttc9e1859_Tc1()
{	
  SetBreakOnFail(1);

  CreateTTEIFFunction("Ttc9e1859_Tet_Tc1_Completion", __eFct, __eLocal);
  
  AddIFAsCleanUpFunction();

  TestPreparationBegin();
  {
    {
      CreateTTEIFFunction("Ttc9e1859_PreCondition", __eFct, __eLocal);
      CallInterfaceFunction(__cEmpty, __cEmpty, "2c26847c-6531-4243-a0ff-f9a3432fa9f9");
    }


  }
  TestPreparationEnd();

  TestCommandBegin(__eSet, __cSet, "Set trigger crash signal Impact_Y_ST3=1", "2");
  {
  
    __ReportTableHead3Columns(__cSetCaption , __cTSym, __cTOp, __cAssigned); 
    {
      $`Network::dbNode::`EIS_BASE::`EIS_BODY1_Container_ST3_Impact2_ST3::`Impact_Y_ST3.phys = 1;
      __ReportSignalSetLValue("PDU signal 'Impact_Y_ST3'", `Network::dbNode::`EIS_BASE::`EIS_BODY1_Container_ST3_Impact2_ST3::`Impact_Y_ST3, __cArray);
      __ReportTableRow(0, __cArray, __cAOp, 1, "");
    }
    __ReportTableEndTestStep("1");
  }
  TestCommandEnd();

  TestCommandBegin(__eWait, __cWait, "wait for 10 s", "3");
  {
    __Wait("1", (10 * 1000000000), 1000000000, "");
  }
  TestCommandEnd();

  TestCommandBegin(__eCheck, __cCheck, "verify all vehicle doors open and unlocking rearlid,fuel filler flap lock", "5");
  {
    __bVerdict = __eVerdictPass;
    __ReportTableHead5Columns(__cCheckCaption, __cTSym, __cTOp, __cRefVal, __cActual, __cRes);
    {
      __csr = CheckSignalMatch(`Network::dbNode::`BC_F::`BC_F_BODY1_GW_Container_ST3_CLkS_Dr_State_ST3::`DrRLtch_FL_Stat_ST3, 2, "==") == 1;
      __ReportTableRow(0, "PDU signal 'DrRLtch_FL_Stat_ST3'", "==", 2, "I_C02_DR_STAT_OPN");
      __ReportCell(`Network::dbNode::`BC_F::`BC_F_BODY1_GW_Container_ST3_CLkS_Dr_State_ST3::`DrRLtch_FL_Stat_ST3);
      __ReportCellResult(__csr, __ePassFail);
      __bVerdict = __bVerdict && __csr;
    }
    {
      __csr = CheckSignalMatch(`Network::dbNode::`BC_F::`BC_F_BODY1_GW_Container_ST3_CLkS_Dr_State_ST3::`DrRLtch_FR_Stat_ST3, 2, "==") == 1;
      __ReportTableRow(0, "PDU signal 'DrRLtch_FR_Stat_ST3'", "==", 2, "I_C02_DR_STAT_OPN");
      __ReportCell(`Network::dbNode::`BC_F::`BC_F_BODY1_GW_Container_ST3_CLkS_Dr_State_ST3::`DrRLtch_FR_Stat_ST3);
      __ReportCellResult(__csr, __ePassFail);
      __bVerdict = __bVerdict && __csr;
    }
    {
      __csr = CheckSignalMatch(`Network::dbNode::`BC_F::`BC_F_BODY1_GW_Container_ST3_CLkS_Dr_State_ST3::`DrRLtch_RL_Stat_ST3, 2, "==") == 1;
      __ReportTableRow(0, "PDU signal 'DrRLtch_RL_Stat_ST3'", "==", 2, "I_C02_DR_STAT_OPN");
      __ReportCell(`Network::dbNode::`BC_F::`BC_F_BODY1_GW_Container_ST3_CLkS_Dr_State_ST3::`DrRLtch_RL_Stat_ST3);
      __ReportCellResult(__csr, __ePassFail);
      __bVerdict = __bVerdict && __csr;
    }
    {
      __csr = CheckSignalMatch(`Network::dbNode::`BC_F::`BC_F_BODY1_GW_Container_ST3_CLkS_Dr_State_ST3::`DrRLtch_RR_Stat_ST3, 2, "==") == 1;
      __ReportTableRow(0, "PDU signal 'DrRLtch_RR_Stat_ST3'", "==", 2, "I_C02_DR_STAT_OPN");
      __ReportCell(`Network::dbNode::`BC_F::`BC_F_BODY1_GW_Container_ST3_CLkS_Dr_State_ST3::`DrRLtch_RR_Stat_ST3);
      __ReportCellResult(__csr, __ePassFail);
      __bVerdict = __bVerdict && __csr;
    }
    __ReportTableEndVerdict("1", __bVerdict);
  }
  TestCommandEnd();


}

void Ttc9e1859_Tet_Tc1_Completion()
{  
  TestCompletionBegin();
  {
    TestCommandBegin(__eSet, __cSet, "Set trigger crash signal Impact_X_ST3=0(default value)", "6");
    {
    
      __ReportTableHead3Columns(__cSetCaption , __cTSym, __cTOp, __cAssigned); 
      {
        $`Network::dbNode::`BC_F::`BC_F_BODY1_GW_Container_ST3_Impact3_ST3::`Impact_X_ST3.phys = 0;
        __ReportSignalSetLValue("PDU signal 'Impact_X_ST3'", `Network::dbNode::`BC_F::`BC_F_BODY1_GW_Container_ST3_Impact3_ST3::`Impact_X_ST3, __cArray);
        __ReportTableRow(0, __cArray, __cAOp, 0, "");
      }
      __ReportTableEndTestStep("1");
    }
    TestCommandEnd();

  }
  TestCompletionEnd();
}

void Ttc9e1859_Tet_Tc2()
{
  CreateTTEIFFunction("Ttc9e1859_Tc2", __eTcDef, __eLocal);  
  CallInterfaceFunction("TC_WL-Star3-TS-34576_Door lock release - roll over event 1", __cEmpty , __cEmpty );
}
testcase Ttc9e1859_Tc2()
{	
  SetBreakOnFail(1);

  CreateTTEIFFunction("Ttc9e1859_Tet_Tc2_Completion", __eFct, __eLocal);
  
  AddIFAsCleanUpFunction();

  TestPreparationBegin();
  {
    {
      CreateTTEIFFunction("Ttc9e1859_PreCondition", __eFct, __eLocal);
      CallInterfaceFunction(__cEmpty, __cEmpty, "2c26847c-6531-4243-a0ff-f9a3432fa9f9");
    }


  }
  TestPreparationEnd();

  TestCommandBegin(__eSet, __cSet, "Set trigger roll over event signal Impact_RO_type1_ST3=1", "2");
  {
  
    __ReportTableHead3Columns(__cSetCaption , __cTSym, __cTOp, __cAssigned); 
    {
      $`Network::dbNode::`BC_F::`BC_F_BODY1_GW_Container_ST3_Impact3_ST3::`Impact_RO_type1_ST3.phys = 1;
      __ReportSignalSetLValue("PDU signal 'Impact_RO_type1_ST3'", `Network::dbNode::`BC_F::`BC_F_BODY1_GW_Container_ST3_Impact3_ST3::`Impact_RO_type1_ST3, __cArray);
      __ReportTableRow(0, __cArray, __cAOp, 1, "");
    }
    __ReportTableEndTestStep("1");
  }
  TestCommandEnd();

  TestCommandBegin(__eWait, __cWait, "wait for 10 s", "3");
  {
    __Wait("1", (10 * 1000000000), 1000000000, "");
  }
  TestCommandEnd();

  TestCommandBegin(__eCheck, __cCheck, "verify all vehicle doors open and unlocking rearlid,fuel filler flap lock", "5");
  {
    __bVerdict = __eVerdictPass;
    __ReportTableHead5Columns(__cCheckCaption, __cTSym, __cTOp, __cRefVal, __cActual, __cRes);
    {
      __csr = CheckSignalMatch(`Network::dbNode::`BC_F::`BC_F_BODY1_GW_Container_ST3_CLkS_Dr_State_ST3::`DrRLtch_FL_Stat_ST3, 2, "==") == 1;
      __ReportTableRow(0, "PDU signal 'DrRLtch_FL_Stat_ST3'", "==", 2, "I_C02_DR_STAT_OPN");
      __ReportCell(`Network::dbNode::`BC_F::`BC_F_BODY1_GW_Container_ST3_CLkS_Dr_State_ST3::`DrRLtch_FL_Stat_ST3);
      __ReportCellResult(__csr, __ePassFail);
      __bVerdict = __bVerdict && __csr;
    }
    {
      __csr = CheckSignalMatch(`Network::dbNode::`BC_F::`BC_F_BODY1_GW_Container_ST3_CLkS_Dr_State_ST3::`DrRLtch_FR_Stat_ST3, 2, "==") == 1;
      __ReportTableRow(0, "PDU signal 'DrRLtch_FR_Stat_ST3'", "==", 2, "I_C02_DR_STAT_OPN");
      __ReportCell(`Network::dbNode::`BC_F::`BC_F_BODY1_GW_Container_ST3_CLkS_Dr_State_ST3::`DrRLtch_FR_Stat_ST3);
      __ReportCellResult(__csr, __ePassFail);
      __bVerdict = __bVerdict && __csr;
    }
    {
      __csr = CheckSignalMatch(`Network::dbNode::`BC_F::`BC_F_BODY1_GW_Container_ST3_CLkS_Dr_State_ST3::`DrRLtch_RL_Stat_ST3, 2, "==") == 1;
      __ReportTableRow(0, "PDU signal 'DrRLtch_RL_Stat_ST3'", "==", 2, "I_C02_DR_STAT_OPN");
      __ReportCell(`Network::dbNode::`BC_F::`BC_F_BODY1_GW_Container_ST3_CLkS_Dr_State_ST3::`DrRLtch_RL_Stat_ST3);
      __ReportCellResult(__csr, __ePassFail);
      __bVerdict = __bVerdict && __csr;
    }
    {
      __csr = CheckSignalMatch(`Network::dbNode::`BC_F::`BC_F_BODY1_GW_Container_ST3_CLkS_Dr_State_ST3::`DrRLtch_RR_Stat_ST3, 2, "==") == 1;
      __ReportTableRow(0, "PDU signal 'DrRLtch_RR_Stat_ST3'", "==", 2, "I_C02_DR_STAT_OPN");
      __ReportCell(`Network::dbNode::`BC_F::`BC_F_BODY1_GW_Container_ST3_CLkS_Dr_State_ST3::`DrRLtch_RR_Stat_ST3);
      __ReportCellResult(__csr, __ePassFail);
      __bVerdict = __bVerdict && __csr;
    }
    __ReportTableEndVerdict("1", __bVerdict);
  }
  TestCommandEnd();


}

void Ttc9e1859_Tet_Tc2_Completion()
{  
  TestCompletionBegin();
  {
    TestCommandBegin(__eSet, __cSet, "Set trigger crash signal Impact_X_ST3=0(default value)", "6");
    {
    
      __ReportTableHead3Columns(__cSetCaption , __cTSym, __cTOp, __cAssigned); 
      {
        $`Network::dbNode::`BC_F::`BC_F_BODY1_GW_Container_ST3_Impact3_ST3::`Impact_X_ST3.phys = 0;
        __ReportSignalSetLValue("PDU signal 'Impact_X_ST3'", `Network::dbNode::`BC_F::`BC_F_BODY1_GW_Container_ST3_Impact3_ST3::`Impact_X_ST3, __cArray);
        __ReportTableRow(0, __cArray, __cAOp, 0, "");
      }
      __ReportTableEndTestStep("1");
    }
    TestCommandEnd();

  }
  TestCompletionEnd();
}

void Ttc9e1859_Tet_Tc3()
{
  CreateTTEIFFunction("Ttc9e1859_Tc3", __eTcDef, __eLocal);  
  CallInterfaceFunction("TC_WL-Star3-TS-34578_Door lock release - roll over event 2", __cEmpty , __cEmpty );
}
testcase Ttc9e1859_Tc3()
{	
  SetBreakOnFail(1);

  CreateTTEIFFunction("Ttc9e1859_Tet_Tc3_Completion", __eFct, __eLocal);
  
  AddIFAsCleanUpFunction();

  TestCommandBegin(__eSet, __cSet, "Set trigger roll over event signal Impact_RO_type2_ST3=1", "1");
  {
  
    __ReportTableHead3Columns(__cSetCaption , __cTSym, __cTOp, __cAssigned); 
    {
      $`Network::dbNode::`BC_F::`BC_F_BODY1_GW_Container_ST3_Impact3_ST3::`Impact_RO_type2_ST3.phys = 1;
      __ReportSignalSetLValue("PDU signal 'Impact_RO_type2_ST3'", `Network::dbNode::`BC_F::`BC_F_BODY1_GW_Container_ST3_Impact3_ST3::`Impact_RO_type2_ST3, __cArray);
      __ReportTableRow(0, __cArray, __cAOp, 1, "");
    }
    __ReportTableEndTestStep("1");
  }
  TestCommandEnd();

  TestCommandBegin(__eWait, __cWait, "wait for 10 s", "2");
  {
    __Wait("1", (10 * 1000000000), 1000000000, "");
  }
  TestCommandEnd();

  TestCommandBegin(__eCheck, __cCheck, "verify all vehicle doors open and unlocking rearlid,fuel filler flap lock", "4");
  {
    __bVerdict = __eVerdictPass;
    __ReportTableHead5Columns(__cCheckCaption, __cTSym, __cTOp, __cRefVal, __cActual, __cRes);
    {
      __csr = CheckSignalMatch(`Network::dbNode::`BC_F::`BC_F_BODY1_GW_Container_ST3_CLkS_Dr_State_ST3::`DrRLtch_FL_Stat_ST3, 2, "==") == 1;
      __ReportTableRow(0, "PDU signal 'DrRLtch_FL_Stat_ST3'", "==", 2, "I_C02_DR_STAT_OPN");
      __ReportCell(`Network::dbNode::`BC_F::`BC_F_BODY1_GW_Container_ST3_CLkS_Dr_State_ST3::`DrRLtch_FL_Stat_ST3);
      __ReportCellResult(__csr, __ePassFail);
      __bVerdict = __bVerdict && __csr;
    }
    {
      __csr = CheckSignalMatch(`Network::dbNode::`BC_F::`BC_F_BODY1_GW_Container_ST3_CLkS_Dr_State_ST3::`DrRLtch_FR_Stat_ST3, 2, "==") == 1;
      __ReportTableRow(0, "PDU signal 'DrRLtch_FR_Stat_ST3'", "==", 2, "I_C02_DR_STAT_OPN");
      __ReportCell(`Network::dbNode::`BC_F::`BC_F_BODY1_GW_Container_ST3_CLkS_Dr_State_ST3::`DrRLtch_FR_Stat_ST3);
      __ReportCellResult(__csr, __ePassFail);
      __bVerdict = __bVerdict && __csr;
    }
    {
      __csr = CheckSignalMatch(`Network::dbNode::`BC_F::`BC_F_BODY1_GW_Container_ST3_CLkS_Dr_State_ST3::`DrRLtch_RL_Stat_ST3, 2, "==") == 1;
      __ReportTableRow(0, "PDU signal 'DrRLtch_RL_Stat_ST3'", "==", 2, "I_C02_DR_STAT_OPN");
      __ReportCell(`Network::dbNode::`BC_F::`BC_F_BODY1_GW_Container_ST3_CLkS_Dr_State_ST3::`DrRLtch_RL_Stat_ST3);
      __ReportCellResult(__csr, __ePassFail);
      __bVerdict = __bVerdict && __csr;
    }
    {
      __csr = CheckSignalMatch(`Network::dbNode::`BC_F::`BC_F_BODY1_GW_Container_ST3_CLkS_Dr_State_ST3::`DrRLtch_RR_Stat_ST3, 2, "==") == 1;
      __ReportTableRow(0, "PDU signal 'DrRLtch_RR_Stat_ST3'", "==", 2, "I_C02_DR_STAT_OPN");
      __ReportCell(`Network::dbNode::`BC_F::`BC_F_BODY1_GW_Container_ST3_CLkS_Dr_State_ST3::`DrRLtch_RR_Stat_ST3);
      __ReportCellResult(__csr, __ePassFail);
      __bVerdict = __bVerdict && __csr;
    }
    __ReportTableEndVerdict("1", __bVerdict);
  }
  TestCommandEnd();


}

void Ttc9e1859_Tet_Tc3_Completion()
{  
  TestCompletionBegin();
  {
    TestCommandBegin(__eSet, __cSet, "Set trigger roll over event signal Impact_RO_type2_ST3=0", "5");
    {
    
      __ReportTableHead3Columns(__cSetCaption , __cTSym, __cTOp, __cAssigned); 
      {
        $`Network::dbNode::`BC_F::`BC_F_BODY1_GW_Container_ST3_Impact3_ST3::`Impact_RO_type2_ST3.phys = 0;
        __ReportSignalSetLValue("PDU signal 'Impact_RO_type2_ST3'", `Network::dbNode::`BC_F::`BC_F_BODY1_GW_Container_ST3_Impact3_ST3::`Impact_RO_type2_ST3, __cArray);
        __ReportTableRow(0, __cArray, __cAOp, 0, "");
      }
      __ReportTableEndTestStep("1");
    }
    TestCommandEnd();

  }
  TestCompletionEnd();
}

void Ttc9e1859_Tet_Tc4()
{
  CreateTTEIFFunction("Ttc9e1859_Tc4", __eTcDef, __eLocal);  
  CallInterfaceFunction("TC_WL-Star3-TS-34580_Door lock release - Front Collision Type1", __cEmpty , __cEmpty );
}
testcase Ttc9e1859_Tc4()
{	
  SetBreakOnFail(1);

  CreateTTEIFFunction("Ttc9e1859_Tet_Tc4_Completion", __eFct, __eLocal);
  
  AddIFAsCleanUpFunction();

  TestPreparationBegin();
  {
    {
      CreateTTEIFFunction("Ttc9e1859_PreCondition", __eFct, __eLocal);
      CallInterfaceFunction(__cEmpty, __cEmpty, "2c26847c-6531-4243-a0ff-f9a3432fa9f9");
    }


  }
  TestPreparationEnd();

  TestCommandBegin(__eSet, __cSet, "Set trigger crash signal Impact_F1_ST3=1", "2");
  {
  
    __ReportTableHead3Columns(__cSetCaption , __cTSym, __cTOp, __cAssigned); 
    {
      $`Network::dbNode::`BC_F::`BC_F_BODY1_GW_Container_ST3_Impact3_ST3::`Impact_F1_ST3.phys = 1;
      __ReportSignalSetLValue("PDU signal 'Impact_F1_ST3'", `Network::dbNode::`BC_F::`BC_F_BODY1_GW_Container_ST3_Impact3_ST3::`Impact_F1_ST3, __cArray);
      __ReportTableRow(0, __cArray, __cAOp, 1, "");
    }
    __ReportTableEndTestStep("1");
  }
  TestCommandEnd();

  TestCommandBegin(__eWait, __cWait, "wait for 10 s", "3");
  {
    __Wait("1", (10 * 1000000000), 1000000000, "");
  }
  TestCommandEnd();

  TestCommandBegin(__eCheck, __cCheck, "verify all vehicle doors open and unlocking rearlid,fuel filler flap lock", "5");
  {
    __bVerdict = __eVerdictPass;
    __ReportTableHead5Columns(__cCheckCaption, __cTSym, __cTOp, __cRefVal, __cActual, __cRes);
    {
      __csr = CheckSignalMatch(`Network::dbNode::`BC_F::`BC_F_BODY1_GW_Container_ST3_CLkS_Dr_State_ST3::`DrRLtch_FL_Stat_ST3, 2, "==") == 1;
      __ReportTableRow(0, "PDU signal 'DrRLtch_FL_Stat_ST3'", "==", 2, "I_C02_DR_STAT_OPN");
      __ReportCell(`Network::dbNode::`BC_F::`BC_F_BODY1_GW_Container_ST3_CLkS_Dr_State_ST3::`DrRLtch_FL_Stat_ST3);
      __ReportCellResult(__csr, __ePassFail);
      __bVerdict = __bVerdict && __csr;
    }
    {
      __csr = CheckSignalMatch(`Network::dbNode::`BC_F::`BC_F_BODY1_GW_Container_ST3_CLkS_Dr_State_ST3::`DrRLtch_FR_Stat_ST3, 2, "==") == 1;
      __ReportTableRow(0, "PDU signal 'DrRLtch_FR_Stat_ST3'", "==", 2, "I_C02_DR_STAT_OPN");
      __ReportCell(`Network::dbNode::`BC_F::`BC_F_BODY1_GW_Container_ST3_CLkS_Dr_State_ST3::`DrRLtch_FR_Stat_ST3);
      __ReportCellResult(__csr, __ePassFail);
      __bVerdict = __bVerdict && __csr;
    }
    {
      __csr = CheckSignalMatch(`Network::dbNode::`BC_F::`BC_F_BODY1_GW_Container_ST3_CLkS_Dr_State_ST3::`DrRLtch_RL_Stat_ST3, 2, "==") == 1;
      __ReportTableRow(0, "PDU signal 'DrRLtch_RL_Stat_ST3'", "==", 2, "I_C02_DR_STAT_OPN");
      __ReportCell(`Network::dbNode::`BC_F::`BC_F_BODY1_GW_Container_ST3_CLkS_Dr_State_ST3::`DrRLtch_RL_Stat_ST3);
      __ReportCellResult(__csr, __ePassFail);
      __bVerdict = __bVerdict && __csr;
    }
    {
      __csr = CheckSignalMatch(`Network::dbNode::`BC_F::`BC_F_BODY1_GW_Container_ST3_CLkS_Dr_State_ST3::`DrRLtch_RR_Stat_ST3, 2, "==") == 1;
      __ReportTableRow(0, "PDU signal 'DrRLtch_RR_Stat_ST3'", "==", 2, "I_C02_DR_STAT_OPN");
      __ReportCell(`Network::dbNode::`BC_F::`BC_F_BODY1_GW_Container_ST3_CLkS_Dr_State_ST3::`DrRLtch_RR_Stat_ST3);
      __ReportCellResult(__csr, __ePassFail);
      __bVerdict = __bVerdict && __csr;
    }
    __ReportTableEndVerdict("1", __bVerdict);
  }
  TestCommandEnd();


}

void Ttc9e1859_Tet_Tc4_Completion()
{  
  TestCompletionBegin();
  {
    TestCommandBegin(__eSet, __cSet, "Set trigger crash signal Impact_X_ST3=0(default value)", "6");
    {
    
      __ReportTableHead3Columns(__cSetCaption , __cTSym, __cTOp, __cAssigned); 
      {
        $`Network::dbNode::`BC_F::`BC_F_BODY1_GW_Container_ST3_Impact3_ST3::`Impact_X_ST3.phys = 0;
        __ReportSignalSetLValue("PDU signal 'Impact_X_ST3'", `Network::dbNode::`BC_F::`BC_F_BODY1_GW_Container_ST3_Impact3_ST3::`Impact_X_ST3, __cArray);
        __ReportTableRow(0, __cArray, __cAOp, 0, "");
      }
      __ReportTableEndTestStep("1");
    }
    TestCommandEnd();

  }
  TestCompletionEnd();
}

void Ttc9e1859_Tet_Tc5()
{
  CreateTTEIFFunction("Ttc9e1859_Tc5", __eTcDef, __eLocal);  
  CallInterfaceFunction("TC_WL-Star3-TS-34582_Door lock release - Front Collision Type2", __cEmpty , __cEmpty );
}
testcase Ttc9e1859_Tc5()
{	
  SetBreakOnFail(1);

  CreateTTEIFFunction("Ttc9e1859_Tet_Tc5_Completion", __eFct, __eLocal);
  
  AddIFAsCleanUpFunction();

  TestPreparationBegin();
  {
    {
      CreateTTEIFFunction("Ttc9e1859_PreCondition", __eFct, __eLocal);
      CallInterfaceFunction(__cEmpty, __cEmpty, "2c26847c-6531-4243-a0ff-f9a3432fa9f9");
    }


  }
  TestPreparationEnd();

  TestCommandBegin(__eSet, __cSet, "Set trigger crash signal Impact_F2_ST3=1", "2");
  {
  
    __ReportTableHead3Columns(__cSetCaption , __cTSym, __cTOp, __cAssigned); 
    {
      $`Network::dbNode::`BC_F::`BC_F_BODY1_GW_Container_ST3_Impact3_ST3::`Impact_F2_ST3.phys = 1;
      __ReportSignalSetLValue("PDU signal 'Impact_F2_ST3'", `Network::dbNode::`BC_F::`BC_F_BODY1_GW_Container_ST3_Impact3_ST3::`Impact_F2_ST3, __cArray);
      __ReportTableRow(0, __cArray, __cAOp, 1, "");
    }
    __ReportTableEndTestStep("1");
  }
  TestCommandEnd();

  TestCommandBegin(__eWait, __cWait, "wait for 10 s", "3");
  {
    __Wait("1", (10 * 1000000000), 1000000000, "");
  }
  TestCommandEnd();

  TestCommandBegin(__eCheck, __cCheck, "verify all vehicle doors open and unlocking rearlid,fuel filler flap lock", "5");
  {
    __bVerdict = __eVerdictPass;
    __ReportTableHead5Columns(__cCheckCaption, __cTSym, __cTOp, __cRefVal, __cActual, __cRes);
    {
      __csr = CheckSignalMatch(`Network::dbNode::`BC_F::`BC_F_BODY1_GW_Container_ST3_CLkS_Dr_State_ST3::`DrRLtch_FL_Stat_ST3, 2, "==") == 1;
      __ReportTableRow(0, "PDU signal 'DrRLtch_FL_Stat_ST3'", "==", 2, "I_C02_DR_STAT_OPN");
      __ReportCell(`Network::dbNode::`BC_F::`BC_F_BODY1_GW_Container_ST3_CLkS_Dr_State_ST3::`DrRLtch_FL_Stat_ST3);
      __ReportCellResult(__csr, __ePassFail);
      __bVerdict = __bVerdict && __csr;
    }
    {
      __csr = CheckSignalMatch(`Network::dbNode::`BC_F::`BC_F_BODY1_GW_Container_ST3_CLkS_Dr_State_ST3::`DrRLtch_FR_Stat_ST3, 2, "==") == 1;
      __ReportTableRow(0, "PDU signal 'DrRLtch_FR_Stat_ST3'", "==", 2, "I_C02_DR_STAT_OPN");
      __ReportCell(`Network::dbNode::`BC_F::`BC_F_BODY1_GW_Container_ST3_CLkS_Dr_State_ST3::`DrRLtch_FR_Stat_ST3);
      __ReportCellResult(__csr, __ePassFail);
      __bVerdict = __bVerdict && __csr;
    }
    {
      __csr = CheckSignalMatch(`Network::dbNode::`BC_F::`BC_F_BODY1_GW_Container_ST3_CLkS_Dr_State_ST3::`DrRLtch_RL_Stat_ST3, 2, "==") == 1;
      __ReportTableRow(0, "PDU signal 'DrRLtch_RL_Stat_ST3'", "==", 2, "I_C02_DR_STAT_OPN");
      __ReportCell(`Network::dbNode::`BC_F::`BC_F_BODY1_GW_Container_ST3_CLkS_Dr_State_ST3::`DrRLtch_RL_Stat_ST3);
      __ReportCellResult(__csr, __ePassFail);
      __bVerdict = __bVerdict && __csr;
    }
    {
      __csr = CheckSignalMatch(`Network::dbNode::`BC_F::`BC_F_BODY1_GW_Container_ST3_CLkS_Dr_State_ST3::`DrRLtch_RR_Stat_ST3, 2, "==") == 1;
      __ReportTableRow(0, "PDU signal 'DrRLtch_RR_Stat_ST3'", "==", 2, "I_C02_DR_STAT_OPN");
      __ReportCell(`Network::dbNode::`BC_F::`BC_F_BODY1_GW_Container_ST3_CLkS_Dr_State_ST3::`DrRLtch_RR_Stat_ST3);
      __ReportCellResult(__csr, __ePassFail);
      __bVerdict = __bVerdict && __csr;
    }
    __ReportTableEndVerdict("1", __bVerdict);
  }
  TestCommandEnd();


}

void Ttc9e1859_Tet_Tc5_Completion()
{  
  TestCompletionBegin();
  {
    TestCommandBegin(__eSet, __cSet, "Set trigger crash signal Impact_X_ST3=0(default value)", "6");
    {
    
      __ReportTableHead3Columns(__cSetCaption , __cTSym, __cTOp, __cAssigned); 
      {
        $`Network::dbNode::`BC_F::`BC_F_BODY1_GW_Container_ST3_Impact3_ST3::`Impact_X_ST3.phys = 0;
        __ReportSignalSetLValue("PDU signal 'Impact_X_ST3'", `Network::dbNode::`BC_F::`BC_F_BODY1_GW_Container_ST3_Impact3_ST3::`Impact_X_ST3, __cArray);
        __ReportTableRow(0, __cArray, __cAOp, 0, "");
      }
      __ReportTableEndTestStep("1");
    }
    TestCommandEnd();

  }
  TestCompletionEnd();
}

void Ttc9e1859_Tet_Tc6()
{
  CreateTTEIFFunction("Ttc9e1859_Tc6", __eTcDef, __eLocal);  
  CallInterfaceFunction("TC_WL-Star3-TS-34580_Door lock release any crash event X - Front Collision Type1", __cEmpty , __cEmpty );
}
testcase Ttc9e1859_Tc6()
{	
  SetBreakOnFail(1);

  CreateTTEIFFunction("Ttc9e1859_Tet_Tc6_Completion", __eFct, __eLocal);
  
  AddIFAsCleanUpFunction();

  TestPreparationBegin();
  {
    {
      CreateTTEIFFunction("Ttc9e1859_PreCondition", __eFct, __eLocal);
      CallInterfaceFunction(__cEmpty, __cEmpty, "2c26847c-6531-4243-a0ff-f9a3432fa9f9");
    }


  }
  TestPreparationEnd();

  TestCommandBegin(__eSet, __cSet, "Set trigger crash signal Impact_X_ST3=1", "2");
  {
  
    __ReportTableHead3Columns(__cSetCaption , __cTSym, __cTOp, __cAssigned); 
    {
      $`Network::dbNode::`BC_F::`BC_F_BODY1_GW_Container_ST3_Impact3_ST3::`Impact_X_ST3.phys = 1;
      __ReportSignalSetLValue("PDU signal 'Impact_X_ST3'", `Network::dbNode::`BC_F::`BC_F_BODY1_GW_Container_ST3_Impact3_ST3::`Impact_X_ST3, __cArray);
      __ReportTableRow(0, __cArray, __cAOp, 1, "");
    }
    __ReportTableEndTestStep("1");
  }
  TestCommandEnd();

  TestCommandBegin(__eSet, __cSet, "Set trigger crash signal Impact_F1_ST3=1", "3");
  {
  
    __ReportTableHead3Columns(__cSetCaption , __cTSym, __cTOp, __cAssigned); 
    {
      $`Network::dbNode::`BC_F::`BC_F_BODY1_GW_Container_ST3_Impact3_ST3::`Impact_F1_ST3.phys = 1;
      __ReportSignalSetLValue("PDU signal 'Impact_F1_ST3'", `Network::dbNode::`BC_F::`BC_F_BODY1_GW_Container_ST3_Impact3_ST3::`Impact_F1_ST3, __cArray);
      __ReportTableRow(0, __cArray, __cAOp, 1, "");
    }
    __ReportTableEndTestStep("1");
  }
  TestCommandEnd();

  TestCommandBegin(__eWait, __cWait, "wait for 10 s", "4");
  {
    __Wait("1", (10 * 1000000000), 1000000000, "");
  }
  TestCommandEnd();

  TestCommandBegin(__eCheck, __cCheck, "verify all vehicle doors open and unlocking rearlid,fuel filler flap lock", "6");
  {
    __bVerdict = __eVerdictPass;
    __ReportTableHead5Columns(__cCheckCaption, __cTSym, __cTOp, __cRefVal, __cActual, __cRes);
    {
      __csr = CheckSignalMatch(`Network::dbNode::`BC_F::`BC_F_BODY1_GW_Container_ST3_CLkS_Dr_State_ST3::`DrRLtch_FL_Stat_ST3, 2, "==") == 1;
      __ReportTableRow(0, "PDU signal 'DrRLtch_FL_Stat_ST3'", "==", 2, "I_C02_DR_STAT_OPN");
      __ReportCell(`Network::dbNode::`BC_F::`BC_F_BODY1_GW_Container_ST3_CLkS_Dr_State_ST3::`DrRLtch_FL_Stat_ST3);
      __ReportCellResult(__csr, __ePassFail);
      __bVerdict = __bVerdict && __csr;
    }
    {
      __csr = CheckSignalMatch(`Network::dbNode::`BC_F::`BC_F_BODY1_GW_Container_ST3_CLkS_Dr_State_ST3::`DrRLtch_FR_Stat_ST3, 2, "==") == 1;
      __ReportTableRow(0, "PDU signal 'DrRLtch_FR_Stat_ST3'", "==", 2, "I_C02_DR_STAT_OPN");
      __ReportCell(`Network::dbNode::`BC_F::`BC_F_BODY1_GW_Container_ST3_CLkS_Dr_State_ST3::`DrRLtch_FR_Stat_ST3);
      __ReportCellResult(__csr, __ePassFail);
      __bVerdict = __bVerdict && __csr;
    }
    {
      __csr = CheckSignalMatch(`Network::dbNode::`BC_F::`BC_F_BODY1_GW_Container_ST3_CLkS_Dr_State_ST3::`DrRLtch_RL_Stat_ST3, 2, "==") == 1;
      __ReportTableRow(0, "PDU signal 'DrRLtch_RL_Stat_ST3'", "==", 2, "I_C02_DR_STAT_OPN");
      __ReportCell(`Network::dbNode::`BC_F::`BC_F_BODY1_GW_Container_ST3_CLkS_Dr_State_ST3::`DrRLtch_RL_Stat_ST3);
      __ReportCellResult(__csr, __ePassFail);
      __bVerdict = __bVerdict && __csr;
    }
    {
      __csr = CheckSignalMatch(`Network::dbNode::`BC_F::`BC_F_BODY1_GW_Container_ST3_CLkS_Dr_State_ST3::`DrRLtch_RR_Stat_ST3, 2, "==") == 1;
      __ReportTableRow(0, "PDU signal 'DrRLtch_RR_Stat_ST3'", "==", 2, "I_C02_DR_STAT_OPN");
      __ReportCell(`Network::dbNode::`BC_F::`BC_F_BODY1_GW_Container_ST3_CLkS_Dr_State_ST3::`DrRLtch_RR_Stat_ST3);
      __ReportCellResult(__csr, __ePassFail);
      __bVerdict = __bVerdict && __csr;
    }
    __ReportTableEndVerdict("1", __bVerdict);
  }
  TestCommandEnd();


}

void Ttc9e1859_Tet_Tc6_Completion()
{  
  TestCompletionBegin();
  {
    TestCommandBegin(__eSet, __cSet, "Set trigger crash signal Impact_X_ST3=0(default value)", "7");
    {
    
      __ReportTableHead3Columns(__cSetCaption , __cTSym, __cTOp, __cAssigned); 
      {
        $`Network::dbNode::`BC_F::`BC_F_BODY1_GW_Container_ST3_Impact3_ST3::`Impact_X_ST3.phys = 0;
        __ReportSignalSetLValue("PDU signal 'Impact_X_ST3'", `Network::dbNode::`BC_F::`BC_F_BODY1_GW_Container_ST3_Impact3_ST3::`Impact_X_ST3, __cArray);
        __ReportTableRow(0, __cArray, __cAOp, 0, "");
      }
      __ReportTableEndTestStep("1");
    }
    TestCommandEnd();

  }
  TestCompletionEnd();
}

void Ttc9e1859_Tet_Tc7()
{
  CreateTTEIFFunction("Ttc9e1859_Tc7", __eTcDef, __eLocal);  
  CallInterfaceFunction("TC_WL-Star3-TS-34584_Door lock release - Rear Collision Type1", __cEmpty , __cEmpty );
}
testcase Ttc9e1859_Tc7()
{	
  SetBreakOnFail(1);

  CreateTTEIFFunction("Ttc9e1859_Tet_Tc7_Completion", __eFct, __eLocal);
  
  AddIFAsCleanUpFunction();

  TestPreparationBegin();
  {
    {
      CreateTTEIFFunction("Ttc9e1859_PreCondition", __eFct, __eLocal);
      CallInterfaceFunction(__cEmpty, __cEmpty, "2c26847c-6531-4243-a0ff-f9a3432fa9f9");
    }


  }
  TestPreparationEnd();

  TestCommandBegin(__eSet, __cSet, "Set trigger crash signal Impact_R1_ST3=1", "2");
  {
  
    __ReportTableHead3Columns(__cSetCaption , __cTSym, __cTOp, __cAssigned); 
    {
      $`Network::dbNode::`EIS_BASE::`EIS_BODY1_Container_ST3_Impact2_ST3::`Impact_R1_ST3.phys = 1;
      __ReportSignalSetLValue("PDU signal 'Impact_R1_ST3'", `Network::dbNode::`EIS_BASE::`EIS_BODY1_Container_ST3_Impact2_ST3::`Impact_R1_ST3, __cArray);
      __ReportTableRow(0, __cArray, __cAOp, 1, "");
    }
    __ReportTableEndTestStep("1");
  }
  TestCommandEnd();

  TestCommandBegin(__eWait, __cWait, "wait for 10 s", "3");
  {
    __Wait("1", (10 * 1000000000), 1000000000, "");
  }
  TestCommandEnd();

  TestCommandBegin(__eCheck, __cCheck, "verify all vehicle doors open and unlocking rearlid,fuel filler flap lock", "5");
  {
    __bVerdict = __eVerdictPass;
    __ReportTableHead5Columns(__cCheckCaption, __cTSym, __cTOp, __cRefVal, __cActual, __cRes);
    {
      __csr = CheckSignalMatch(`Network::dbNode::`BC_F::`BC_F_BODY1_GW_Container_ST3_CLkS_Dr_State_ST3::`DrRLtch_FL_Stat_ST3, 2, "==") == 1;
      __ReportTableRow(0, "PDU signal 'DrRLtch_FL_Stat_ST3'", "==", 2, "I_C02_DR_STAT_OPN");
      __ReportCell(`Network::dbNode::`BC_F::`BC_F_BODY1_GW_Container_ST3_CLkS_Dr_State_ST3::`DrRLtch_FL_Stat_ST3);
      __ReportCellResult(__csr, __ePassFail);
      __bVerdict = __bVerdict && __csr;
    }
    {
      __csr = CheckSignalMatch(`Network::dbNode::`BC_F::`BC_F_BODY1_GW_Container_ST3_CLkS_Dr_State_ST3::`DrRLtch_FR_Stat_ST3, 2, "==") == 1;
      __ReportTableRow(0, "PDU signal 'DrRLtch_FR_Stat_ST3'", "==", 2, "I_C02_DR_STAT_OPN");
      __ReportCell(`Network::dbNode::`BC_F::`BC_F_BODY1_GW_Container_ST3_CLkS_Dr_State_ST3::`DrRLtch_FR_Stat_ST3);
      __ReportCellResult(__csr, __ePassFail);
      __bVerdict = __bVerdict && __csr;
    }
    {
      __csr = CheckSignalMatch(`Network::dbNode::`BC_F::`BC_F_BODY1_GW_Container_ST3_CLkS_Dr_State_ST3::`DrRLtch_RL_Stat_ST3, 2, "==") == 1;
      __ReportTableRow(0, "PDU signal 'DrRLtch_RL_Stat_ST3'", "==", 2, "I_C02_DR_STAT_OPN");
      __ReportCell(`Network::dbNode::`BC_F::`BC_F_BODY1_GW_Container_ST3_CLkS_Dr_State_ST3::`DrRLtch_RL_Stat_ST3);
      __ReportCellResult(__csr, __ePassFail);
      __bVerdict = __bVerdict && __csr;
    }
    {
      __csr = CheckSignalMatch(`Network::dbNode::`BC_F::`BC_F_BODY1_GW_Container_ST3_CLkS_Dr_State_ST3::`DrRLtch_RR_Stat_ST3, 2, "==") == 1;
      __ReportTableRow(0, "PDU signal 'DrRLtch_RR_Stat_ST3'", "==", 2, "I_C02_DR_STAT_OPN");
      __ReportCell(`Network::dbNode::`BC_F::`BC_F_BODY1_GW_Container_ST3_CLkS_Dr_State_ST3::`DrRLtch_RR_Stat_ST3);
      __ReportCellResult(__csr, __ePassFail);
      __bVerdict = __bVerdict && __csr;
    }
    __ReportTableEndVerdict("1", __bVerdict);
  }
  TestCommandEnd();


}

void Ttc9e1859_Tet_Tc7_Completion()
{  
  TestCompletionBegin();
  {
    TestCommandBegin(__eSet, __cSet, "Set trigger crash signal Impact_X_ST3=0(default value)", "6");
    {
    
      __ReportTableHead3Columns(__cSetCaption , __cTSym, __cTOp, __cAssigned); 
      {
        $`Network::dbNode::`BC_F::`BC_F_BODY1_GW_Container_ST3_Impact3_ST3::`Impact_X_ST3.phys = 0;
        __ReportSignalSetLValue("PDU signal 'Impact_X_ST3'", `Network::dbNode::`BC_F::`BC_F_BODY1_GW_Container_ST3_Impact3_ST3::`Impact_X_ST3, __cArray);
        __ReportTableRow(0, __cArray, __cAOp, 0, "");
      }
      __ReportTableEndTestStep("1");
    }
    TestCommandEnd();

  }
  TestCompletionEnd();
}

void Ttc9e1859_Tet_Tc8()
{
  CreateTTEIFFunction("Ttc9e1859_Tc8", __eTcDef, __eLocal);  
  CallInterfaceFunction("TC_WL-Star3-TS-34586_Door lock release - Rear Collision Type2", __cEmpty , __cEmpty );
}
testcase Ttc9e1859_Tc8()
{	
  SetBreakOnFail(1);

  CreateTTEIFFunction("Ttc9e1859_Tet_Tc8_Completion", __eFct, __eLocal);
  
  AddIFAsCleanUpFunction();

  TestPreparationBegin();
  {
    {
      CreateTTEIFFunction("Ttc9e1859_PreCondition", __eFct, __eLocal);
      CallInterfaceFunction(__cEmpty, __cEmpty, "2c26847c-6531-4243-a0ff-f9a3432fa9f9");
    }


  }
  TestPreparationEnd();

  TestCommandBegin(__eSet, __cSet, "Set trigger crash signal Impact_R2_ST3=1", "2");
  {
  
    __ReportTableHead3Columns(__cSetCaption , __cTSym, __cTOp, __cAssigned); 
    {
      $`Network::dbNode::`EIS_BASE::`EIS_BODY1_Container_ST3_Impact2_ST3::`Impact_R2_ST3.phys = 1;
      __ReportSignalSetLValue("PDU signal 'Impact_R2_ST3'", `Network::dbNode::`EIS_BASE::`EIS_BODY1_Container_ST3_Impact2_ST3::`Impact_R2_ST3, __cArray);
      __ReportTableRow(0, __cArray, __cAOp, 1, "");
    }
    __ReportTableEndTestStep("1");
  }
  TestCommandEnd();

  TestCommandBegin(__eWait, __cWait, "wait for 10 s", "3");
  {
    __Wait("1", (10 * 1000000000), 1000000000, "");
  }
  TestCommandEnd();

  TestCommandBegin(__eCheck, __cCheck, "verify all vehicle doors open and unlocking rearlid,fuel filler flap lock", "5");
  {
    __bVerdict = __eVerdictPass;
    __ReportTableHead5Columns(__cCheckCaption, __cTSym, __cTOp, __cRefVal, __cActual, __cRes);
    {
      __csr = CheckSignalMatch(`Network::dbNode::`BC_F::`BC_F_BODY1_GW_Container_ST3_CLkS_Dr_State_ST3::`DrRLtch_FL_Stat_ST3, 2, "==") == 1;
      __ReportTableRow(0, "PDU signal 'DrRLtch_FL_Stat_ST3'", "==", 2, "I_C02_DR_STAT_OPN");
      __ReportCell(`Network::dbNode::`BC_F::`BC_F_BODY1_GW_Container_ST3_CLkS_Dr_State_ST3::`DrRLtch_FL_Stat_ST3);
      __ReportCellResult(__csr, __ePassFail);
      __bVerdict = __bVerdict && __csr;
    }
    {
      __csr = CheckSignalMatch(`Network::dbNode::`BC_F::`BC_F_BODY1_GW_Container_ST3_CLkS_Dr_State_ST3::`DrRLtch_FR_Stat_ST3, 2, "==") == 1;
      __ReportTableRow(0, "PDU signal 'DrRLtch_FR_Stat_ST3'", "==", 2, "I_C02_DR_STAT_OPN");
      __ReportCell(`Network::dbNode::`BC_F::`BC_F_BODY1_GW_Container_ST3_CLkS_Dr_State_ST3::`DrRLtch_FR_Stat_ST3);
      __ReportCellResult(__csr, __ePassFail);
      __bVerdict = __bVerdict && __csr;
    }
    {
      __csr = CheckSignalMatch(`Network::dbNode::`BC_F::`BC_F_BODY1_GW_Container_ST3_CLkS_Dr_State_ST3::`DrRLtch_RL_Stat_ST3, 2, "==") == 1;
      __ReportTableRow(0, "PDU signal 'DrRLtch_RL_Stat_ST3'", "==", 2, "I_C02_DR_STAT_OPN");
      __ReportCell(`Network::dbNode::`BC_F::`BC_F_BODY1_GW_Container_ST3_CLkS_Dr_State_ST3::`DrRLtch_RL_Stat_ST3);
      __ReportCellResult(__csr, __ePassFail);
      __bVerdict = __bVerdict && __csr;
    }
    {
      __csr = CheckSignalMatch(`Network::dbNode::`BC_F::`BC_F_BODY1_GW_Container_ST3_CLkS_Dr_State_ST3::`DrRLtch_RR_Stat_ST3, 2, "==") == 1;
      __ReportTableRow(0, "PDU signal 'DrRLtch_RR_Stat_ST3'", "==", 2, "I_C02_DR_STAT_OPN");
      __ReportCell(`Network::dbNode::`BC_F::`BC_F_BODY1_GW_Container_ST3_CLkS_Dr_State_ST3::`DrRLtch_RR_Stat_ST3);
      __ReportCellResult(__csr, __ePassFail);
      __bVerdict = __bVerdict && __csr;
    }
    __ReportTableEndVerdict("1", __bVerdict);
  }
  TestCommandEnd();


}

void Ttc9e1859_Tet_Tc8_Completion()
{  
  TestCompletionBegin();
  {
    TestCommandBegin(__eSet, __cSet, "Set trigger crash signal Impact_X_ST3=0(default value)", "6");
    {
    
      __ReportTableHead3Columns(__cSetCaption , __cTSym, __cTOp, __cAssigned); 
      {
        $`Network::dbNode::`BC_F::`BC_F_BODY1_GW_Container_ST3_Impact3_ST3::`Impact_X_ST3.phys = 0;
        __ReportSignalSetLValue("PDU signal 'Impact_X_ST3'", `Network::dbNode::`BC_F::`BC_F_BODY1_GW_Container_ST3_Impact3_ST3::`Impact_X_ST3, __cArray);
        __ReportTableRow(0, __cArray, __cAOp, 0, "");
      }
      __ReportTableEndTestStep("1");
    }
    TestCommandEnd();

  }
  TestCompletionEnd();
}

void Ttc9e1859_Tet_Tc9()
{
  CreateTTEIFFunction("Ttc9e1859_Tc9", __eTcDef, __eLocal);  
  CallInterfaceFunction("TC_WL-Star3-TS-34572_Door lock release any crash event X - Rear Collision Type1", __cEmpty , __cEmpty );
}
testcase Ttc9e1859_Tc9()
{	
  SetBreakOnFail(1);

  CreateTTEIFFunction("Ttc9e1859_Tet_Tc9_Completion", __eFct, __eLocal);
  
  AddIFAsCleanUpFunction();

  TestPreparationBegin();
  {
    {
      CreateTTEIFFunction("Ttc9e1859_PreCondition", __eFct, __eLocal);
      CallInterfaceFunction(__cEmpty, __cEmpty, "2c26847c-6531-4243-a0ff-f9a3432fa9f9");
    }


  }
  TestPreparationEnd();

  TestCommandBegin(__eSet, __cSet, "Set trigger crash signal Impact_X_ST3=1", "2");
  {
  
    __ReportTableHead3Columns(__cSetCaption , __cTSym, __cTOp, __cAssigned); 
    {
      $`Network::dbNode::`BC_F::`BC_F_BODY1_GW_Container_ST3_Impact3_ST3::`Impact_X_ST3.phys = 1;
      __ReportSignalSetLValue("PDU signal 'Impact_X_ST3'", `Network::dbNode::`BC_F::`BC_F_BODY1_GW_Container_ST3_Impact3_ST3::`Impact_X_ST3, __cArray);
      __ReportTableRow(0, __cArray, __cAOp, 1, "");
    }
    __ReportTableEndTestStep("1");
  }
  TestCommandEnd();

  TestCommandBegin(__eSet, __cSet, "Set trigger crash signal Impact_R1_ST3=1", "3");
  {
  
    __ReportTableHead3Columns(__cSetCaption , __cTSym, __cTOp, __cAssigned); 
    {
      $`Network::dbNode::`EIS_BASE::`EIS_BODY1_Container_ST3_Impact2_ST3::`Impact_R1_ST3.phys = 1;
      __ReportSignalSetLValue("PDU signal 'Impact_R1_ST3'", `Network::dbNode::`EIS_BASE::`EIS_BODY1_Container_ST3_Impact2_ST3::`Impact_R1_ST3, __cArray);
      __ReportTableRow(0, __cArray, __cAOp, 1, "");
    }
    __ReportTableEndTestStep("1");
  }
  TestCommandEnd();

  TestCommandBegin(__eWait, __cWait, "wait for 10 s", "4");
  {
    __Wait("1", (10 * 1000000000), 1000000000, "");
  }
  TestCommandEnd();

  TestCommandBegin(__eCheck, __cCheck, "verify all vehicle doors open and unlocking rearlid,fuel filler flap lock", "6");
  {
    __bVerdict = __eVerdictPass;
    __ReportTableHead5Columns(__cCheckCaption, __cTSym, __cTOp, __cRefVal, __cActual, __cRes);
    {
      __csr = CheckSignalMatch(`Network::dbNode::`BC_F::`BC_F_BODY1_GW_Container_ST3_CLkS_Dr_State_ST3::`DrRLtch_FL_Stat_ST3, 2, "==") == 1;
      __ReportTableRow(0, "PDU signal 'DrRLtch_FL_Stat_ST3'", "==", 2, "I_C02_DR_STAT_OPN");
      __ReportCell(`Network::dbNode::`BC_F::`BC_F_BODY1_GW_Container_ST3_CLkS_Dr_State_ST3::`DrRLtch_FL_Stat_ST3);
      __ReportCellResult(__csr, __ePassFail);
      __bVerdict = __bVerdict && __csr;
    }
    {
      __csr = CheckSignalMatch(`Network::dbNode::`BC_F::`BC_F_BODY1_GW_Container_ST3_CLkS_Dr_State_ST3::`DrRLtch_FR_Stat_ST3, 2, "==") == 1;
      __ReportTableRow(0, "PDU signal 'DrRLtch_FR_Stat_ST3'", "==", 2, "I_C02_DR_STAT_OPN");
      __ReportCell(`Network::dbNode::`BC_F::`BC_F_BODY1_GW_Container_ST3_CLkS_Dr_State_ST3::`DrRLtch_FR_Stat_ST3);
      __ReportCellResult(__csr, __ePassFail);
      __bVerdict = __bVerdict && __csr;
    }
    {
      __csr = CheckSignalMatch(`Network::dbNode::`BC_F::`BC_F_BODY1_GW_Container_ST3_CLkS_Dr_State_ST3::`DrRLtch_RL_Stat_ST3, 2, "==") == 1;
      __ReportTableRow(0, "PDU signal 'DrRLtch_RL_Stat_ST3'", "==", 2, "I_C02_DR_STAT_OPN");
      __ReportCell(`Network::dbNode::`BC_F::`BC_F_BODY1_GW_Container_ST3_CLkS_Dr_State_ST3::`DrRLtch_RL_Stat_ST3);
      __ReportCellResult(__csr, __ePassFail);
      __bVerdict = __bVerdict && __csr;
    }
    {
      __csr = CheckSignalMatch(`Network::dbNode::`BC_F::`BC_F_BODY1_GW_Container_ST3_CLkS_Dr_State_ST3::`DrRLtch_RR_Stat_ST3, 2, "==") == 1;
      __ReportTableRow(0, "PDU signal 'DrRLtch_RR_Stat_ST3'", "==", 2, "I_C02_DR_STAT_OPN");
      __ReportCell(`Network::dbNode::`BC_F::`BC_F_BODY1_GW_Container_ST3_CLkS_Dr_State_ST3::`DrRLtch_RR_Stat_ST3);
      __ReportCellResult(__csr, __ePassFail);
      __bVerdict = __bVerdict && __csr;
    }
    __ReportTableEndVerdict("1", __bVerdict);
  }
  TestCommandEnd();


}

void Ttc9e1859_Tet_Tc9_Completion()
{  
  TestCompletionBegin();
  {
    TestCommandBegin(__eSet, __cSet, "Set trigger crash signal Impact_X_ST3=0(default value)", "7");
    {
    
      __ReportTableHead3Columns(__cSetCaption , __cTSym, __cTOp, __cAssigned); 
      {
        $`Network::dbNode::`BC_F::`BC_F_BODY1_GW_Container_ST3_Impact3_ST3::`Impact_X_ST3.phys = 0;
        __ReportSignalSetLValue("PDU signal 'Impact_X_ST3'", `Network::dbNode::`BC_F::`BC_F_BODY1_GW_Container_ST3_Impact3_ST3::`Impact_X_ST3, __cArray);
        __ReportTableRow(0, __cArray, __cAOp, 0, "");
      }
      __ReportTableEndTestStep("1");
    }
    TestCommandEnd();

  }
  TestCompletionEnd();
}

