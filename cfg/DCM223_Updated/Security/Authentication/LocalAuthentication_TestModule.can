/*@!Encoding:1252*/

// Security Feature V2.10.6.0

/*
This test module realizes the local authentication.
to use this module the sysvar file Sysvar_Authentication_Testmodule.vsysvar
must be included in CANoe. 
It provides variables for DiagTarget, DiagnosticsRole and AuthResult.
*/

includes
{
  #include "LocalAuthentication_Helper.cin"
}

variables
{
  char cTestNodeName[40] = "Local Authentication Test Module";
  
 
  char AuthenticatedTargetList[200]; //buffer for panel output
  char NotAuthenticatedTargetList[200]; //buffer for panel output
  char AuthenticatedLabel[50];
  char NotAuthenticatedLabel[50];
  int IsFirstAuthenticatedTarget;
  int IsFirstNotAuthenticatedTarget;
  char messageBuf[400]; //buffer for panel output
  
  int AuthResultOverAll = 0; 
  
}

testcase LocalAuthentication()
{
  char targetName[400]; 
  int i;
  char ecuQual[100];

  AuthResultOverAll = 0;
  IsFirstAuthenticatedTarget = 1;
  IsFirstNotAuthenticatedTarget = 1;
  // prepare message buffer for panels
  sysSetVariableString("LocalAuthentication","AuthenticatedTargets"," ");
  strncat(AuthenticatedLabel,"Authenticated: " ,elcount(AuthenticatedTargetList));
  strncat(NotAuthenticatedLabel,"Not Authenticated: ",elcount(NotAuthenticatedTargetList));

  strncat(AuthenticatedTargetList, AuthenticatedLabel ,elcount(AuthenticatedTargetList));
  strncat(NotAuthenticatedTargetList, NotAuthenticatedLabel, elcount(NotAuthenticatedTargetList));
   
  // switch between Authentication modes
  if(@sysvar::LocalAuthentication::TargetMode == 1 ) // AuthForSingleTarget
  {
    TestStep("","Authentication for single target");
    sysGetVariableString("LocalAuthentication","DiagTarget",targetName,elCount(targetName));
    if( Authenticate(targetName,@sysvar::DAG_Diagnostics::DiagnosticsRole)==1) // successful
    {
      strncat(AuthenticatedTargetList,targetName,elcount(AuthenticatedTargetList));
    }
    else // not successful
    {
      strncat(NotAuthenticatedTargetList,ecuQual,elcount(NotAuthenticatedTargetList));
    }

    if(@sysvar::LocalAuthentication::CloseDiagChannelAfterAuth == 1)
    {
      CloseDiagChannel(targetName);
    }
  }
  else if(@sysvar::LocalAuthentication::TargetMode == 0 ) //AuthForAllTargets
  {
    TestStep("","Authentication for all targets");
    ReadDiagQualifier();
    testStepPass("","Available targets: %s",DiagTargetList);
    
    i = DiagTargetCount;
    while( i-- > 0) // for each target
    {
      diagGetTargetQualifier( i, ecuQual, elcount(ecuQual));
      if( strncmp("VSM",ecuQual,3) != 0 ) 
      { 
        if( Authenticate(ecuQual,@sysvar::DAG_Diagnostics::DiagnosticsRole)==1 ) // successful
        {    
          if (IsFirstAuthenticatedTarget == 0)
          {
            strncat(AuthenticatedTargetList,",",elcount(AuthenticatedTargetList));  
          }
          else
          {
            IsFirstAuthenticatedTarget = 0;
          }
          strncat(AuthenticatedTargetList,ecuQual,elcount(AuthenticatedTargetList));
        }
        else // not successful
        {
          if (IsFirstNotAuthenticatedTarget == 0)
          {
            strncat(NotAuthenticatedTargetList,",",elcount(NotAuthenticatedTargetList));  
          }
          else
          {
            IsFirstNotAuthenticatedTarget = 0;
          }
          strncat(NotAuthenticatedTargetList,ecuQual,elcount(NotAuthenticatedTargetList));
        }

        if(@sysvar::LocalAuthentication::CloseDiagChannelAfterAuth == 1)
        {
          CloseDiagChannel(ecuQual);
        }
      }
    }
  }
  
  if (strncmp(AuthenticatedTargetList, AuthenticatedLabel, elcount(AuthenticatedTargetList)) != 0)
  {
    strncat(messageBuf,AuthenticatedTargetList,elcount(messageBuf));
  }
  if (strncmp(NotAuthenticatedTargetList, NotAuthenticatedLabel, elcount(NotAuthenticatedTargetList)) != 0)
  {
    if (strncmp(AuthenticatedTargetList, AuthenticatedLabel, elcount(AuthenticatedTargetList)) != 0)
    {
      strncat(messageBuf," - ",elcount(messageBuf));
    }
    strncat(messageBuf,NotAuthenticatedTargetList,elcount(messageBuf));
  }
  sysSetVariableString("LocalAuthentication","AuthenticatedTargets",messageBuf);
  if(   strlen(NotAuthenticatedTargetList) > 20)
  {
    @sysvar::LocalAuthentication::AuthResult = 0;
  }
}

void CloseDiagChannel(char targetName[])
{
//  strncat(messageBuf," ",elcount(messageBuf));
//  strncat(messageBuf,"DiagChannel is closed",elcount(messageBuf));
//  strncat(messageBuf," ",elcount(messageBuf));
//  sysSetVariableString("LocalAuthentication","AuthenticatedTargets",messageBuf);
  diagCloseChannel(targetName); // Vector: Close the Diag Channel for the single DiagTarget SEC_MGR-1499
}

