/*@!Encoding:1252*/
includes
{
  
}
// ---------------------------------------------------
// node global variables.
// ---------------------------------------------------
variables
{
  const int gMTU = 1500;               // tcp mtu
  const int gSERVER_REPLY_WELCOME = 1; // server reply for welcome.
  const int gSERVER_REPLY_ANSWER = 2;  // server reply for answer.
  const dword gIPV4_STR_SIZE = 16;     // IPv4 string size
  const dword gINVALID_SOCKET = ~0;    // invalid socket constant
  dword gListenPort = 4242;           // port to send udp to.
  dword gListenSocket = gINVALID_SOCKET;       // server side: server listen socket
  dword gServerClientSocket = gINVALID_SOCKET; // server side: a client's socket
  char gServerTcpBuffer[gMTU];                 // tcp receive buffer of server
  int Cont = 0;
  
  timer DMRR_timer;
  timer DMRL_timer;
  timer DMFR_timer;
  timer DMFL_timer;
  
  dword Socket_nvm = 0;
  int ar[100];
  
  int DMRR_ACTIVE = 0;
  int DMRL_ACTIVE = 0;
  int DMFR_ACTIVE = 0;
  int DMFL_ACTIVE = 0;
  
  int TargetFL = 0;
  int TargetFR = 0;
  int TargetRL = 0;
  int TargetRR = 0;
  
  char totalVersions[50];
  
  //int Action_Type_DOWN = 0;
}

// ---------------------------------------------------
// Interaction: Server disconnects client...
// ---------------------------------------------------
on key 'x'
{
  serverDisconnectClient();
}

// ---------------------------------------------------
// on measurement start. (initialize and start demo)
// ---------------------------------------------------
on start
{
  serverStart();
  @DAG_Diagnostics::DiagnosticsRole = 3;
  @ModelGlobal::ISw_Stat = 4;
  @IL::Klemme15 = 1;
}

// ---------------------------------------------------
// before measurement stops.
// ---------------------------------------------------
on preStop
{
  // close server ( this implies closing all server and client sockets. )
  serverClose();
}

on message 0x18E13080x /*FL*/
   {
    //write(" byte 0%2X", this.byte(1));
    // Código que se ejecuta cuando se recibe un mensaje con ID 0x18E13080x
    if (this.byte(1)==0x7E)
    {
      TargetFL = 1;
      TargetFR = 0;
      TargetRL = 0;
      TargetRR = 0;
    }
   }
  
  on message 0x18E13280x /*FR*/
   {
    // Código que se ejecuta cuando se recibe un mensaje con ID 0x18E13280x
    if (this.byte(1)==0x7E)
    {
      TargetFL = 0;
      TargetFR = 1;
      TargetRL = 0;
      TargetRR = 0;
    }
   }
  
  
  on message 0x18E13480x /*RL*/
   {
    // Código que se ejecuta cuando se recibe un mensaje con ID 0x18E13480x
    if (this.byte(1)==0x7E)
    {
      TargetFL = 0;
      TargetFR = 0;
      TargetRL = 1;
      TargetRR = 0;
    }
   }
  
  on message 0x18E13680x /*RR*/
   {
    // Código que se ejecuta cuando se recibe un mensaje con ID 0x18E13680x
    if (this.byte(1)==0x7E)
    {
      TargetFL = 0;
      TargetFR = 0;
      TargetRL = 0;
      TargetRR = 1;
    }
   }

on timer DMRR_timer
{
  diagRequest DMRR_MMA.SoftwareVersion_Read DMRR_SW;
  diagRequest DMRR_MMA.HardwareVersion_Read DMRR_HW;
  diagRequest DMRR_MMA.ECUSerialNumberDataIdentifier_Read DMRR_SN;
  
  switch(Cont)
  {
    case 0: // SW
        DiagSendRequest(DMRR_SW);
        Cont++;
        setTimer(DMRR_timer,1);
      break;
    case 1: // HW
        DiagSendRequest(DMRR_HW);
        Cont++;
        setTimer(DMRR_timer,1);
      break;
    case 2: // SN
        DiagSendRequest(DMRR_SN);
        Cont++;
        setTimer(DMRR_timer,1);
      break;
    case 3: // Fin
        Cont = 0;
        cancelTimer(DMRR_timer);
      break;
    default:
      break;
  }
}

on timer DMRL_timer
{
  diagRequest DMRL_MMA.SoftwareVersion_Read DMRL_SW;
  diagRequest DMRL_MMA.HardwareVersion_Read DMRL_HW;
  diagRequest DMRL_MMA.ECUSerialNumberDataIdentifier_Read DMRL_SN;
  
  switch(Cont)
  {
    case 0: // SW
        DiagSendRequest(DMRL_SW);
        Cont++;
        setTimer(DMRL_timer,1);
      break;
    case 1: // HW
        DiagSendRequest(DMRL_HW);
        Cont++;
        setTimer(DMRL_timer,1);
      break;
    case 2: // SN
        DiagSendRequest(DMRL_SN);
        Cont++;
        setTimer(DMRL_timer,1);
      break;
    case 3: // Fin
        Cont = 0;
        cancelTimer(DMRL_timer);
      break;
    default:
      break;
  }
}

on timer DMFR_timer
{
  diagRequest DMFR_MMA.SoftwareVersion_Read DMFR_SW;
  diagRequest DMFR_MMA.HardwareVersion_Read DMFR_HW;
  diagRequest DMFR_MMA.ECUSerialNumberDataIdentifier_Read DMFR_SN;
  
  switch(Cont)
  {
    case 0: // SW
        DiagSendRequest(DMFR_SW);
        Cont++;
        setTimer(DMFR_timer,1);
      break;
    case 1: // HW
        DiagSendRequest(DMFR_HW);
        Cont++;
        setTimer(DMFR_timer,1);
      break;
    case 2: // SN
        DiagSendRequest(DMFR_SN);
        Cont++;
        setTimer(DMFR_timer,1);
      break;
    case 3: // Fin
        Cont = 0;
        cancelTimer(DMFR_timer);
      break;
    default:
      break;
  }
}

on timer DMFL_timer
{
  diagRequest DMFL_MMA.SoftwareVersion_Read DMFL_SW;
  diagRequest DMFL_MMA.HardwareVersion_Read DMFL_HW;
  diagRequest DMFL_MMA.ECUSerialNumberDataIdentifier_Read DMFL_SN;
  
  switch(Cont)
  {
    case 0: // SW
        DiagSendRequest(DMFL_SW);
        Cont++;
        setTimer(DMFL_timer,1);
      break;
    case 1: // HW
        DiagSendRequest(DMFL_HW);
        Cont++;
        setTimer(DMFL_timer,1);
      break;
    case 2: // SN
        DiagSendRequest(DMFL_SN);
        Cont++;
        setTimer(DMFL_timer,1);
      break;
    case 3: // Fin
        Cont = 0;
        cancelTimer(DMFL_timer);
      break;
    default:
      break;
  }
}

on sysvar MMA::DMFL
{
  if (@MMA::DMFL==1)
  {
    @MMA::DMFR = 0;
    @MMA::DMRL = 0;
    @MMA::DMRR = 0;
    sysSetVariableString("LocalAuthentication", "DiagTarget", "DMFL_MMA") ;
  }
}

on sysvar MMA::DMFR
{
  if (@MMA::DMFR==1)
  {
    @MMA::DMFL = 0;
    @MMA::DMRL = 0;
    @MMA::DMRR = 0;
    sysSetVariableString("LocalAuthentication", "DiagTarget", "DMFR_MMA") ;
  }
}
on sysvar MMA::DMRL
{
  if (@MMA::DMRL==1)
  {
    @MMA::DMFR = 0;
    @MMA::DMFL = 0;
    @MMA::DMRR = 0;
    sysSetVariableString("LocalAuthentication", "DiagTarget", "DMRL_MMA") ;
  }
}
on sysvar MMA::DMRR
{
  if (@MMA::DMRR==1)
  {
    @MMA::DMFR = 0;
    @MMA::DMRL = 0;
    @MMA::DMFL = 0;
    sysSetVariableString("LocalAuthentication", "DiagTarget", "DMRR_MMA") ;
  }
}

on sysvar ACCTIONS::DOWN
{

    if (@ACCTIONS::DOWN == 1)
  {
    //Action_Type_DOWN = 1;
      if (@MMA::DMFL==1)
    {
      diagRequest DMFL_MMA.PWC_WindowLift_Start req;
      req.SetParameter("WinLift_Rq", 1);
      DiagSendRequest(req);
      //sendTcpData (Socket_nvm, "Action_type_DOWN_DMFL OK");
      //write("Action_type_DOWN_DMFL OK");
    }
    if (@MMA::DMFR==1)
    {
      diagRequest DMFR_MMA.PWC_WindowLift_Start req;
      req.SetParameter("WinLift_Rq", 1);
      DiagSendRequest(req);
//      sendTcpData (Socket_nvm, "Action_type_DOWN_DMFR OK");
//      write("Action_type_DOWN_DMFR OK");
    }
    if (@MMA::DMRL==1)
    {
      diagRequest DMRL_MMA.PWC_WindowLift_Start req;
      req.SetParameter("WinLift_Rq", 1);
      DiagSendRequest(req);
//      sendTcpData (Socket_nvm, "Action_type_DOWN_DMRL OK");
//      write("Action_type_DOWN_DMRL OK");
    }
    if (@MMA::DMRR==1)
    {
      diagRequest DMRR_MMA.PWC_WindowLift_Start req;
      req.SetParameter("WinLift_Rq", 1);
      DiagSendRequest(req);
//      sendTcpData (Socket_nvm, "Action_type_DOWN_DMRR OK");
//      write("Action_type_DOWN_DMRR OK");
    }
  }
}

on sysvar ACCTIONS::UP
{
    if (@ACCTIONS::UP == 1)
  {
      if (@MMA::DMFL==1)
    {
      diagRequest DMFL_MMA.PWC_WindowLift_Start req;
      req.SetParameter("WinLift_Rq", 2);
      DiagSendRequest(req);
//      sendTcpData (Socket_nvm, "Action_type_UP_DMFL OK");
//      write("Action_type_UP_DMFL OK");
    }
    if (@MMA::DMFR==1)
    {
      diagRequest DMFR_MMA.PWC_WindowLift_Start req;
      req.SetParameter("WinLift_Rq", 2);
      DiagSendRequest(req);
//      sendTcpData (Socket_nvm, "Action_type_UP_DMFR OK");
//      write("Action_type_UP_DMFR OK");
    }
    if (@MMA::DMRL==1)
    {
      diagRequest DMRL_MMA.PWC_WindowLift_Start req;
      req.SetParameter("WinLift_Rq", 2);
      DiagSendRequest(req);
//      sendTcpData (Socket_nvm, "Action_type_UP_DMRL OK");
//      write("Action_type_UP_DMRL OK");
    }
    if (@MMA::DMRR==1)
    {
      diagRequest DMRR_MMA.PWC_WindowLift_Start req;
      req.SetParameter("WinLift_Rq", 2);
      DiagSendRequest(req );
//      sendTcpData (Socket_nvm, "Action_type_UP_DMRR OK");
//      write("Action_type_UP_DMRR OK");
    }
  }
}
on sysvar ACCTIONS::STOP
{
  if (@ACCTIONS::STOP == 1)
  {
  if (@MMA::DMFL==1)
    {
      diagRequest DMFL_MMA.PWC_WindowLift_Stop req;
      DiagSendRequest(req);
//      sendTcpData (Socket_nvm, "Action_type_STOP_DMFL OK");
//      write("Action_type_STOP_DMFL OK");
    }
    if (@MMA::DMFR==1)
    {
      diagRequest DMFR_MMA.PWC_WindowLift_Stop req;
      DiagSendRequest(req);
//      sendTcpData (Socket_nvm, "Action_type_STOP_DMFR OK");
//      write("Action_type_STOP_DMFR OK");
    }
    if (@MMA::DMRL==1)
    {
      diagRequest DMRL_MMA.PWC_WindowLift_Stop req;
      DiagSendRequest(req);
//      sendTcpData (Socket_nvm, "Action_type_STOP_DMRL OK");
//      write("Action_type_STOP_DMRL OK");
    }
    if (@MMA::DMRR==1)
    {
      diagRequest DMRR_MMA.PWC_WindowLift_Stop req;
      DiagSendRequest(req);
//      sendTcpData (Socket_nvm, "Action_type_STOP_DMRR OK");
//      write("Action_type_STOP_DMRR OK");
    }
  }
}

on sysvar ACCTIONS::Auto
{
  if (@ACCTIONS::Auto ==1)
  {
    if (TargetFL==1)
        {
          @LocalAuthentication::Button_Authenticate = 1;
          DMRR_ACTIVE = 0;
          DMRL_ACTIVE = 0;
          DMFR_ACTIVE = 0;
          DMFL_ACTIVE = 1;
          Cont = 0;
          setTimer(DMFL_timer,3);
        }
  }
}

on sysvar ACCTIONS::SW_version
{
  if (@ACCTIONS::SW_version== 1)
  {
  if (@MMA::DMFL==1)
    {
      diagRequest DMFL_MMA.SoftwareVersion_Read req;
      DiagSendRequest(req);
    }
    if (@MMA::DMFR==1)
    {
      diagRequest DMFR_MMA.SoftwareVersion_Read req;
      DiagSendRequest(req);
    }
    if (@MMA::DMRL==1)
    {
      diagRequest DMRL_MMA.SoftwareVersion_Read req;
      DiagSendRequest(req);
    }
    if (@MMA::DMRR==1)
    {
      diagRequest DMRR_MMA.SoftwareVersion_Read req;
      DiagSendRequest(req);
    }
  }
}

on sysvar ACCTIONS::HW_version
{
  if (@ACCTIONS::HW_version== 1)
  {
  if (@MMA::DMFL==1)
    {
      diagRequest DMFL_MMA.HardwareVersion_Read req;
      DiagSendRequest(req);
    }
    if (@MMA::DMFR==1)
    {
      diagRequest DMFR_MMA.HardwareVersion_Read req;
      DiagSendRequest(req);
    }
    if (@MMA::DMRL==1)
    {
      diagRequest DMRL_MMA.HardwareVersion_Read req;
      DiagSendRequest(req);
    }
    if (@MMA::DMRR==1)
    {
      diagRequest DMRR_MMA.HardwareVersion_Read req;
      DiagSendRequest(req);
    }
  }
}

on sysvar ACCTIONS::SN_version
{
  if (@ACCTIONS::SN_version== 1)
  {
  if (@MMA::DMFL==1)
    {
      diagRequest DMFL_MMA.ECUSerialNumberDataIdentifier_Read req;
      DiagSendRequest(req);
    }
    if (@MMA::DMFR==1)
    {
      diagRequest DMFR_MMA.ECUSerialNumberDataIdentifier_Read req;
      DiagSendRequest(req);
    }
    if (@MMA::DMRL==1)
    {
      diagRequest DMRL_MMA.ECUSerialNumberDataIdentifier_Read req;
      DiagSendRequest(req);
    }
    if (@MMA::DMRR==1)
    {
      diagRequest DMRR_MMA.ECUSerialNumberDataIdentifier_Read req;
      DiagSendRequest(req);
    }
  }
}

on sysvar ACCTIONS::LOOK
{
    if (@ACCTIONS::LOOK == 1)
  {
      if (@MMA::DMFL==1)
    {
      diagRequest DMFL_MMA.DLK_IOControl_Control req;
      req.SetParameter("DiagRq_DLK_Thatcham_Lk_Unlk", 1);
      req.SetParameter("DiagRqData_DLK_Lk_Unlk", 1);
      req.SetParameter("EM_DiagRq_DLK_Thatcham_Lk_Unlk", 1);
      req.SetParameter("EM_DiagRqData_DLK_Lk_Unlk", 1);
      DiagSendRequest(req);
//      sendTcpData (Socket_nvm, "DLK_IOControl LOCK_DMFL_MMA OK");
      write("DLK_IOControl LOCK_DMFL OK");
    }
    else if (@MMA::DMFR==1)
    {
      diagRequest DMFR_MMA.DLK_IOControl_Control req;
      req.SetParameter("DiagRq_DLK_Thatcham_Lk_Unlk", 1);
      req.SetParameter("DiagRqData_DLK_Lk_Unlk", 1);
      req.SetParameter("EM_DiagRq_DLK_Thatcham_Lk_Unlk", 1);
      req.SetParameter("EM_DiagRqData_DLK_Lk_Unlk", 1);
      DiagSendRequest(req);
//      sendTcpData (Socket_nvm, "DLK_IOControl LOCK_DMFR_MMA OK");
      write("DLK_IOControl LOCK_DMFR OK");
    }
    else if (@MMA::DMRL==1)
    {
      diagRequest DMRL_MMA.DLK_IOControl_Control req;
      req.SetParameter("DiagRq_DLK_Thatcham_Lk_Unlk", 1);
      req.SetParameter("DiagRqData_DLK_Lk_Unlk", 1);
      req.SetParameter("EM_DiagRq_DLK_Thatcham_Lk_Unlk", 1);
      req.SetParameter("EM_DiagRqData_DLK_Lk_Unlk", 1);
      DiagSendRequest(req);
//      sendTcpData (Socket_nvm, "DLK_IOControl LOCK_DMRL_MMA OK");
      write("DLK_IOControl LOCK_DMRL OK");
    }
    else if (@MMA::DMRR==1)
    {
      diagRequest DMRR_MMA.DLK_IOControl_Control req;
      req.SetParameter("DiagRq_DLK_Thatcham_Lk_Unlk", 1);
      req.SetParameter("DiagRqData_DLK_Lk_Unlk", 1);
      req.SetParameter("EM_DiagRq_DLK_Thatcham_Lk_Unlk", 1);
      req.SetParameter("EM_DiagRqData_DLK_Lk_Unlk", 1);
      DiagSendRequest(req);
//      sendTcpData (Socket_nvm, "DLK_IOControl LOCK_DMRR_MMA OK");
      write("DLK_IOControl LOCK_DMRR OK");

    }
       else
    {
//      sendTcpData(Socket_nvm, "Set_target ERROR Target not conected");
      write("DLK_IOControl LOCK NOK");
    }
  }
}

on sysvar ACCTIONS::UNLOOK
{
    if (@ACCTIONS::UNLOOK == 1)
  {
      if (@MMA::DMFL==1)
    {
      diagRequest DMFL_MMA.DLK_IOControl_Control req;
      req.SetParameter("DiagRq_DLK_Thatcham_Lk_Unlk", 2);
      req.SetParameter("DiagRqData_DLK_Lk_Unlk", 2);
      req.SetParameter("EM_DiagRq_DLK_Thatcham_Lk_Unlk", 1);
      req.SetParameter("EM_DiagRqData_DLK_Lk_Unlk", 1);
      DiagSendRequest(req);
//      sendTcpData (Socket_nvm, "DLK_IOControl UNLOCK_DMFL_MMA OK");
      write("DLK_IOControl UNLOCK_DMFL OK");
    }
    else if (@MMA::DMFR==1)
    {
      diagRequest DMFR_MMA.DLK_IOControl_Control req;
      req.SetParameter("DiagRq_DLK_Thatcham_Lk_Unlk", 2);
      req.SetParameter("DiagRqData_DLK_Lk_Unlk", 2);
      req.SetParameter("EM_DiagRq_DLK_Thatcham_Lk_Unlk", 1);
      req.SetParameter("EM_DiagRqData_DLK_Lk_Unlk", 1);
      DiagSendRequest(req);
//      sendTcpData (Socket_nvm, "DLK_IOControl UNLOCK_DMFR_MMA OK");
      write("DLK_IOControl UNLOCK_DMFR OK");
    }
    else if (@MMA::DMRL==1)
    {
      diagRequest DMRL_MMA.DLK_IOControl_Control req;
      req.SetParameter("DiagRq_DLK_Thatcham_Lk_Unlk", 2);
      req.SetParameter("DiagRqData_DLK_Lk_Unlk", 2);
      req.SetParameter("EM_DiagRq_DLK_Thatcham_Lk_Unlk", 1);
      req.SetParameter("EM_DiagRqData_DLK_Lk_Unlk", 1);
      DiagSendRequest(req);
//      sendTcpData (Socket_nvm, "DLK_IOControl UNLOCK_DMRL_MMA OK");
      write("DLK_IOControl UNLOCK_DMRL OK");
    }
    else if (@MMA::DMRR==1)
    {
      diagRequest DMRR_MMA.DLK_IOControl_Control req;
      req.SetParameter("DiagRq_DLK_Thatcham_Lk_Unlk", 2);
      req.SetParameter("DiagRqData_DLK_Lk_Unlk", 2);
      req.SetParameter("EM_DiagRq_DLK_Thatcham_Lk_Unlk", 1);
      req.SetParameter("EM_DiagRqData_DLK_Lk_Unlk", 1);
      DiagSendRequest(req);
//      sendTcpData (Socket_nvm, "DLK_IOControl UNLOCK_DMRR_MMA OK");
      write("DLK_IOControl UNLOCK_DMRR OK");
    }
       else
    {
//      sendTcpData(Socket_nvm, "Set_target ERROR Target not conected");
      write("DLK_IOControl UNLOCK NOK");
    }
  }
}

// ---------------------------------------------------
// Callback when client connects to server's listen socket.
// ---------------------------------------------------
void OnTcpListen( dword socket, long result)
{
  dword errCode;
  writeLineEx(1, 1, " [ S: OnTcpListen called. (result: %d)]", result);
  if (gServerClientSocket != gINVALID_SOCKET)
  {
    writeLineEx(1, 2, "S: A client is already connected. Not accepting.");
    return;
  }
  if (result == 0)
  {
    if (socket == gListenSocket)
    {
      write("S: Incoming client.", socket);
      gServerClientSocket = TcpAccept( gListenSocket );
      if (gServerClientSocket == gINVALID_SOCKET)
      {
        errCode = IpGetLastSocketError(gListenSocket);
        if (errCode == 87)
        {
          writeLineEx( 1, 3, "S: TcpAccept: Invalid listen socket given.");
          // handle error...
        }
        else
        {
          writeLineEx( 1, 3, "S: TcpAccept: Socket error: %d", IpGetLastSocketError(gListenSocket) );
          // handle error...
        }
      }
      else
      {
        write("S: Accepted client on socket %d to socket %d.", gListenSocket, gServerClientSocket);
        cancelTimer(DMRR_timer);
        cancelTimer(DMRL_timer);
        cancelTimer(DMFL_timer);
        cancelTimer(DMFR_timer);
        totalVersions[0] = '\0';
        TargetFL = 0;
        TargetFR = 0;
        TargetRL = 0;
        TargetRR = 0;
        // start to receive data on the server's client socket...
        startReceive(gServerClientSocket, gServerTcpBuffer);
        // do more stuff on server to initialize the incoming accepted client...
        // welcome client.
        serverSend(gSERVER_REPLY_WELCOME, gServerClientSocket);
      }
    }
    else
    {
      writeLineEx( 1, 3, "S: OnTcpListen: Unexpected connection on socket %d. (result:%d)", socket, result);
      // handle error...
    }
  }
}

// ---------------------------------------------------
// When asynchronous TcpSend completes...
// ---------------------------------------------------
void OnTcpSend( dword socket, long result, char buffer[], dword size)
{
  writeLineEx(1, 1, " [ S: OnTcpSend called. (result: %d)]", result);
  if (result == 0)
  {
    if (socket != gINVALID_SOCKET)
    {
      if (socket == gServerClientSocket)
      {
        write("S: Server sent %d bytes to client done. (socket %d, result: %d)", size, socket, result);
        Socket_nvm = socket;
      }
    }
  }
}

// ---------------------------------------------------
// When receiving data on socket...
// ---------------------------------------------------
void OnTcpReceive( dword socket, long result, dword address, dword port, char buffer[], dword size)
{
  writeLineEx(1, 1, " [ S: OnTcpReceive called. (result: %d)]", result);
  if (result == 0)
  {
    if (socket == gServerClientSocket)
    {
      // server receives from client...
      write("S: Server received %d bytes from client: %s (result: %d)", size, buffer, result);
      DiagFuntionality(buffer);
      // check client's request...
      if (strstr(buffer, "REQUEST") >= 0)
      {
        write("S: Client request OK, sending answer.");
        serverSend(gSERVER_REPLY_ANSWER, gServerClientSocket); // answer
      }
      // continue receiving data.
      startReceive(gServerClientSocket, gServerTcpBuffer);
    }
    else if (socket != gINVALID_SOCKET)
    {
      writeLineEx(1, 3, " [ S: UNIMPLEMENTED: Received %d bytes on socket %d from 0x%x:%d with data: %s (result: %d) ]", size, socket, address, port, buffer, result);
    }
  }
}

// ---------------------------------------------------
// TCP socket receives a close notification
// (remote closed)
// ---------------------------------------------------
void OnTcpClose( dword socket, long result)
{
  if (socket == gServerClientSocket)
  {
    TcpClose(gServerClientSocket);
    gServerClientSocket = gINVALID_SOCKET;
    writeLineEx(1, 1, " [ S: OnTcpClose called. (socket: %d, result: %d) ]", socket, result);
  }
}

// ---------------------------------------------------
// server disconnects client
// ---------------------------------------------------
void serverDisconnectClient()
{
  if (gServerClientSocket != gINVALID_SOCKET)
  {
    write("S: Server disconnects client. (socket %d)", gServerClientSocket);
    TcpClose(gServerClientSocket);
    gServerClientSocket = gINVALID_SOCKET;
  }
}

// ---------------------------------------------------
// start receiving on given socket into given buffer.
// ---------------------------------------------------
void startReceive ( dword socket, char buffer[] )
{
  long result;
  result = TcpReceive( socket, buffer, elcount(buffer) );
  if (result == -1)
  {
    result = IpGetLastSocketError(socket);
    if (result != 997) // not asynchronous
    {
      // failure
      writeLineEx( 1, 3, "S: TcpReceive error %d", result);
    }
  }
  else if (result != 0) // synchronous sending failed
  {
    // failure
    writeLineEx( 1, 3, "S: TcpReceive error %d", result);
  }
}

// ---------------------------------------------------
// start server
// ---------------------------------------------------
void serverStart()
{
  writeLineEx(1, 1, " [ S: Open TCP server socket at port %d... ]", gListenPort);
  gListenSocket = TcpOpen(0, gListenPort);
  if (gListenSocket == gINVALID_SOCKET)
  {
    writeLineEx( 1, 3, " [ S: TcpOpen: Error opening TCP Socket on port %d. (Error %d) ]", gListenPort, IpGetLastError() );
    // handle error...
  }
  else
  {
    if (TcpListen( gListenSocket ) != 0)
    {
      writeLineEx(1, 3, " [ S: TcpListen: Error listening on socket. ]");
      TcpClose(gListenSocket);
      gListenSocket = gINVALID_SOCKET;
      // handle error...
    }
    else
    {
      writeLineEx(1, 1, " [ S: Start listening on server socket %d... ]", gListenSocket);
    }
  }
}

// ---------------------------------------------------
// close server
// ---------------------------------------------------
void serverClose()
{
  if (gListenSocket != gINVALID_SOCKET)
  {
    writeLineEx(1, 1, " [ Server shutdown. ]");
    serverDisconnectClient();
    TcpClose(gListenSocket);
    gListenSocket = gINVALID_SOCKET;
  }
}

// ---------------------------------------------------
// server sends data to client
// ---------------------------------------------------
void serverSend(int replyNr, dword socket)
{
  if (socket != gINVALID_SOCKET)
  {
    writeLineEx(1, 1, "S: Sending data to client. (socket %d)", socket);
    switch(replyNr)
    {
      case gSERVER_REPLY_WELCOME:
      {
        //sendTcpData( socket, " Server data: WELCOME.");
        break;
      }
      case gSERVER_REPLY_ANSWER:
      {
        //sendTcpData(socket, "Server data: ANSWER.");
        break;
      }
      default:
      {
        writeLineEx(1, 3, " [ serverSend: UNSUPPORTED REPLY NR %d ]", replyNr);
        break;
      }
    }
  }
}

// ---------------------------------------------------
// send tcp data.
// ---------------------------------------------------
void sendTcpData( dword socket, char data[] )
{
  long result;
  dword size;
  size = elcount(data);
  result = TcpSend(socket, data, size);
  if (result == 0)
  {
    // sending took place immediately.
//    write("Socket = %d", socket);
    writeLineEx(1, 1, " [ S: Synchronous sending: '%s' on socket %d ]", data, socket);
    OnTcpSend(socket, result, data, size); // trigger callback manually
  }
  else
  {
    if (result == -1)
    {
      result = IpGetLastSocketError(socket);
      if (result == 997)
      {
        // sending is done asynchronously.
        writeLineEx(1, 1, " [ S: Asynchronous sending: '%s' on socket %d ]", data, socket);
        // => OnTcpSend is called when done sending.
      }
      else
      {
        writeLineEx( 1, 3, " [ S: sendTcpData: Error sending data. (%d) ]", result);
        cancelTimer(DMRR_timer);
        cancelTimer(DMRL_timer);
        cancelTimer(DMFL_timer);
        cancelTimer(DMFR_timer);
        totalVersions[0] = '\0';
        TargetFL = 0;
        TargetFR = 0;
        TargetRL = 0;
        TargetRR = 0;
      }
    }
    else
    {
      writeLineEx( 1, 3, " [ S: sendTcpData: Error sending data. (%d) ]", result);
      cancelTimer(DMRR_timer);
      cancelTimer(DMRL_timer);
      cancelTimer(DMFL_timer);
      cancelTimer(DMFR_timer);
      totalVersions[0] = '\0';
      TargetFL = 0;
      TargetFR = 0;
      TargetRL = 0;
      TargetRR = 0;
    }
  }
}

void DiagFuntionality (char data[])
{
  if ((strncmp(data,"Read_info DMFL_MMA", strlen(data)) == 0)||(strncmp(data,"Read_info DMFR_MMA", strlen(data)) == 0)||(strncmp(data,"Read_info DMRL_MMA", strlen(data)) == 0)||(strncmp(data,"Read_info DMRR_MMA", strlen(data)) == 0))
    {     
      if ((strncmp(data,"Read_info DMRR_MMA", strlen(data)) == 0))/*el target y el seleccionado son iguales¿?*/
      {
        if (TargetRR==1)
        {
          @LocalAuthentication::Button_Authenticate = 1;
          DMRR_ACTIVE = 1;
          DMRL_ACTIVE = 0;
          DMFR_ACTIVE = 0;
          DMFL_ACTIVE = 0;
          Cont = 0;
          setTimer(DMRR_timer,3);
        }
        else 
        {
          sendTcpData(Socket_nvm, "Set_target ERROR Target not conected");
        }
      }
      if (strncmp(data,"Read_info DMFR_MMA", strlen(data)) == 0)
      {
        if (TargetFR==1)
        {
          @LocalAuthentication::Button_Authenticate = 1;
          DMRR_ACTIVE = 0;
          DMRL_ACTIVE = 0;
          DMFR_ACTIVE = 1;
          DMFL_ACTIVE = 0;
          Cont = 0;
          setTimer(DMFR_timer,3);
          }
        else 
        {
          sendTcpData(Socket_nvm, "Set_target ERROR Target not conected");
        }
      }
      if (strncmp(data,"Read_info DMRL_MMA", strlen(data)) == 0)
      {
        if (TargetRL==1)
        {
          @LocalAuthentication::Button_Authenticate = 1;
          DMRR_ACTIVE = 0;
          DMRL_ACTIVE = 1;
          DMFR_ACTIVE = 0;
          DMFL_ACTIVE = 0;
          Cont = 0;
          setTimer(DMRL_timer,3);
        }
        else 
        {
          sendTcpData(Socket_nvm, "Set_target ERROR Target not conected");
        }
      }
      if (strncmp(data,"Read_info DMFL_MMA", strlen(data)) == 0)
      {
        if (TargetFL==1)
        {
          @LocalAuthentication::Button_Authenticate = 1;
          DMRR_ACTIVE = 0;
          DMRL_ACTIVE = 0;
          DMFR_ACTIVE = 0;
          DMFL_ACTIVE = 1;
          Cont = 0;
          setTimer(DMFL_timer,3);
        }
        else 
        {
          sendTcpData(Socket_nvm, "Set_target ERROR Target not conected");
        }
      }
   } 
    
  if (strncmp(data,"Window_control DOWN", strlen(data)) == 0) 
    {
      if (DMFL_ACTIVE == 1)
      {
      diagRequest DMFL_MMA.PWC_WindowLift_Start req;
      req.SetParameter("WinLift_Rq", 1);
      DiagSendRequest(req);
      sendTcpData (Socket_nvm, "Action_type DOWN DMFL_MMA OK");
      write("Action_type_DOWN_DMFL OK");
      }
      else if (DMFR_ACTIVE == 1)
      {
        diagRequest DMFR_MMA.PWC_WindowLift_Start req;
        req.SetParameter("WinLift_Rq", 1);
        DiagSendRequest(req);
        sendTcpData (Socket_nvm, "Action_type DOWN DMFR_MMA OK");
        write("Action_type_DOWN_DMFR OK");
      }
      else if (DMRL_ACTIVE == 1)
      {
        diagRequest DMRL_MMA.PWC_WindowLift_Start req;
        req.SetParameter("WinLift_Rq", 1);
        DiagSendRequest(req);
        sendTcpData (Socket_nvm, "Action_type DOWN DMRL_MMA OK");
        write("Action_type_DOWN_DMRL OK");
      }
      else if (DMRR_ACTIVE == 1)
      {
      diagRequest DMRR_MMA.PWC_WindowLift_Start req;
      req.SetParameter("WinLift_Rq", 1);
      DiagSendRequest(req);
      sendTcpData (Socket_nvm, "Action_type DOWN DMRR_MMA OK");
      write("Action_type_DOWN_DMRR OK");
     }
      else
      {
        sendTcpData(Socket_nvm, "Set_target ERROR Target not conected");
      }
  }
  if (strncmp(data,"Window_control UP", strlen(data)) == 0) 
  {
      if (DMFL_ACTIVE == 1)
    {
      diagRequest DMFL_MMA.PWC_WindowLift_Start req;
      req.SetParameter("WinLift_Rq", 2);
      DiagSendRequest(req);
      sendTcpData (Socket_nvm, "Action_type UP DMFL_MMA OK");
      write("Action_type_UP_DMFL OK");
    }
    else if (DMFR_ACTIVE == 1)
    {
      diagRequest DMFR_MMA.PWC_WindowLift_Start req;
      req.SetParameter("WinLift_Rq", 2);
      DiagSendRequest(req);
      sendTcpData (Socket_nvm, "Action_type UP DMFR_MMA OK");
      write("Action_type_UP_DMFR OK");
    }
    else if (DMRL_ACTIVE == 1)
    {
      diagRequest DMRL_MMA.PWC_WindowLift_Start req;
      req.SetParameter("WinLift_Rq", 2);
      DiagSendRequest(req);
      sendTcpData (Socket_nvm, "Action_type UP DMRL_MMA OK");
      write("Action_type_UP_DMRL OK");
    }
    else if (DMRR_ACTIVE == 1)
    {
      diagRequest DMRR_MMA.PWC_WindowLift_Start req;
      req.SetParameter("WinLift_Rq", 2);
      DiagSendRequest(req );
      sendTcpData (Socket_nvm, "Action_type UP DMRR_MMA OK");
      write("Action_type_UP_DMRR OK");
    }
    else
    {
      sendTcpData(Socket_nvm, "Set_target ERROR Target not conected");
    }
  }
    if (strncmp(data,"Window_control STOP", strlen(data)) == 0) 
  {
      if (DMFL_ACTIVE == 1)
    {
      diagRequest DMFL_MMA.PWC_WindowLift_Stop req;
      DiagSendRequest(req);
      sendTcpData (Socket_nvm, "Action_type STOP DMFL_MMA OK");
      write("Action_type_STOP_DMFL OK");
    }
    else if (DMFR_ACTIVE == 1)
    {
      diagRequest DMFR_MMA.PWC_WindowLift_Stop req;
      DiagSendRequest(req);
      sendTcpData (Socket_nvm, "Action_type STOP DMFR_MMA OK");
      write("Action_type_STOP_DMFR OK");
    }
    else if (DMRL_ACTIVE == 1)
    {
      diagRequest DMRL_MMA.PWC_WindowLift_Stop req;
      DiagSendRequest(req);
      sendTcpData (Socket_nvm, "Action_type STOP DMRL_MMA OK");
      write("Action_type_STOP_DMRL OK");
    }
    else if (DMRR_ACTIVE == 1)
    {
      diagRequest DMRR_MMA.PWC_WindowLift_Start req;
      DiagSendRequest(req );
      sendTcpData (Socket_nvm, "Action_type STOP DMRR_MMA OK");
      write("Action_type_STOP_DMRR OK");
    }
    else
    {
      sendTcpData(Socket_nvm, "Set_target ERROR Target not conected");
    }
  }
  if (strncmp(data,"DLK_IOControl LOCK", strlen(data)) == 0)
  {
    if (DMFL_ACTIVE == 1)
    {
      diagRequest DMFL_MMA.DLK_IOControl_Control req;
      req.SetParameter("DiagRq_DLK_Thatcham_Lk_Unlk", 1);
      req.SetParameter("DiagRqData_DLK_Lk_Unlk", 1);
      req.SetParameter("EM_DiagRq_DLK_Thatcham_Lk_Unlk", 1);
      req.SetParameter("EM_DiagRqData_DLK_Lk_Unlk", 1);
      DiagSendRequest(req);
      sendTcpData (Socket_nvm, "DLK_IOControl LOCK DMFL_MMA OK");
      write("DLK_IOControl LOCK_DMFL OK");
    }
    else if (DMFR_ACTIVE == 1)
    {
      diagRequest DMFR_MMA.DLK_IOControl_Control req;
      req.SetParameter("DiagRq_DLK_Thatcham_Lk_Unlk", 1);
      req.SetParameter("DiagRqData_DLK_Lk_Unlk", 1);
      req.SetParameter("EM_DiagRq_DLK_Thatcham_Lk_Unlk", 1);
      req.SetParameter("EM_DiagRqData_DLK_Lk_Unlk", 1);
      DiagSendRequest(req);
      sendTcpData (Socket_nvm, "DLK_IOControl LOCK DMFR_MMA OK");
      write("DLK_IOControl LOCK_DMFR OK");
    }
    else if (DMRL_ACTIVE == 1)
    {
      diagRequest DMRL_MMA.DLK_IOControl_Control req;
      req.SetParameter("DiagRq_DLK_Thatcham_Lk_Unlk", 1);
      req.SetParameter("DiagRqData_DLK_Lk_Unlk", 1);
      req.SetParameter("EM_DiagRq_DLK_Thatcham_Lk_Unlk", 1);
      req.SetParameter("EM_DiagRqData_DLK_Lk_Unlk", 1);
      DiagSendRequest(req);
      sendTcpData (Socket_nvm, "DLK_IOControl LOCK DMRL_MMA OK");
      write("DLK_IOControl LOCK_DMRL OK");
    }
    else if (DMRR_ACTIVE == 1)
    {
      diagRequest DMRR_MMA.DLK_IOControl_Control req;
      req.SetParameter("DiagRq_DLK_Thatcham_Lk_Unlk", 1);
      req.SetParameter("DiagRqData_DLK_Lk_Unlk", 1);
      req.SetParameter("EM_DiagRq_DLK_Thatcham_Lk_Unlk", 1);
      req.SetParameter("EM_DiagRqData_DLK_Lk_Unlk", 1);
      DiagSendRequest(req);
      sendTcpData (Socket_nvm, "DLK_IOControl LOCK DMRR_MMA OK");
      write("DLK_IOControl LOCK_DMRR OK");

    }
       else
    {
      sendTcpData(Socket_nvm, "Set_target ERROR Target not conected");
    }
  }
  
  if (strncmp(data,"DLK_IOControl UNLOCK", strlen(data)) == 0)
  {
    if (DMFL_ACTIVE == 1)
    {
      diagRequest DMFL_MMA.DLK_IOControl_Control req;
      req.SetParameter("DiagRq_DLK_Thatcham_Lk_Unlk", 2);
      req.SetParameter("DiagRqData_DLK_Lk_Unlk", 2);
      req.SetParameter("EM_DiagRq_DLK_Thatcham_Lk_Unlk", 1);
      req.SetParameter("EM_DiagRqData_DLK_Lk_Unlk", 1);
      DiagSendRequest(req);
      sendTcpData (Socket_nvm, "DLK_IOControl UNLOCK DMFL_MMA OK");
      write("DLK_IOControl UNLOCK_DMFL OK");
    }
    else if (DMFR_ACTIVE == 1)
    {
      diagRequest DMFR_MMA.DLK_IOControl_Control req;
      req.SetParameter("DiagRq_DLK_Thatcham_Lk_Unlk", 2);
      req.SetParameter("DiagRqData_DLK_Lk_Unlk", 2);
      req.SetParameter("EM_DiagRq_DLK_Thatcham_Lk_Unlk", 1);
      req.SetParameter("EM_DiagRqData_DLK_Lk_Unlk", 1);
      DiagSendRequest(req);
      sendTcpData (Socket_nvm, "DLK_IOControl UNLOCK DMFR_MMA OK");
      write("DLK_IOControl UNLOCK_DMFR OK");
    }
    else if (DMRL_ACTIVE == 1)
    {
      diagRequest DMRL_MMA.DLK_IOControl_Control req;
      req.SetParameter("DiagRq_DLK_Thatcham_Lk_Unlk", 2);
      req.SetParameter("DiagRqData_DLK_Lk_Unlk", 2);
      req.SetParameter("EM_DiagRq_DLK_Thatcham_Lk_Unlk", 1);
      req.SetParameter("EM_DiagRqData_DLK_Lk_Unlk", 1);
      DiagSendRequest(req);
      sendTcpData (Socket_nvm, "DLK_IOControl UNLOCK DMRL_MMA OK");
      write("DLK_IOControl UNLOCK_DMRL OK");
    }
    else if (DMRR_ACTIVE == 1)
    {
      diagRequest DMRR_MMA.DLK_IOControl_Control req;
      req.SetParameter("DiagRq_DLK_Thatcham_Lk_Unlk", 2);
      req.SetParameter("DiagRqData_DLK_Lk_Unlk", 2);
      req.SetParameter("EM_DiagRq_DLK_Thatcham_Lk_Unlk", 1);
      req.SetParameter("EM_DiagRqData_DLK_Lk_Unlk", 1);
      DiagSendRequest(req);
      sendTcpData (Socket_nvm, "DLK_IOControl UNLOCK DMRR_MMA OK");
      write("DLK_IOControl UNLOCK_DMRR OK");
    }
       else
    {
      sendTcpData(Socket_nvm, "Set_target ERROR Target not conected");
    }
  }

  if ((strncmp(data,"Read_info DMFL_MMA", strlen(data)) != 0)&&(strncmp(data,"Read_info DMFR_MMA", strlen(data)) != 0)&&(strncmp(data,"Read_info DMRL_MMA", strlen(data)) != 0)&&(strncmp(data,"Read_info DMRR_MMA", strlen(data)) != 0)&&(strncmp(data,"Window_control DOWN", strlen(data)) != 0)&&(strncmp(data,"Window_control UP", strlen(data)) != 0)&&(strncmp(data,"Window_control STOP", strlen(data)) != 0)&&(strncmp(data,"DLK_IOControl UNLOCK", strlen(data)) != 0)&&(strncmp(data,"DLK_IOControl LOCK", strlen(data)) != 0))
  {
    sendTcpData (Socket_nvm, "Set_target ERROR Invalid Command");
  }
  
}

on sysvar LocalAuthentication::AuthResult
{
  if (@LocalAuthentication::AuthResult == 1)
  {
    //sendTcpData(Socket_nvm, "Authenticate OK");
    write("Set_target OK");
    @LocalAuthentication::AuthResult = 3;
  }
  else if (@LocalAuthentication::AuthResult == 0)
  {
    sendTcpData(Socket_nvm, "Set_target ZenzefiError");
    write("Set_target ZenzefiError");
  }
  else
  {
    /*no action*/
  }
}

on diagResponse *
{
  byte data[4096];
  long size;
  double param_value1=0xFF;
  double param_value2=0xFF;
  byte respon[20];
  char serialNumber[14];
  char stringResult[7];
  char nuevo_string[50];
  char myStringSW[20];
  char myStringHW[10];

  int i;
  diagResponse * resp; // declare response with no concrete interpretation
  size=this.GetPrimitiveSize(); // get length of response
  this.GetPrimitiveData(data, elcount(data)); // copy actual response from "on diagResponse *" into data array
  switch(data[0])
  {
    case 0x62: // UDS: Read data identifier positive Response
      if ((data[1]==0xF1) && (data[2]==0x51))/*SW VERSION*/
      {
        //totalVersions[0] = 0x00;
        //totalVersions[0] = '\0';
//        for (i= 0;i<42;i++)
//        {
//          totalVersions[i]='0';
//        }
//         write("clear%s", totalVersions);
        totalVersions[0] = '\0';
        for (i = 0; i < 6; i++)
        {
          myStringSW[3*i] = (data[i+3]/10) + 0x30; 
          myStringSW[3*i+1] = (data[i+3]%10) + 0x30; 
          if (i == 2)
          {
            myStringSW[3*i+2] = ' ';  
          }
          else if(i != 5)
          {
            myStringSW[3*i+2] = '.';
          }
        }
        write("SW_version: %s", myStringSW);
        //sendTcpData(Socket_nvm, myStringSW);
        strncat(totalVersions, myStringSW, 50);
        strncat(totalVersions, ",", 50);
      }
      if ((data[1]==0xF1) && (data[2]==0x50))/*HW VERSION*/
      {        
        for (i = 0; i < 3; i++)
        {
          myStringHW[3*i] = (data[i+3]/10) + 0x30; 
          myStringHW[3*i+1] = (data[i+3]%10) + 0x30; 
          if(i != 2)
          {
            myStringHW[3*i+2] = '.';
          }
        }
        write("HW_version: %s", myStringHW);
        //sendTcpData(Socket_nvm, myStringHW);
        strncat(totalVersions, myStringHW, 42);
        strncat(totalVersions, ",", 50);
      }
      if ((data[1]==0xF1) && (data[2]==0x8C)) /*SERIAL NUMBER*/
      {
        for (i = 0; i<13; i++)
        {
          serialNumber[i] = data[i+3];
        }
        write("Serial Number: %s", serialNumber);
        //sendTcpData(Socket_nvm, serialNumber);
        strncat(totalVersions, serialNumber, 50);
        write("SW,HW,SN: %s", totalVersions);
        sendTcpData(Socket_nvm, totalVersions);
        totalVersions[0] = '\0';
      }
      break;
    case 0x71: // UDS: EcuReset_Process positive Response
      
      break;
    default:
      break;
  }
}