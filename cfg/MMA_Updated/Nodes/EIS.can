includes
{
  // Import required CAPL include files
  //--- begin generated part --- Block start #GlobalBody_Includes#; do not delete this line and do not add application code in this code block!
  /* #ChannelGlobalStart# |CAN1| #BusGlobalStart# |BODY1| */
  #include "..\CAPL\ARGTMgr.cin"
  /* #ChannelGlobalEnd# |CAN1| #BusGlobalEnd# |BODY1| */
  //--- end generated part --- Block end #GlobalBody_Includes#; do not delete this line! Add application code below this line.
  //--- begin generated part --- Block start #Body_Includes#; do not delete this line and do not add application code in this code block!
  /* #ChannelStart# |CAN1| #BusStart# |BODY1| */
  #include "..\CAPL\PDU-IL-KL30-Helper_CAN1.cin"
  #include "..\CAPL\PDU-NM-Panel-Helper_CAN1.cin"
  #include "..\CAPL\PDU-NM-ASR-Helper_CAN1.cin"
  #include "..\Security\FreshnessSynchronization\SecTickCountSynchronization.cin"
  /* #ChannelEnd# |CAN1| #BusEnd# |BODY1| */
  //--- end generated part --- Block end #Body_Includes#; do not delete this line! Add application code below this line.
}

variables
{
  // Define global variables for this CAPL file

  /*--- #GenHeader Begin# --- begin generated comment ---
  | Generated on Tuesday, November 22, 2022, 07:51:13
  | By ModelGenerator for Daimler 1.5.4.10, ModelGeneratorDaimlerDLL 1.5.4.84
  | Package Daimler 4.1.0
  | Target Bus: BODY1; Channel: CAN1; DB Cluster: BODY1;
  | From Database: STAR_35_BODY1_CAN_2022_29a_AR43.arxml
  | CANoe Version 14.2.43.0
    --- #GenHeader End  # --- end generated comment --- */

  char gECU[256] = "EIS";
  //--- begin generated part --- Block start #Hdr_GlobalVariables#; do not delete this line and do not add application code in this code block!
  /* #ChannelStart# |CAN1| #BusStart# |BODY1| */
  // For BODY1::EIS_BODY1_Container_ST3_VSS_TP_VIN_ST3
  msTimer gCAN1TimerVIN1;
  int gCAN1VIN1MsgPart = 2;
  char gCAN1VIN1Buffer[24];
  /* #ChannelEnd# |CAN1| #BusEnd# |BODY1| */
  //--- end generated part --- Block end #Hdr_GlobalVariables#; do not delete this line! Add application code below this line.
  //--- begin generated part --- Block start #GlobalBody_GlobalVariables#; do not delete this line and do not add application code in this code block!
  /* #ChannelGlobalStart# |CAN1| #BusGlobalStart# |BODY1| */
  /* #ChannelGlobalEnd# |CAN1| #BusGlobalEnd# |BODY1| */
  //--- end generated part --- Block end #GlobalBody_GlobalVariables#; do not delete this line! Add application code below this line.
  //--- begin generated part --- Block start #Body_GlobalVariables#; do not delete this line and do not add application code in this code block!
  /* #ChannelStart# |CAN1| #BusStart# |BODY1| */
  char gCAN1BusName[256] = "BODY1";
  int gCAN1Channel = 1; //// The channel the bus is attached to
  int gCAN1TXEnable = 1; //// enable/disable TX of application messages

  long gCAN1DisturbanceMode;
  long gCAN1DisturbanceCount;
  long gCAN1DisturbanceValue;
  long gCAN1DisturbanceContinueMode;
  double gCAN1DisturbancePeriod;
  /* #ChannelEnd# |CAN1| #BusEnd# |BODY1| */
  //--- end generated part --- Block end #Body_GlobalVariables#; do not delete this line! Add application code below this line.
}

on preStart
{
  // Initialize CAPL includes and node's modules/DLLs
  //--- begin generated part --- Block start #Hdr_OnInit#; do not delete this line and do not add application code in this code block!
  /* #ChannelStart# |CAN1| #BusStart# |BODY1| */
  /* #ChannelEnd# |CAN1| #BusEnd# |BODY1| */
  //--- end generated part --- Block end #Hdr_OnInit#; do not delete this line! Add application code below this line.
  //--- begin generated part --- Block start #GlobalBody_OnInit#; do not delete this line and do not add application code in this code block!
  /* #ChannelGlobalStart# |CAN1| #BusGlobalStart# |BODY1| */
  ARGTMgr_OnInit();
  /* #ChannelGlobalEnd# |CAN1| #BusGlobalEnd# |BODY1| */
  //--- end generated part --- Block end #GlobalBody_OnInit#; do not delete this line! Add application code below this line.
  //--- begin generated part --- Block start #Body_OnInit#; do not delete this line and do not add application code in this code block!
  /* #ChannelStart# |CAN1| #BusStart# |BODY1| */
  ILCAN1_OnInit();
  NMCAN1_OnInit();
  SetBusContext(gILCAN1_BusContext);
  ILSetOperationMode(0, @sysvar::IL::UBPlugNPlay);
  // For BODY1::EIS_BODY1_Container_ST3_VSS_TP_VIN_ST3
  ILSetOperationMode(BODY1::EIS_BODY1_Container_ST3_VSS_TP_VIN_ST3::VSS_TP_VIN_0_ST3, 2, 0); // set NWM-WakeupAllowed to false
  ILSetOperationMode(BODY1::EIS_BODY1_Container_ST3_VSS_TP_VIN_ST3::VSS_TP_VIN_1_ST3, 2, 0); // set NWM-WakeupAllowed to false
  ILSetOperationMode(BODY1::EIS_BODY1_Container_ST3_VSS_TP_VIN_ST3::VSS_TP_VIN_2_ST3, 2, 0); // set NWM-WakeupAllowed to false
  ILSetOperationMode(BODY1::EIS_BODY1_Container_ST3_VSS_TP_VIN_ST3::VSS_TP_VIN_3_ST3, 2, 0); // set NWM-WakeupAllowed to false
  ILSetOperationMode(BODY1::EIS_BODY1_Container_ST3_VSS_TP_VIN_ST3::VSS_TP_VIN_4_ST3, 2, 0); // set NWM-WakeupAllowed to false
  ILSetOperationMode(BODY1::EIS_BODY1_Container_ST3_VSS_TP_VIN_ST3::VSS_TP_VIN_5_ST3, 2, 0); // set NWM-WakeupAllowed to false
  ILSetOperationMode(BODY1::EIS_BODY1_Container_ST3_VSS_TP_VIN_ST3::VSS_TP_VIN_6_ST3, 2, 0); // set NWM-WakeupAllowed to false
  ILSetOperationMode(BODY1::EIS_BODY1_Container_ST3_VSS_TP_VIN_ST3::VSS_TP_VIN_7_ST3, 2, 0); // set NWM-WakeupAllowed to false
  SetBusContext(gILCAN1_BusContext);
  SecurityLocalSetOperationParameter(1,1); // 1=TxFreshnessStartupBehaviour, 1=trigger "On Ignition On"
  SetBusContext(gILCAN1_BusContext);
  SecurityLocalSetOperationParameter(4,1); // 4=Increment Local Tick Count, 1=increment from measurement start
  SysSetVariableInt("SeckTickSynchronization", "ReadSecTickCountAtStart", 1); // Enable reading of global SecTickCount value from ECU during start
  /* #ChannelEnd# |CAN1| #BusEnd# |BODY1| */
  //--- end generated part --- Block end #Body_OnInit#; do not delete this line! Add application code below this line.
}

on start
{
  // Start CAPL includes and node's modules/DLLs
  //--- begin generated part --- Block start #Hdr_OnStart#; do not delete this line and do not add application code in this code block!
  /* #ChannelStart# |CAN1| #BusStart# |BODY1| */
  /* #ChannelEnd# |CAN1| #BusEnd# |BODY1| */
  //--- end generated part --- Block end #Hdr_OnStart#; do not delete this line! Add application code below this line.
  //--- begin generated part --- Block start #GlobalBody_OnStart#; do not delete this line and do not add application code in this code block!
  /* #ChannelGlobalStart# |CAN1| #BusGlobalStart# |BODY1| */
  ARGTMgr_OnStart();
  /* #ChannelGlobalEnd# |CAN1| #BusGlobalEnd# |BODY1| */
  //--- end generated part --- Block end #GlobalBody_OnStart#; do not delete this line! Add application code below this line.
  //--- begin generated part --- Block start #Body_OnStart#; do not delete this line and do not add application code in this code block!
  /* #ChannelStart# |CAN1| #BusStart# |BODY1| */
  ILCAN1_OnStart();
  NMCAN1_OnStart();
  SetBusContext(gILCAN1_BusContext);
  if (@sysvar::IL::Klemme15 != 0) SecurityLocalSetOperationParameter(3,1); // 3=Transmit Secure Tick Count Broadcast, 1=start transmission of Secure Tick Count
  /* #ChannelEnd# |CAN1| #BusEnd# |BODY1| */
  //--- end generated part --- Block end #Body_OnStart#; do not delete this line! Add application code below this line.
}

on preStop
{
  // Prepare stopping
  //--- begin generated part --- Block start #Hdr_OnStopping#; do not delete this line and do not add application code in this code block!
  /* #ChannelStart# |CAN1| #BusStart# |BODY1| */
  /* #ChannelEnd# |CAN1| #BusEnd# |BODY1| */
  //--- end generated part --- Block end #Hdr_OnStopping#; do not delete this line! Add application code below this line.
  //--- begin generated part --- Block start #Body_OnStopping#; do not delete this line and do not add application code in this code block!
  /* #ChannelStart# |CAN1| #BusStart# |BODY1| */
  /* #ChannelEnd# |CAN1| #BusEnd# |BODY1| */
  //--- end generated part --- Block end #Body_OnStopping#; do not delete this line! Add application code below this line.
}

on stopMeasurement
{
  // Stop actions
  //--- begin generated part --- Block start #Hdr_OnStop#; do not delete this line and do not add application code in this code block!
  /* #ChannelStart# |CAN1| #BusStart# |BODY1| */
  /* #ChannelEnd# |CAN1| #BusEnd# |BODY1| */
  //--- end generated part --- Block end #Hdr_OnStop#; do not delete this line! Add application code below this line.
  //--- begin generated part --- Block start #Body_OnStop#; do not delete this line and do not add application code in this code block!
  /* #ChannelStart# |CAN1| #BusStart# |BODY1| */
  /* #ChannelEnd# |CAN1| #BusEnd# |BODY1| */
  //--- end generated part --- Block end #Body_OnStop#; do not delete this line! Add application code below this line.
}

void StartSim(dword busContext, int busActive, int mode)
{
  // Called when ... due to ...
  //   mode == 1: ILControlResume
  //   mode == 2: ILControlStart
  //   mode == 3: ILControlSimulationOn
  //--- begin generated part --- Block start #Hdr_StartSim#; do not delete this line and do not add application code in this code block!
  /* #ChannelStart# |CAN1| #BusStart# |BODY1| */
  dword lCAN1BusContext_VIN1;
  /* #ChannelEnd# |CAN1| #BusEnd# |BODY1| */
  //--- end generated part --- Block end #Hdr_StartSim#; do not delete this line! Add application code below this line.
  //write("[%.6f %NODE_NAME%] StartSim(0x%X, %d, %d)", TimeNowNS()/1e9, busContext, busActive, mode);
  //--- begin generated part --- Block start #Body_StartSim#; do not delete this line and do not add application code in this code block!
  /* #ChannelStart# |CAN1| #BusStart# |BODY1| */
  lCAN1BusContext_VIN1 = GetBusNameContext(gCAN1BusName);
  if (busContext == lCAN1BusContext_VIN1)
  {
    SysGetVariableString(sysvar::ModelGlobal::VIN, gCAN1VIN1Buffer, elcount(gCAN1VIN1Buffer));
    if (strlen(gCAN1VIN1Buffer) == 0)
    {
      strncpy(gCAN1VIN1Buffer, "?????????????????", 24);
      SysSetVariableString(sysvar::ModelGlobal::VIN, gCAN1VIN1Buffer);
    }
  }
  if ((isTimerActive(gCAN1TimerVIN1) == 0) && (busContext == lCAN1BusContext_VIN1)) setTimer(gCAN1TimerVIN1,1); // Simulation of BODY1::EIS_BODY1_Container_ST3_VSS_TP_VIN_ST3
  /* #ChannelEnd# |CAN1| #BusEnd# |BODY1| */
  //--- end generated part --- Block end #Body_StartSim#; do not delete this line! Add application code below this line.
}

void StopSim(dword busContext, int busActive, int mode)
{
  // Called when ... due to ...
  //   mode == 1: ILControlWait
  //   mode == 2: ILControlStop
  //   mode == 3: ILControlSimulationOff
  //--- begin generated part --- Block start #Hdr_StopSim#; do not delete this line and do not add application code in this code block!
  /* #ChannelStart# |CAN1| #BusStart# |BODY1| */
  dword lCAN1BusContext_VIN1;
  /* #ChannelEnd# |CAN1| #BusEnd# |BODY1| */
  //--- end generated part --- Block end #Hdr_StopSim#; do not delete this line! Add application code below this line.
  //write("[%.6f %NODE_NAME%] StopSim(0x%X, %d, %d)", TimeNowNS()/1e9, busContext, busActive, mode);
  //--- begin generated part --- Block start #Body_StopSim#; do not delete this line and do not add application code in this code block!
  /* #ChannelStart# |CAN1| #BusStart# |BODY1| */
  // For BODY1::EIS_BODY1_Container_ST3_VSS_TP_VIN_ST3
  lCAN1BusContext_VIN1 = GetBusNameContext(gCAN1BusName);
  if (busContext == lCAN1BusContext_VIN1)
  {
    if (isTimerActive(gCAN1TimerVIN1))
      cancelTimer(gCAN1TimerVIN1);
  }
  /* #ChannelEnd# |CAN1| #BusEnd# |BODY1| */
  //--- end generated part --- Block end #Body_StopSim#; do not delete this line! Add application code below this line.
}

on sysvar_update sysvar::IL::Klemme15
{
  // Handle system state variable
  //--- begin generated part --- Block start #Hdr_KL15_Klemme15#; do not delete this line and do not add application code in this code block!
  /* #ChannelStart# |CAN1| #BusStart# |BODY1| */
  /* #ChannelEnd# |CAN1| #BusEnd# |BODY1| */
  //--- end generated part --- Block end #Hdr_KL15_Klemme15#; do not delete this line! Add application code below this line.
  //--- begin generated part --- Block start #Body_KL15_Klemme15#; do not delete this line and do not add application code in this code block!
  /* #ChannelStart# |CAN1| #BusStart# |BODY1| */
  ILCAN1_OnEnvKlemme15(@this);
  SetBusContext(gILCAN1_BusContext);
  if (@this != 0) SecurityLocalSetOperationParameter(3,1); // 3=Transmit Secure Tick Count Broadcast, 1=start transmission of Secure Tick Count
  /* #ChannelEnd# |CAN1| #BusEnd# |BODY1| */
  //--- end generated part --- Block end #Body_KL15_Klemme15#; do not delete this line! Add application code below this line.
}

on sysvar_update sysvar::IL::StartWithoutSending
{
  // Handle system state variable
  //--- begin generated part --- Block start #Hdr_StartManner_StartWithoutSending#; do not delete this line and do not add application code in this code block!
  /* #ChannelStart# |CAN1| #BusStart# |BODY1| */
  /* #ChannelEnd# |CAN1| #BusEnd# |BODY1| */
  //--- end generated part --- Block end #Hdr_StartManner_StartWithoutSending#; do not delete this line! Add application code below this line.
  //--- begin generated part --- Block start #Body_StartManner_StartWithoutSending#; do not delete this line and do not add application code in this code block!
  /* #ChannelStart# |CAN1| #BusStart# |BODY1| */
  ILCAN1_OnEnvStartWithoutSending(@this);
  /* #ChannelEnd# |CAN1| #BusEnd# |BODY1| */
  //--- end generated part --- Block end #Body_StartManner_StartWithoutSending#; do not delete this line! Add application code below this line.
}

on sysvar_update sysvar::IL::UBPlugNPlay
{
  // Handle system state variable
  //--- begin generated part --- Block start #Hdr_UBOpMode_UBPlugNPlay#; do not delete this line and do not add application code in this code block!
  /* #ChannelStart# |CAN1| #BusStart# |BODY1| */
  /* #ChannelEnd# |CAN1| #BusEnd# |BODY1| */
  //--- end generated part --- Block end #Hdr_UBOpMode_UBPlugNPlay#; do not delete this line! Add application code below this line.
  //--- begin generated part --- Block start #Body_UBOpMode_UBPlugNPlay#; do not delete this line and do not add application code in this code block!
  /* #ChannelStart# |CAN1| #BusStart# |BODY1| */
  SetBusContext(gILCAN1_BusContext);
  ILSetOperationMode(0, @this);
  /* #ChannelEnd# |CAN1| #BusEnd# |BODY1| */
  //--- end generated part --- Block end #Body_UBOpMode_UBPlugNPlay#; do not delete this line! Add application code below this line.
}

dword applPDUILTxPending(dword busContext, dword shortId, dword longId, char name[], dword& aPDULength, byte data[])
{
  dword ret = 1;
  //--- begin generated part --- Block start #Hdr_applPDUILTxPending#; do not delete this line and do not add application code in this code block!
  /* #ChannelStart# |CAN1| #BusStart# |BODY1| */
  /* #ChannelEnd# |CAN1| #BusEnd# |BODY1| */
  //--- end generated part --- Block end #Hdr_applPDUILTxPending#; do not delete this line! Add application code below this line.
  //write("[%.6f %NODE_NAME%] applPDUILTxPending(0x%X, 0x%X, 0x%X, %s, %d, %d)", TimeNowNS()/1e9, busContext, shortId, longId, name, aPDULength, elcount(data));
  //--- begin generated part --- Block start #Body_applPDUILTxPending#; do not delete this line and do not add application code in this code block!
  /* #ChannelStart# |CAN1| #BusStart# |BODY1| */
  /* #ChannelEnd# |CAN1| #BusEnd# |BODY1| */
  //--- end generated part --- Block end #Body_applPDUILTxPending#; do not delete this line! Add application code below this line.
  return ret;
}

dword applPDUILStart(dword busContext, dword busActive, dword mode)
{
  dword ret = 1;
  //--- begin generated part --- Block start #Hdr_applPDUILStart#; do not delete this line and do not add application code in this code block!
  /* #ChannelStart# |CAN1| #BusStart# |BODY1| */
  /* #ChannelEnd# |CAN1| #BusEnd# |BODY1| */
  //--- end generated part --- Block end #Hdr_applPDUILStart#; do not delete this line! Add application code below this line.
  //write("[%.6f %NODE_NAME%] applPDUILStart(0x%X, %d, %d)", TimeNowNS()/1e9, busContext, busActive, mode);
  //--- begin generated part --- Block start #Body_applPDUILStart#; do not delete this line and do not add application code in this code block!
  /* #ChannelStart# |CAN1| #BusStart# |BODY1| */
  /* #ChannelEnd# |CAN1| #BusEnd# |BODY1| */
  //--- end generated part --- Block end #Body_applPDUILStart#; do not delete this line! Add application code below this line.
  //--- begin generated part --- Block start #Footer_applPDUILStart#; do not delete this line and do not add application code in this code block!
  /* #ChannelStart# |CAN1| #BusStart# |BODY1| */
  StartSim(busContext, busActive, mode);
  /* #ChannelEnd# |CAN1| #BusEnd# |BODY1| */
  //--- end generated part --- Block end #Footer_applPDUILStart#; do not delete this line! Add application code below this line.
  return ret;
}

dword applPDUILStop(dword busContext, dword busActive, dword mode)
{
  dword ret = 1;
  //--- begin generated part --- Block start #Hdr_applPDUILStop#; do not delete this line and do not add application code in this code block!
  /* #ChannelStart# |CAN1| #BusStart# |BODY1| */
  /* #ChannelEnd# |CAN1| #BusEnd# |BODY1| */
  //--- end generated part --- Block end #Hdr_applPDUILStop#; do not delete this line! Add application code below this line.
  //write("[%.6f %NODE_NAME%] applPDUILStop(0x%X, %d, %d)", TimeNowNS()/1e9, busContext, busActive, mode);
  //--- begin generated part --- Block start #Body_applPDUILStop#; do not delete this line and do not add application code in this code block!
  /* #ChannelStart# |CAN1| #BusStart# |BODY1| */
  StopSim(busContext, busActive, mode);
  /* #ChannelEnd# |CAN1| #BusEnd# |BODY1| */
  //--- end generated part --- Block end #Body_applPDUILStop#; do not delete this line! Add application code below this line.
  //--- begin generated part --- Block start #Footer_applPDUILStop#; do not delete this line and do not add application code in this code block!
  /* #ChannelStart# |CAN1| #BusStart# |BODY1| */
  /* #ChannelEnd# |CAN1| #BusEnd# |BODY1| */
  //--- end generated part --- Block end #Footer_applPDUILStop#; do not delete this line! Add application code below this line.
  return ret;
}

void Nm_NetworkStartInd()
{
  // Callback of CAN AUTOSAR NM DLL
  dword lBusContext;
  //--- begin generated part --- Block start #Hdr_Nm_NetworkStartInd#; do not delete this line and do not add application code in this code block!
  /* #ChannelStart# |CAN1| #BusStart# |BODY1| */
  /* #ChannelEnd# |CAN1| #BusEnd# |BODY1| */
  //--- end generated part --- Block end #Hdr_Nm_NetworkStartInd#; do not delete this line! Add application code below this line.
  lBusContext = GetBusContext();
  //--- begin generated part --- Block start #Body_Nm_NetworkStartInd#; do not delete this line and do not add application code in this code block!
  /* #ChannelStart# |CAN1| #BusStart# |BODY1| */
  if (lBusContext == gNMCAN1_BusContext) NMCAN1_IndNetworkStart();
  /* #ChannelEnd# |CAN1| #BusEnd# |BODY1| */
  //--- end generated part --- Block end #Body_Nm_NetworkStartInd#; do not delete this line! Add application code below this line.
  SetBusContext(lBusContext);
}

void Nm_NetworkModeInd()
{
  // Callback of CAN AUTOSAR NM DLL
  dword lBusContext;
  //--- begin generated part --- Block start #Hdr_Nm_NetworkModeInd#; do not delete this line and do not add application code in this code block!
  /* #ChannelStart# |CAN1| #BusStart# |BODY1| */
  /* #ChannelEnd# |CAN1| #BusEnd# |BODY1| */
  //--- end generated part --- Block end #Hdr_Nm_NetworkModeInd#; do not delete this line! Add application code below this line.
  lBusContext = GetBusContext();
  //--- begin generated part --- Block start #Body_Nm_NetworkModeInd#; do not delete this line and do not add application code in this code block!
  /* #ChannelStart# |CAN1| #BusStart# |BODY1| */
  if (lBusContext == gNMCAN1_BusContext) NMCAN1_IndNetworkMode();
  /* #ChannelEnd# |CAN1| #BusEnd# |BODY1| */
  //--- end generated part --- Block end #Body_Nm_NetworkModeInd#; do not delete this line! Add application code below this line.
  SetBusContext(lBusContext);
}

void Nm_NetworkTimeoutInd()
{
  // Callback of CAN AUTOSAR NM DLL
  dword lBusContext;
  //--- begin generated part --- Block start #Hdr_Nm_NetworkTimeoutInd#; do not delete this line and do not add application code in this code block!
  /* #ChannelStart# |CAN1| #BusStart# |BODY1| */
  /* #ChannelEnd# |CAN1| #BusEnd# |BODY1| */
  //--- end generated part --- Block end #Hdr_Nm_NetworkTimeoutInd#; do not delete this line! Add application code below this line.
  lBusContext = GetBusContext();
  //--- begin generated part --- Block start #Body_Nm_NetworkTimeoutInd#; do not delete this line and do not add application code in this code block!
  /* #ChannelStart# |CAN1| #BusStart# |BODY1| */
  if (lBusContext == gNMCAN1_BusContext) NMCAN1_IndNetworkTimeout();
  /* #ChannelEnd# |CAN1| #BusEnd# |BODY1| */
  //--- end generated part --- Block end #Body_Nm_NetworkTimeoutInd#; do not delete this line! Add application code below this line.
  SetBusContext(lBusContext);
}

void Nm_PrepareBusSleepModeInd()
{
  // Callback of CAN AUTOSAR NM DLL
  dword lBusContext;
  //--- begin generated part --- Block start #Hdr_Nm_PrepareBusSleepModeInd#; do not delete this line and do not add application code in this code block!
  /* #ChannelStart# |CAN1| #BusStart# |BODY1| */
  /* #ChannelEnd# |CAN1| #BusEnd# |BODY1| */
  //--- end generated part --- Block end #Hdr_Nm_PrepareBusSleepModeInd#; do not delete this line! Add application code below this line.
  lBusContext = GetBusContext();
  //--- begin generated part --- Block start #Body_Nm_PrepareBusSleepModeInd#; do not delete this line and do not add application code in this code block!
  /* #ChannelStart# |CAN1| #BusStart# |BODY1| */
  if (lBusContext == gNMCAN1_BusContext) NMCAN1_IndPrepareBusSleepMode();
  /* #ChannelEnd# |CAN1| #BusEnd# |BODY1| */
  //--- end generated part --- Block end #Body_Nm_PrepareBusSleepModeInd#; do not delete this line! Add application code below this line.
  SetBusContext(lBusContext);
}

void Nm_BusSleepModeInd()
{
  // Callback of CAN AUTOSAR NM DLL
  dword lBusContext;
  //--- begin generated part --- Block start #Hdr_Nm_BusSleepModeInd#; do not delete this line and do not add application code in this code block!
  /* #ChannelStart# |CAN1| #BusStart# |BODY1| */
  /* #ChannelEnd# |CAN1| #BusEnd# |BODY1| */
  //--- end generated part --- Block end #Hdr_Nm_BusSleepModeInd#; do not delete this line! Add application code below this line.
  lBusContext = GetBusContext();
  //--- begin generated part --- Block start #Body_Nm_BusSleepModeInd#; do not delete this line and do not add application code in this code block!
  /* #ChannelStart# |CAN1| #BusStart# |BODY1| */
  if (lBusContext == gNMCAN1_BusContext) NMCAN1_IndBusSleepMode();
  /* #ChannelEnd# |CAN1| #BusEnd# |BODY1| */
  //--- end generated part --- Block end #Body_Nm_BusSleepModeInd#; do not delete this line! Add application code below this line.
  SetBusContext(lBusContext);
}

void Nm_StateChangeNotification(long previousState, long currentState)
{
  // Callback of CAN AUTOSAR NM DLL
  dword lBusContext;
  //--- begin generated part --- Block start #Hdr_Nm_StateChangeNotification#; do not delete this line and do not add application code in this code block!
  /* #ChannelStart# |CAN1| #BusStart# |BODY1| */
  /* #ChannelEnd# |CAN1| #BusEnd# |BODY1| */
  //--- end generated part --- Block end #Hdr_Nm_StateChangeNotification#; do not delete this line! Add application code below this line.
  lBusContext = GetBusContext();
  //--- begin generated part --- Block start #Body_Nm_StateChangeNotification#; do not delete this line and do not add application code in this code block!
  /* #ChannelStart# |CAN1| #BusStart# |BODY1| */
  if (lBusContext == gNMCAN1_BusContext) NMCAN1_IndStateChangeNotification(previousState, currentState);
  /* #ChannelEnd# |CAN1| #BusEnd# |BODY1| */
  //--- end generated part --- Block end #Body_Nm_StateChangeNotification#; do not delete this line! Add application code below this line.
  SetBusContext(lBusContext);
}

void OnSecurityLocalPDUPreTx(char pduName[], dword dataId, byte payload[], dword payloadLength, qword& authInfoHigh, qword& authInfo, dword authInfoBitLength, qword& freshness, dword freshnessBitLength, dword freshnessValueId)
{
  //--- begin generated part --- Block start #Hdr_OnSecurityLocalPDUPreTx#; do not delete this line and do not add application code in this code block!
  /* #ChannelStart# |CAN1| #BusStart# |BODY1| */
  /* #ChannelEnd# |CAN1| #BusEnd# |BODY1| */
  //--- end generated part --- Block end #Hdr_OnSecurityLocalPDUPreTx#; do not delete this line! Add application code below this line.
  // This is a callback from the node layer DLL 'SecMgrCANoeClient.dll'.
  //write("[%.6f %NETWORK_NAME% %NODE_NAME%] OnSecurityLocalPDUPreTx(PDU \"%s\", DataId: %u, Payload length: %i Byte, AuthInfo: %llu, Freshness: 0x%llX)", TimeNowNS()/1e9, pduName, dataId, payloadLength, authInfo, freshness);
  //--- begin generated part --- Block start #Body_OnSecurityLocalPDUPreTx#; do not delete this line and do not add application code in this code block!
  /* #ChannelStart# |CAN1| #BusStart# |BODY1| */
  /* #ChannelEnd# |CAN1| #BusEnd# |BODY1| */
  //--- end generated part --- Block end #Body_OnSecurityLocalPDUPreTx#; do not delete this line! Add application code below this line.
}

void OnARGTMgr_StatusChanged(word timeDomainIndex, word domainID, enum ARGTMgr_Status status)
{
  //--- begin generated part --- Block start #Hdr_OnARGTMgr_StatusChanged#; do not delete this line and do not add application code in this code block!
  /* #ChannelStart# |CAN1| #BusStart# |BODY1| */
  /* #ChannelEnd# |CAN1| #BusEnd# |BODY1| */
  //--- end generated part --- Block end #Hdr_OnARGTMgr_StatusChanged#; do not delete this line! Add application code below this line.
  //--- begin generated part --- Block start #Body_OnARGTMgr_StatusChanged#; do not delete this line and do not add application code in this code block!
  /* #ChannelStart# |CAN1| #BusStart# |BODY1| */
  /* #ChannelEnd# |CAN1| #BusEnd# |BODY1| */
  //--- end generated part --- Block end #Body_OnARGTMgr_StatusChanged#; do not delete this line! Add application code below this line.
}

void OnARGTMgr_SyncPoint(word timeDomainIndex, word domainID, byte dir, qword timeNs)
{
  //--- begin generated part --- Block start #Hdr_OnARGTMgr_SyncPoint#; do not delete this line and do not add application code in this code block!
  /* #ChannelStart# |CAN1| #BusStart# |BODY1| */
  /* #ChannelEnd# |CAN1| #BusEnd# |BODY1| */
  //--- end generated part --- Block end #Hdr_OnARGTMgr_SyncPoint#; do not delete this line! Add application code below this line.
  //--- begin generated part --- Block start #Body_OnARGTMgr_SyncPoint#; do not delete this line and do not add application code in this code block!
  /* #ChannelStart# |CAN1| #BusStart# |BODY1| */
  /* #ChannelEnd# |CAN1| #BusEnd# |BODY1| */
  //--- end generated part --- Block end #Body_OnARGTMgr_SyncPoint#; do not delete this line! Add application code below this line.
}

void OnARGTMgr_TriggerSyncMessageOnGatewayMasterPorts(word timeDomainIndex, word domainID, qword currentGlobalTimeNs, byte userBytes[], word userBytesLength)
{
  //--- begin generated part --- Block start #Hdr_OnARGTMgr_TriggerSyncMessageOnGatewayMasterPorts#; do not delete this line and do not add application code in this code block!
  /* #ChannelStart# |CAN1| #BusStart# |BODY1| */
  /* #ChannelEnd# |CAN1| #BusEnd# |BODY1| */
  //--- end generated part --- Block end #Hdr_OnARGTMgr_TriggerSyncMessageOnGatewayMasterPorts#; do not delete this line! Add application code below this line.
  //--- begin generated part --- Block start #Body_OnARGTMgr_TriggerSyncMessageOnGatewayMasterPorts#; do not delete this line and do not add application code in this code block!
  /* #ChannelStart# |CAN1| #BusStart# |BODY1| */
  /* #ChannelEnd# |CAN1| #BusEnd# |BODY1| */
  //--- end generated part --- Block end #Body_OnARGTMgr_TriggerSyncMessageOnGatewayMasterPorts#; do not delete this line! Add application code below this line.
}

//--- begin generated part --- Block start <#Helper_Functions#> do not delete this line and do not add application code in this code block!
/* #ChannelStart# |CAN1| #BusStart# |BODY1| */
on timer gCAN1TimerVIN1
{
  // Simulation of BODY1::EIS_BODY1_Container_ST3_VSS_TP_VIN_ST3
  // Sending Part Null (first 7 digits)
  // Pause 20ms
  // Sending Part One (next 7 digits)
  // Pause 20ms
  // Sending Part Two (last 3 digits; rest 0xFF)
  // Pause 960ms
  // Sending Part Null (first 7 digits)
  // etc.
  int TimerVal;
  int i;
  char apId[50] = "SECUREDVIN";
  byte gVINBuffer[17];
  dword returnValue;
  SysGetVariableString(sysvar::ModelGlobal::VIN, gCAN1VIN1Buffer, elcount(gCAN1VIN1Buffer));
  //if (1)
  {
    if (1)
    {
      // SecOC is activated, therefore use SecMgrCANoeClient.dll function:
      
      for (i = 0; ((i < elcount(gVINBuffer)) && (i < elcount(gCAN1VIN1Buffer))); i++)
        gVINBuffer[i] = gCAN1VIN1Buffer[i];
      SetBusContext(gILCAN1_BusContext);
      returnValue = LocalSecurityTransmitApplicationProtocol(apId, gVINBuffer, elcount(gVINBuffer));
      TimerVal = 1000;
    }
    else
    {
      switch ($BODY1::EIS_BODY1_Container_ST3_VSS_TP_VIN_ST3::VSS_TP_VIN_0_ST3)
      {
        case (0):
          gCAN1VIN1MsgPart = 1;
          $BODY1::EIS_BODY1_Container_ST3_VSS_TP_VIN_ST3::VSS_TP_VIN_0_ST3 = 1;
          $BODY1::EIS_BODY1_Container_ST3_VSS_TP_VIN_ST3::VSS_TP_VIN_1_ST3 = gCAN1VIN1Buffer[7];
          $BODY1::EIS_BODY1_Container_ST3_VSS_TP_VIN_ST3::VSS_TP_VIN_2_ST3 = gCAN1VIN1Buffer[8];
          $BODY1::EIS_BODY1_Container_ST3_VSS_TP_VIN_ST3::VSS_TP_VIN_3_ST3 = gCAN1VIN1Buffer[9];
          $BODY1::EIS_BODY1_Container_ST3_VSS_TP_VIN_ST3::VSS_TP_VIN_4_ST3 = gCAN1VIN1Buffer[10];
          $BODY1::EIS_BODY1_Container_ST3_VSS_TP_VIN_ST3::VSS_TP_VIN_5_ST3 = gCAN1VIN1Buffer[11];
          $BODY1::EIS_BODY1_Container_ST3_VSS_TP_VIN_ST3::VSS_TP_VIN_6_ST3 = gCAN1VIN1Buffer[12];
          $BODY1::EIS_BODY1_Container_ST3_VSS_TP_VIN_ST3::VSS_TP_VIN_7_ST3 = gCAN1VIN1Buffer[13];
          TimerVal = 20;
          break;
        case (1):
          gCAN1VIN1MsgPart = 2;
          $BODY1::EIS_BODY1_Container_ST3_VSS_TP_VIN_ST3::VSS_TP_VIN_0_ST3 = 2;
          $BODY1::EIS_BODY1_Container_ST3_VSS_TP_VIN_ST3::VSS_TP_VIN_1_ST3 = gCAN1VIN1Buffer[14];
          $BODY1::EIS_BODY1_Container_ST3_VSS_TP_VIN_ST3::VSS_TP_VIN_2_ST3 = gCAN1VIN1Buffer[15];
          $BODY1::EIS_BODY1_Container_ST3_VSS_TP_VIN_ST3::VSS_TP_VIN_3_ST3 = gCAN1VIN1Buffer[16];
          $BODY1::EIS_BODY1_Container_ST3_VSS_TP_VIN_ST3::VSS_TP_VIN_4_ST3 = 0xFF;
          $BODY1::EIS_BODY1_Container_ST3_VSS_TP_VIN_ST3::VSS_TP_VIN_5_ST3 = 0xFF;
          $BODY1::EIS_BODY1_Container_ST3_VSS_TP_VIN_ST3::VSS_TP_VIN_6_ST3 = 0xFF;
          $BODY1::EIS_BODY1_Container_ST3_VSS_TP_VIN_ST3::VSS_TP_VIN_7_ST3 = 0xFF;
          TimerVal = 960;
          break;
        case (2):
          gCAN1VIN1MsgPart = 0;
          $BODY1::EIS_BODY1_Container_ST3_VSS_TP_VIN_ST3::VSS_TP_VIN_0_ST3 = 0;
          $BODY1::EIS_BODY1_Container_ST3_VSS_TP_VIN_ST3::VSS_TP_VIN_1_ST3 = gCAN1VIN1Buffer[0];
          $BODY1::EIS_BODY1_Container_ST3_VSS_TP_VIN_ST3::VSS_TP_VIN_2_ST3 = gCAN1VIN1Buffer[1];
          $BODY1::EIS_BODY1_Container_ST3_VSS_TP_VIN_ST3::VSS_TP_VIN_3_ST3 = gCAN1VIN1Buffer[2];
          $BODY1::EIS_BODY1_Container_ST3_VSS_TP_VIN_ST3::VSS_TP_VIN_4_ST3 = gCAN1VIN1Buffer[3];
          $BODY1::EIS_BODY1_Container_ST3_VSS_TP_VIN_ST3::VSS_TP_VIN_5_ST3 = gCAN1VIN1Buffer[4];
          $BODY1::EIS_BODY1_Container_ST3_VSS_TP_VIN_ST3::VSS_TP_VIN_6_ST3 = gCAN1VIN1Buffer[5];
          $BODY1::EIS_BODY1_Container_ST3_VSS_TP_VIN_ST3::VSS_TP_VIN_7_ST3 = gCAN1VIN1Buffer[6];
          TimerVal = 20;
          break;
        default:
          gCAN1VIN1MsgPart = 0;
          $BODY1::EIS_BODY1_Container_ST3_VSS_TP_VIN_ST3::VSS_TP_VIN_0_ST3 = 0;
          $BODY1::EIS_BODY1_Container_ST3_VSS_TP_VIN_ST3::VSS_TP_VIN_1_ST3 = gCAN1VIN1Buffer[0];
          $BODY1::EIS_BODY1_Container_ST3_VSS_TP_VIN_ST3::VSS_TP_VIN_2_ST3 = gCAN1VIN1Buffer[1];
          $BODY1::EIS_BODY1_Container_ST3_VSS_TP_VIN_ST3::VSS_TP_VIN_3_ST3 = gCAN1VIN1Buffer[2];
          $BODY1::EIS_BODY1_Container_ST3_VSS_TP_VIN_ST3::VSS_TP_VIN_4_ST3 = gCAN1VIN1Buffer[3];
          $BODY1::EIS_BODY1_Container_ST3_VSS_TP_VIN_ST3::VSS_TP_VIN_5_ST3 = gCAN1VIN1Buffer[4];
          $BODY1::EIS_BODY1_Container_ST3_VSS_TP_VIN_ST3::VSS_TP_VIN_6_ST3 = gCAN1VIN1Buffer[5];
          $BODY1::EIS_BODY1_Container_ST3_VSS_TP_VIN_ST3::VSS_TP_VIN_7_ST3 = gCAN1VIN1Buffer[6];
          TimerVal = 1;
          break;
      }
    }
  }
  setTimer(gCAN1TimerVIN1, TimerVal);
}

/* #ChannelEnd# |CAN1| #BusEnd# |BODY1| */
//--- end generated part --- Block end <#Helper_Functions#> do not delete this line! Add application code below this line.

//--- begin generated part --- Block start <#SysVar_Handler#> do not delete this line and do not add application code in this code block!
/* #ChannelStart# |CAN1| #BusStart# |BODY1| */
on sysvar_update sysvar::IL_CAN1::NODES::N_EIS::EnableNode
{
  ILCAN1_Enable(@this && @sysvar::IL_CAN1::enable_AllNodes);
}

on sysvar_update sysvar::IL_CAN1::enable_AllNodes
{
  ILCAN1_Enable(@this && @sysvar::IL_CAN1::NODES::N_EIS::EnableNode);
}

on sysvar_update sysvar::NM_CAN1::NODES::N_EIS::DeactivateNM
{
  if( @this == 1 || @sysvar::NM_CAN1::StateControl::DeactivateNM == 1)
  {
    NMCAN1_Enable(0);
  }
  else
  {
    NMCAN1_Enable(1);
  }
}

on sysvar_update sysvar::NM_CAN1::StateControl::DeactivateNM
{
  if( @this == 1 || @sysvar::NM_CAN1::NODES::N_EIS::DeactivateNM == 1)
  {
    NMCAN1_Enable(0);
  }
  else
  {
    NMCAN1_Enable(1);
  }
}

on sysvar_update sysvar::NM_CAN1::NODES::N_EIS::OpenNodePanel
{
  OpenNodePanel("BODY1::EIS", 1);
}

on sysvar_update sysvar::NM_CAN1::StateControl::CloseNodePanels
{
  OpenNodePanel("BODY1::EIS", 0);
}

/* #ChannelEnd# |CAN1| #BusEnd# |BODY1| */
//--- end generated part --- Block end <#SysVar_Handler#> do not delete this line! Add application code below this line.

//--- begin generated part --- Block start <#MsgUpdateFcns#> do not delete this line and do not add application code in this code block!
/* #ChannelStart# |CAN1| #BusStart# |BODY1| */
/* #ChannelEnd# |CAN1| #BusEnd# |BODY1| */
//--- end generated part --- Block end <#MsgUpdateFcns#> do not delete this line! Add application code below this line.

