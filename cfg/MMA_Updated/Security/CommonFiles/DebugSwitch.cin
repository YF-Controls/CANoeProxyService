/*@!Encoding:1252*/

// Security Feature V2.10.6.0

variables
{
    int debug = 0; 
}

