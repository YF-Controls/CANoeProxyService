/*@!Encoding:1252*/

// Security Feature V2.10.6.0

//////////////////////////////////////////////////////////////
// SecTickCountSynchronization.cin
//
// Adapter to put the new freshnessvalue (read from the ECUs)
// into the VSM simulation.
// An additonal offset is added to consider some delays 
// 
//
//////////////////////////////////////////////////////////////

on sysvar_update sysvar::SeckTickSynchronization::CalculatedSecTickCountWithOffset
{
  // Integrator GeneratedCode start
sysSetVariableLongLong(sysvarMember::_Security::BODY1::PredefinedFreshness::TickCount.Value,@sysvar::SeckTickSynchronization::CalculatedSecTickCountWithOffset);
  // Integrator GeneratedCode end
}

on sysvar_update sysvar::SeckTickSynchronization::Button_TriggerManualSeckTickCountUpdate
{
  if( @this == 1 )
  {
  // Integrator GeneratedCode start
@sysvar::SeckTickSynchronization::CalculatedSecTickCountWithOffset = @sysvar::SeckTickSynchronization::ManualUpdateValue;
  // Integrator GeneratedCode end
  }
}

on sysvar_update sysvar::SeckTickSynchronization::Button_ReadSeckTickCount
{
  if(@this == 1)
    ReadSecTickCount();  
}

void ReadSecTickCount()
{
  @sysvar::SeckTickSynchronization::ReadSeckTickCountOnly = 1; // configures test module
  
  @sysvar::SeckTickSynchronization::TriggerSecTickCountRead = 1; //starts test module 
}

on sysvar_update sysvar::SeckTickSynchronization::Button_SecTickCountSync
{
  if( @this==1)
  {
    @sysvar::SeckTickSynchronization::ReadSeckTickCountOnly = 0; // configures test module
    @sysvar::SeckTickSynchronization::TriggerSecTickCountRead = 1; //starts test module
  }
}

on sysvar_update sysvar::SeckTickSynchronization::Button_SignTickCountOffset
{
  if(@this == 1 )
  {
    if( @sysvar::SeckTickSynchronization::SignTickCountOffset == 0 )
    {
      @sysvar::SeckTickSynchronization::SignTickCountOffset = 1;
      putValueToControl("SecTickCountSynchronization","SignTickCountOffset","+");
    }
    else
    {
      @sysvar::SeckTickSynchronization::SignTickCountOffset = 0;
      putValueToControl("SecTickCountSynchronization","SignTickCountOffset","-");
    }
      
  }
}

on Start
{
  if( @sysvar::SeckTickSynchronization::ReadSecTickCountAtStart == 1 )
  {
    ReadSecTickCount();
  }
  UpdateSeckTickCountSyncPanel();
}

void UpdateSeckTickCountSyncPanel()
{
  if( @sysvar::SeckTickSynchronization::SignTickCountOffset == 1 )
    putValueToControl("SecTickCountSynchronization","SignTickCountOffset","+");
  else if (@sysvar::SeckTickSynchronization::SignTickCountOffset == 0 )
    putValueToControl("SecTickCountSynchronization","SignTickCountOffset","-");  
}



on sysvar_update sysvar::SeckTickSynchronization::TriggerRTOffsetBroadcast
{
  char apId_RTOffset[15] = "REALTIMEOFFSET";
  byte payloadRTOffset[12];	
  long copiedBytes;
  word year;
    
  if( @this == 1)
  {
    sysGetVariableData(sysvar::SeckTickSynchronization::ECU_DateTime,payloadRTOffset, copiedBytes);
    year = payloadRTOffset[1] + (payloadRTOffset[0]*100);
    payloadRTOffset[0] = (year >> 8) & 0xFF;
    payloadRTOffset[1] = (year) & 0xFF;
    payloadRTOffset[7] =  (@sysvar::SeckTickSynchronization::CalculatedSecTickCountWithOffset >> 32) & 0xFF;
    payloadRTOffset[8] =  (@sysvar::SeckTickSynchronization::CalculatedSecTickCountWithOffset >> 24) & 0xFF;
    payloadRTOffset[9] =  (@sysvar::SeckTickSynchronization::CalculatedSecTickCountWithOffset >> 16) & 0xFF;
    payloadRTOffset[10] = (@sysvar::SeckTickSynchronization::CalculatedSecTickCountWithOffset >> 8)  & 0xFF;
    payloadRTOffset[11] = @sysvar::SeckTickSynchronization::CalculatedSecTickCountWithOffset & 0xFF;
    write("payloadRTOffset: %x %x %x %x %x %x %x tick: %x %x %x %x %x", payloadRTOffset[0], payloadRTOffset[1], payloadRTOffset[2], payloadRTOffset[3], 
                                                                  payloadRTOffset[4], payloadRTOffset[5], payloadRTOffset[6], payloadRTOffset[7], 
                                                                  payloadRTOffset[8], payloadRTOffset[9], payloadRTOffset[10], payloadRTOffset[11]);
    SecurityLocalTransmitApplicationProtocol(apId_RTOffset,payloadRTOffset,elcount(payloadRTOffset));
    @sysvar::SeckTickSynchronization::TriggerRTOffsetBroadcast = 0;
  }
}



